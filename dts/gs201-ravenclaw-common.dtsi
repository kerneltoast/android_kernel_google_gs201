// SPDX-License-Identifier: GPL-2.0-only
/*
 * Ravenclaw device tree source
 *
 * Copyright 2021 Google,LLC
 */

#include "gs201-cloudripper-common.dtsi"

#include "gs201-ravenclaw-audio.dtsi"
#include "gs201-ravenclaw-display.dtsi"
#include "gs201/gs201-ravenclaw-fingerprint.dtsi"
#include "gs201-ravenclaw-pmic.dtsi"
#include "gs201-ravenclaw-thermal.dtsi"
#include "gs201-ravenclaw-touch.dtsi"
#include "gs201-ravenclaw-typec.dtsi"
#include "gs201-ravenclaw-wcharger.dtsi"
#include "gs201-ravenclaw-usecases.dtsi"
#include "gs201/gs201-ravenclaw-uwb.dtsi"
