// SPDX-License-Identifier: GPL-2.0-only
/*
 * Lynx device tree source
 *
 * Copyright 2021 Google,LLC
 */

/dts-v1/;
/plugin/;

#include "gs201-lynx-common.dtsi"
#include "gs201-lynx-touch-dev1_0.dtsi"

/ {
	board_id = <0x30501>;
	board_rev = <0x10000>;
	fragment@boardbase {
		target-path="/";
		__overlay__ {
			model = "GS201 Lynx DEV 1.0 based on GS201";
			compatible = "google,GS201 LYNX", "google,GS201";
		};
	};
};

&serial_0 {
	status = "okay";
};

&aoc {
	sensor_mag-supply = <&m_ldo24_reg>;
	sensor_power_list = "sensor_mag", "sensor_1v8", "sensor_3v3";
};
