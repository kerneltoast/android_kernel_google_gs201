// SPDX-License-Identifier: GPL-2.0-only
/*
 * Google L10 touch device tree source
 *
 * Copyright 2022 Google Inc.
 *
 */

#include <arm64/exynos/exynos-pinctrl.h>
#include <dt-bindings/regulator/samsung,s2mpg-regulator.h>

/*
 * Touch is connected to spi_0, pins:
 *   CLK=GPP20[0], MOSI=GPP20[1], MISO=GPP20[2], CS=GPP20[3]
 * TS_RESET_L = C26 = XAPC_USI11_RTSN_DI = GPP23[2] = <&gpp23 2 0>
 * TS_INT_L = AT22 = XEINT_8 = GPA7[0] = <&gpa7 0 0>
 *
 * DVDD = PP1800_L25M_TSP_DVDD = ??? = VLDO25M = "PP1800_L25M_TSP"?
 * AVDD = PP3300_L26M_TS_AVDD  = ??? = VLDO26M = "PP3300_L26M_TSP"?
 *
 * AP2AOC: XHSI1_GPIO2 - GPH1[0] -> XAOC_GPIO13 - gpio_in[87]
 * AOC2AP: XAOC_GPIO8 - gpio_in[74] -> XEINT_19 - GPA8[7]
 */

&spi_0 {
	dma-mode;
	dmas = <&pdma0 0 &pdma0 1>;
	swap-mode = <1>;
	cs-gpio = <&gpp20 3 GPIO_ACTIVE_LOW>;
	num-cs = <1>;
};

&spitouch {
	status = "ok";
	compatible = "goodix,nottingham";

	spi-max-frequency = <10000000>;

	goodix,irq-gpio = <&gpa7 0 0>;
	goodix,reset-gpio = <&gpp23 2 0>;
	goodix,avdd-name = "avdd";
	goodix,iovdd-name = "vdd";
	goodix,irq-flags = <2>; /* 1:trigger rising, 2:trigger falling;*/
	goodix,panel-max-x = <1079>;
	goodix,panel-max-y = <2399>;
	goodix,panel-max-w = <255>;
	goodix,panel-max-p = <255>;
	goodix,panel-height-mm = <142>;
	goodix,udfps-x = <540>;
	goodix,udfps-y = <1717>;
	goodix,sleep-enable;

	goog,offload-enabled;
	goog,v4l2-enabled;
	goog,offload-caps-scan-types = /bits/ 16 <0xC0>;
	goog,touch_offload_id = /bits/ 8 <'l' '1' '0' '0'>;
	goog,display-resolution = /bits/ 16 <1080 2400>;
	goog,channel-num = /bits/ 16 <16 34>;
	goog,tbn-enabled;

	controller-data {
		samsung,spi-feedback-delay = <0>;
		samsung,spi-chip-select-mode = <1>;
		cs-clock-delay = <1>;
	};
};
