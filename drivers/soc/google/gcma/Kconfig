## google-modules/amplifiers/cs35l45/Kconfig
```kconfig
# SPDX-License-Identifier: GPL-2.0-only
config SND_SOC_CS35L45_CS_DSP
	tristate
	default n

config SND_SOC_CS35L45
        tristate "Cirrus Logic CS35L45 CODEC"
        select SND_SOC_CS35L45_WM_ADSP

config SND_SOC_CS35L45_SPI
	tristate "Cirrus Logic CS35L45 CODEC (SPI)"
	depends on SND_SOC_CS35L45
	depends on SPI_MASTER
	select SND_SOC_CS35L45
	select REGMAP_SPI

config SND_SOC_CS35L45_I2C
	tristate "Cirrus Logic CS35L45 CODEC (I2C)"
	depends on I2C
	select SND_SOC_CS35L45
	select REGMAP_I2C
```

## google-modules/amplifiers/cs40l25/Kconfig
```kconfig
#
# Misc strange devices
#

config HAPTICS_CS40L2X
	tristate "Cirrus Logic CS40L20/CS40L25/CS40L25A/CS40L25B haptics driver"
	depends on I2C && SYSFS && NEW_LEDS
	help
	  Boosted Haptics Driver with Integrated DSP and Waveform Memory
	  with Closed Loop Algorithms and LRA Protection

config SND_SOC_CS40L2X
	tristate "Cirrus Logic CS40L20/CS40L25/CS40L25A/CS40L25B PCM haptics PCM driver"
	depends on HAPTICS_CS40L2X
	help
	  Haptics PCM Driver with Integrated DSP and Waveform Memory
	  with Closed Loop Algorithms and LRA Protection
```
