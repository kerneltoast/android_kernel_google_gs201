## drivers/soc/google/gcma/Kconfig
```kconfig
# SPDX-License-Identifier: GPL-2.0
#
config GCMA
        tristate "GCMA(Guaranteed Contiguous Memory Allocator"
        depends on CLEANCACHE
```

## drivers/soc/google/gnssif_spi/Kconfig
```kconfig
config EXYNOS_GNSS_IF_SPI
	tristate "Exynos GNSS SPI interface driver"
	default n
	help
	  Exynos GNSS SPI interface driver
```

## drivers/soc/google/gsa/Kconfig
```kconfig
config GSA
	tristate "GSA driver"
	default n

config GSA_PKVM
	bool "Support pKVM"
	depends on GSA
	depends on PKVM_S2MPU
	default n

config GSA_GSC
	tristate "GSC Proxy"
	depends on GSA
	default n
```

## drivers/soc/google/pa_kill/Kconfig
```kconfig
# SPDX-License-Identifier: GPL-2.0
#
config PROACTIVE_KILL
	tristate "Proactive Kill"
```

## drivers/soc/google/s2mpu/Kconfig
```kconfig
config GS_S2MPU
	tristate "S2MPU driver"
	depends on ARM64
	depends on SOC_GS101
```

## drivers/soc/google/smra/Kconfig
```kconfig
# SPDX-License-Identifier: GPL-2.0
#
config SMRA
        tristate "Smart Readahead"
```

## drivers/soc/google/vh/kernel/Kconfig
```kconfig
# SPDX-License-Identifier: GPL-2.0-only
# kernel vendor hook modules

config VH_SYSTRACE
	tristate "Vendor SYSTRACE support"
	depends on VH_KERNEL
	depends on TRACING
	default n
	help
	  This module exports ATRACE_XXX APIs at kernel.
	  All tracepoints can be identified and plotted at Chrome tracing UI.

	  Use APIs exported by this module to correlate kernel activities
	  to userspace and system events in the timeline.

	  If in doubt, say N.

config PIXEL_EM
	tristate "Enable Pixel Energy Model driver"
	depends on VH_KERNEL
	default n
	help
	  Support Pixel Energy Model.

config PIXEL_METRICS
        tristate "Enable PIXEL METRICS driver"
        depends on VH_KERNEL
        default n

config CPUIDLE_METRICS
	bool "Use cpu idle metrics module"
	depends on PIXEL_METRICS
	default y

config VH_FS
	tristate "Vendor hooks for filesystem"
	depends on VH_KERNEL
	default n

config VH_MM
	tristate "Vendor hooks for Memory Management"
	depends on VH_KERNEL
	default n

config VH_CGROUP
	tristate "Vendor hooks for cgroup"
	depends on VH_KERNEL
	default n

config VH_THERMAL
	tristate "Vendor hooks for kernel thermal"
	depends on VH_KERNEL
	default n

source "$(KCONFIG_SOC_GS_PREFIX)drivers/soc/google/vh/kernel/sched/Kconfig"
```

## drivers/staging/android/ion/exynos/Kconfig
```kconfig
# SPDX-License-Identifier: GPL-2.0
config ION_EXYNOS_CMA_HEAP
	bool "Ion Exynos CMA heap support"
	depends on CMA
	help
	  Choose this option to enable CMA heap with Ion for Exynos SoCs.
	  Unlike the cma heap supported by ION_CMA_HEAP, only selected
	  cma area is registered as a heap.

config ION_EXYNOS
	tristate "Ion Exynos heap support"
	depends on ION
```

## drivers/thermal/google/Kconfig
```kconfig
# SPDX-License-Identifier: GPL-2.0-only

config GSOC_PMIC_THERMAL
	tristate "Google LLC. Granville SPMIC thermal driver"
	depends on THERMAL
	help
	  This enables the thermal driver for the Granville PMIC adc thermistors
	  device. It registers thermal zone with multiple trip points.
	  Thermal client sets threshold temperature and  gets updated when
	  a threshold is reached.

config GSOC_PMIC_THERMAL_CAMBRIA
	tristate "Google LLC. Cambria SPMIC thermal driver"
	depends on THERMAL
	help
	  This enables the thermal driver for the Cambria PMIC adc thermistors
	  device. It registers thermal zone with multiple trip points.
	  Thermal client sets threshold temperature and  gets updated when
	  a threshold is reached.

config THERMAL_SENSOR_STS4X
	tristate "Sensiron STS4X temperature sensor."
	depends on THERMAL && I2C
	help
	  This enables the thermal driver for the Digital Temp Sensor (STS4x).
	  It initiates a i2c_driver and registers a thermal zone to get temperature.

config THERMAL_UCLAMP_COOLING_DEVICE
	tristate "Thermal cooling device for scheduler auto uclamp"
	depends on THERMAL && VH_SCHED
	help
	  This module will register cooling device to place thermal auto uclamp max
	  for each cluster. There will be one cooling device per cluster and thermal
	  governors can use these cooling device to mitigate CPU to selectively allow
	  ADPF tasks to use the max CPU capacity.
```

## drivers/thermal/samsung/Kconfig
```kconfig
# SPDX-License-Identifier: GPL-2.0-only
config EXYNOS_THERMAL
	tristate "Exynos thermal management unit driver"
	depends on THERMAL_OF
	depends on HAS_IOMEM
	help
	  If you say yes here you get support for the TMU (Thermal Management
	  Unit) driver for Samsung Exynos series of SoCs. This driver initialises
	  the TMU, reports temperature and handles cooling action if defined.
	  This driver uses the Exynos core thermal APIs and TMU configuration
	  data from the supported SoCs.

config GS101_THERMAL_V2
	tristate "GS101 thermal management unit driver"
	depends on THERMAL_OF
	depends on HAS_IOMEM
	help
	  If you say yes here you get support for the TMU (Thermal Management
	  Unit) driver for GS101 SoCs. This driver initialises
	  the TMU, reports temperature and handles cooling action if defined.
	  This driver uses the GS101 thermal APIs and TMU configuration
	  data from the supported SoCs.

config EXYNOS_ACPM_THERMAL
	tristate "Exynos ACPM TMU plug-in support"
	depends on GS101_THERMAL_V2
	help
	  This feature supports ACPM TMU plug-in for Exynos thermal driver.

config EXYNOS_CPU_THERMAL
	tristate "EXYNOS cpu cooling support"
	depends on GS101_THERMAL_V2
	help
	  This implements the generic cpu cooling mechanism through frequency
	  reduction. An ACPI version of this already exists
	  (drivers/acpi/processor_thermal.c).
	  This will be useful for platforms using the generic thermal interface
	  and not the ACPI interface.
	  If you want this support, you should say Y here.

config GPU_THERMAL
	tristate "gpu cooling support"
	depends on GS101_THERMAL_V2
	help
	  This implements the gpu cooling mechanism through frequency
	  reduction.
	  If you want this support, you should say Y here.

config ISP_THERMAL
	tristate "isp cooling support"
	depends on GS101_THERMAL_V2
	help
	  This implements the isp cooling mechanism through fps
	  reduction.
	  If you want this support, you should say Y here.
```

## drivers/ufs/Kconfig
```kconfig
# SPDX-License-Identifier: GPL-2.0-only

config SCSI_UFS_EXYNOS_GS
	tristate "EXYNOS UFS Host Controller Driver for GS SoCs"
	depends on SCSI_UFSHCD && SCSI_UFSHCD_PLATFORM
	help
	  This selects the GS UFS host controller driver which
	  run with GS SoCs.

	  If you have a controller with this interface, say Y or M here.

config SCSI_UFS_CRYPTO_SW_KEYS_MODE
	bool "Enable support for software delivered encryption keys"
	depends on SCSI_UFS_CRYPTO
	help
	  The exynos controller supports both hardware and software encryption
	  key modes. The hardware encryption key mode is the default one. This
	  config enables support for software key mode which must be activated
	  via the use_kdn=0 module parameter passed via command line.

config SCSI_UFS_PIXEL_FIPS140
	tristate "Enable FIPS 140 CMVP Module"
	depends on m && SCSI_UFS_EXYNOS_GS && SCSI_UFS_CRYPTO
	select CRYPTO_FIPS140_MERGE_MOD_SECTIONS
	help
	  Build a module capable of executing FIPS140-3 compliant self tests of
	  the UFS crypto engine. The module is used to execute power on self
	  test for cases where the hardware component does not support
	  the functionality natively.
```

## drivers/usb/dwc3/Kconfig
```kconfig
# SPDX-License-Identifier: GPL-2.0

if USB_DWC3

config USB_DWC3_EXYNOS_GS
	tristate "GS Platform"
	depends on (USB_DWC3 || COMPILE_TEST) && OF
	help
	  'USB_DWC3_EXYNOS_GS' is glue layer which can be used with
	  Synopsys DWC3 controller on GS SoCs. Say 'Y' or 'M'
	  if you have one such devices.

endif
```

## drivers/usb/gadget/Kconfig
```kconfig
# SPDX-License-Identifier: GPL-2.0
#
# USB Gadget support on a system involves
#    (a) a peripheral controller, and
#    (b) the gadget driver using it.
#
# NOTE:  Gadget support ** DOES NOT ** depend on host-side CONFIG_USB !!
#
#  - Host systems (like PCs) need CONFIG_USB (with "A" jacks).
#  - Peripherals (like PDAs) need CONFIG_USB_GADGET (with "B" jacks).
#  - Some systems have both kinds of controllers.
#
# With help from a special transceiver and a "Mini-AB" jack, systems with
# both kinds of controller can also support "USB On-the-Go" (CONFIG_USB_OTG).
#

if USB_GADGET

config USB_F_DM
	tristate

config USB_F_ETR_MIU
	tristate

config USB_CONFIGFS_F_DM
	tristate "DM gadget"
	depends on USB_CONFIGFS
	select USB_F_DM
	select USB_U_SERIAL
	help
	  USB gadget DM(Diagnosis Monitor) support

config USB_CONFIGFS_F_ETR_MIU
	tristate "ETR_MIU"
	depends on USB_CONFIGFS
	select USB_F_ETR_MIU
	help
	  The ETR_MIU function enables sending trace data from Coresight ETR to USB
	  via ETR_MIU. The function has an interface with two alternate settings.
	  Alt0 setting is idle mode. Alt1 setting is data transfer mode. USB host
	  must set Alt1 before attempting to download trace data.
endif # USB_GADGET
```

## drivers/usb/host/Kconfig
```kconfig
# SPDX-License-Identifier: GPL-2.0
#
# USB Host Controller Drivers
#

if USB_XHCI_HCD

config USB_XHCI_EXYNOS
	tristate "xHCI support for EXYNOS SoCs"
	help
	  Say 'Y' to enable the support for the xHCI host controller
	  found in Exynos SoCs.

config USB_XHCI_GOOG_DMA
	tristate "xHCI DMA driver for GOOG SoCs"
	help
	  Say 'Y' to enable the support for the xHCI DMA driver for
	  GOOG SoCs.

endif # USB_XHCI_HCD
```

## drivers/usb/typec/tcpm/google/Kconfig
```kconfig
# SPDX-License-Identifier: GPL-2.0-only
#
# Copyright (C) 2021, Google LLC

if TYPEC_TCPM

config USB_PSY
	tristate

config TYPEC_COOLING_DEV
	tristate "USB TYPE-C port cooling device"
	depends on EXTCON
	select THERMAL
	select GOOGLE_VOTABLE
	help
	  Type-C port passive cooling device to throttle when the port is hot.

if TYPEC_TCPCI

config TYPEC_FUSB307
	tristate "Fairchild FUSB307B Type-C chip driver"
	select USB_PSY
	help
	  The Fairchild FUSB307 Type-C chip driver that works with
	  Type-C Port Controller Manager to provide USB PD and USB
	  Type-C functionalities.

config TYPEC_MAX77759
	tristate "Maxim MAX77759 Type-C driver"
	select USB_PSY
	help
	  MAX77759 TCPCI driver to interface with TCPM.

endif # TYPEC_TCPCI
endif # TYPEC_TCPM

config POGO_TRANSPORT
	tristate "Pogo transport management driver"
	depends on TYPEC_MAX77759
	select GOOGLE_LOGBUFFER
	help
	  Pogo transport management driver
```

## drivers/video/Kconfig
```kconfig
# SPDX-License-Identifier: GPL-2.0-only
#
# Video configuration
#

if HAS_IOMEM

source "$(KCONFIG_SOC_GS_PREFIX)drivers/gpu/exynos/Kconfig"

endif
```

## drivers/video/backlight/Kconfig
```kconfig
# SPDX-License-Identifier: GPL-2.0-only
#
# Backlight drivers configuration
#

if BACKLIGHT_CLASS_DEVICE

config BACKLIGHT_RT4539_GS
	tristate "Backlight driver for Richtek RT4539"
	depends on I2C
	help
	  This supports Richtek RT4539 backlight driver.

endif # BACKLIGHT_CLASS_DEVICE
```

## drivers/watchdog/Kconfig
```kconfig
# SPDX-License-Identifier: GPL-2.0-only

#
# Watchdog device configuration
#

if WATCHDOG

# ARM Architecture

config S3C2410_WATCHDOG_GS
	tristate "S3C2410 Watchdog in Google SoCs"
	select WATCHDOG_CORE
	help
	  Watchdog timer block in the Samsung SoCs and some Google SoCs. This
	  will reboot the system when the timer expires with the watchdog
	  enabled.

	  The driver is limited by the speed of the system's PCLK
	  signal, so with reasonably fast systems (PCLK around 50-66MHz)
	  then watchdog intervals of over approximately 20seconds are
	  unavailable.

	  The driver can be built as a module by choosing M, and will
	  be called s3c2410_wdt

config S3C2410_SHUTDOWN_REBOOT
	bool "Support watchdog reset after watchdog shutdown"
	depends on S3C2410_WATCHDOG_GS
	default n
	help
	  This config disable the shutdown function of S3C2410 watchdog.
	  To prevent stuck after watchdog driver shutdown, shutdown
	  function will not stop or disable watchdog and it will just
	  kick 30 second. It will prevent being stucked in reset
	  sequence with some other failure.
	  This feature is not recommeneded for debugging.

endif # WATCHDOG
```

## fps_touch_handler/Kconfig
```kconfig
# SPDX-License-Identifier: GPL-2.0

config FPS_TOUCH_HANDLER
	tristate "fps touch handler"
	default n
	help
	add support for fps touch handler.
```

## google-devices/gs201/Kconfig.ext.gs201
```kconfig
# SPDX-License-Identifier: GPL-2.0-only

source "$(KCONFIG_SOC_GS_PREFIX)drivers/block/zram/Kconfig"

source "$(KCONFIG_SOC_GS_PREFIX)drivers/bts/Kconfig"

source "$(KCONFIG_SOC_GS_PREFIX)drivers/clk/gs/Kconfig"

source "$(KCONFIG_SOC_GS_PREFIX)drivers/clocksource/Kconfig"

source "$(KCONFIG_SOC_GS_PREFIX)drivers/cpufreq/Kconfig"

source "$(KCONFIG_SOC_GS_PREFIX)drivers/devfreq-whi/google/Kconfig"

source "$(KCONFIG_SOC_GS_PREFIX)drivers/dma-buf/heaps/Kconfig"

source "$(KCONFIG_SOC_GS_PREFIX)drivers/dma/Kconfig"

source "$(KCONFIG_SOC_GS_PREFIX)drivers/i2c/busses/Kconfig"

source "$(KCONFIG_SOC_GS_PREFIX)drivers/iio/Kconfig"

source "$(KCONFIG_SOC_GS_PREFIX)drivers/input/Kconfig"

source "$(KCONFIG_SOC_GS_PREFIX)drivers/iommu/Kconfig"

source "$(KCONFIG_SOC_GS_PREFIX)drivers/media/platform/Kconfig"

source "$(KCONFIG_SOC_GS_PREFIX)drivers/mfd/Kconfig"

source "$(KCONFIG_SOC_GS_PREFIX)drivers/misc/Kconfig"

source "$(KCONFIG_SOC_GS_PREFIX)drivers/pci/controller/dwc-whi/Kconfig"

source "$(KCONFIG_SOC_GS_PREFIX)drivers/performance/gs_perf_mon/Kconfig"

source "$(KCONFIG_SOC_GS_PREFIX)drivers/performance/lat_governors/Kconfig"

source "$(KCONFIG_SOC_GS_PREFIX)drivers/phy/Kconfig"

source "$(KCONFIG_SOC_GS_PREFIX)drivers/pinctrl/Kconfig"

source "$(KCONFIG_SOC_GS_PREFIX)drivers/power/Kconfig"

source "$(KCONFIG_SOC_GS_PREFIX)drivers/pwm/Kconfig"

source "$(KCONFIG_SOC_GS_PREFIX)drivers/regulator/Kconfig"

source "$(KCONFIG_SOC_GS_PREFIX)drivers/rtc/Kconfig"

source "$(KCONFIG_SOC_GS_PREFIX)drivers/soc/google/Kconfig"

source "$(KCONFIG_SOC_GS_PREFIX)drivers/spi/Kconfig"

source "$(KCONFIG_SOC_GS_PREFIX)drivers/thermal/Kconfig"

source "$(KCONFIG_SOC_GS_PREFIX)drivers/tty/serial/Kconfig"

source "$(KCONFIG_SOC_GS_PREFIX)drivers/ufs/Kconfig"

source "$(KCONFIG_SOC_GS_PREFIX)drivers/usb/Kconfig"

source "$(KCONFIG_SOC_GS_PREFIX)drivers/video/Kconfig"

source "$(KCONFIG_SOC_GS_PREFIX)drivers/video/backlight/Kconfig"

source "$(KCONFIG_SOC_GS_PREFIX)drivers/watchdog/Kconfig"

source "$(KCONFIG_EXT_MODULES_PREFIX)private/google-modules/bms/misc/Kconfig"

source "$(KCONFIG_EXT_MODULES_PREFIX)private/google-modules/display/common/Kconfig"

source "$(KCONFIG_EXT_MODULES_PREFIX)private/google-modules/display/samsung/Kconfig"

source "$(KCONFIG_EXT_MODULES_PREFIX)private/google-modules/display/samsung/panel/Kconfig"

source "$(KCONFIG_EXT_MODULES_PREFIX)private/google-modules/fingerprint/goodix/fps_touch_handler/Kconfig"

source "$(KCONFIG_EXT_MODULES_PREFIX)private/google-modules/power/mitigation/Kconfig"

source "$(KCONFIG_EXT_MODULES_PREFIX)private/google-modules/power/reset/Kconfig"

source "$(KCONFIG_EXT_MODULES_PREFIX)private/google-modules/radio/samsung/s5300/Kconfig"

source "$(KCONFIG_EXT_MODULES_PREFIX)private/google-modules/touch/common/Kconfig"

source "$(KCONFIG_EXT_MODULES_PREFIX)private/google-modules/trusty/drivers/trusty/Kconfig"
```

## google-devices/lynx/Kconfig.ext.lynx
```kconfig
# SPDX-License-Identifier: GPL-2.0-only

source "$(KCONFIG_EXT_MODULES_PREFIX)private/google-modules/radio/samsung/s5300/Kconfig"

source "$(KCONFIG_EXT_MODULES_PREFIX)private/google-modules/touch/common/Kconfig"
```

## google-modules/Kconfig
```kconfig
# SPDX-License-Identifier: GPL-2.0

config GOOGLE_MODULES
	def_bool y
	select DRM_MIPI_DSI
	select GPIOLIB_IRQCHIP
	select REGMAP_IRQ
	select SND_SOC_COMPRESS
	select VIDEOMODE_HELPERS
```
