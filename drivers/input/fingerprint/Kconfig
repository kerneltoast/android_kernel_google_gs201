## drivers/input/fingerprint/Kconfig
```kconfig
config GOODIX_FINGERPRINT
	tristate "generic goodix fingerprint driver"
	default n
	help
	add support for goodix fingerprint driver.
```

## drivers/iommu/Kconfig
```kconfig
# SPDX-License-Identifier: GPL-2.0-only
if IOMMU_SUPPORT

config SAMSUNG_IOMMU
	tristate "Samsung IOMMU Support"
	select ARM_DMA_USE_IOMMU
	select IOMMU_DMA
	select SAMSUNG_IOMMU_GROUP
	help
	  Support for IOMMU on GS SoCs.

config SAMSUNG_IOMMU_V9
	tristate "Samsung IOMMU V9 Support"
	select ARM_DMA_USE_IOMMU
	select IOMMU_DMA
	select SAMSUNG_IOMMU_GROUP
	help
	  Support for IOMMU V9 on Samsung Exynos SoCs.

config SAMSUNG_IOMMU_GROUP
	tristate "Samsung IOMMU Group Support"
	help
	  Support for IOMMU group on GS SoCs.

config SAMSUNG_SECURE_IOVA
	tristate "Samsung Secure IOVA Support"
	help
	  Support secure device virtual address management for GS SoCs.

config EXYNOS_PCIE_IOMMU
	tristate "Enable Exynos PCIe IOMMU"
	depends on PCI_EXYNOS_GS
	help
	  Support for IOMMU feature for Exynos PCIe. Memory shared between the
	  PCIe Root Complex and the Endpoints is susceptible to attacks by
	  malicious firmware loaded into the Endpoints. Enabling this provides
	  secure access of memory shared between PCIe RC and the EPs.

config PCIE_IOMMU_HISTORY_LOG
	bool "Enable Exynos PCIe IOMMU Map/Unmap History"
	depends on EXYNOS_PCIE_IOMMU
	help
	  Support for saving map and unmap history of shared memory between the
	  Root Complex and Endpoints of the Exynos PCIe interface. This history
	  can be used for debugging purposes.

	  Say Y to enable this feature.

config IOVAD_BEST_FIT_ALGO
	tristate "Enable best fit IOVA allocation"
	help
	  Support best fit IOVA allocation for GS SoCs.

endif # IOMMU_SUPPORT
```

## drivers/media/platform/Kconfig
```kconfig
# SPDX-License-Identifier: GPL-2.0-only

if V4L_PLATFORM_DRIVERS

#
# Platform multimedia device configuration
#
source "$(KCONFIG_SOC_GS_PREFIX)drivers/media/platform/exynos/Kconfig"

endif # V4L_PLATFORM_DRIVERS

config VIDEO_EXYNOS_SMFC
	tristate "Exynos Still MFC(H/W JPEG CODEC) Driver"
	depends on VIDEO_DEV && HAS_DMA
	select V4L2_MEM2MEM_DEV
	select VIDEOBUF2_DMA_SG
	default n
	help
	  Still MFC(Multi Format Codec) V4L2 Driver for Exynos SoCs.
	  The driver supports for mem2mem V4L2 device.
```

## drivers/media/platform/bigocean/Kconfig
```kconfig
#
# Big Ocean configuration
#

comment "BigOcean video codec"

config BIGOCEAN
	tristate "BigOcean video codec"
	depends on EXYNOS_BTS
	default n
	select PM
	help
	Driver for BigOcean video codec
```

## drivers/media/platform/exynos/Kconfig
```kconfig
#
# Exynos multimedia device drivers
#
config VIDEO_EXYNOS
        bool "Exynos Multimedia Devices"
        depends on ARCH_EXYNOS
        default y
        help
          This is a representative exynos multimedia device.

source "drivers/media/platform/exynos/mfc/Kconfig"

config MEDIA_EXYNOS
        bool
        depends on VIDEO_EXYNOS
        default y
        help
          Compile mdev to use exynos media device driver.
```

## drivers/media/platform/exynos/mfc/Kconfig
```kconfig
config VIDEO_EXYNOS_MFC
	tristate "Exynos MFC Driver"
	default n
	depends on VIDEO_EXYNOS
	select VIDEOBUF2_CORE
	select VIDEOBUF2_DMA_SG
	---help---
	  MFC driver for V4L2.

config MFC_USES_LLC
	  bool "MFC LLC support"
	  default y
	  depends on VIDEO_EXYNOS_MFC
	  help
	  Uses the LLC of MFC.

config MFC_USE_DMABUF_CONTAINER
	bool "MFC dma-buf container support"
	default n
	depends on VIDEO_EXYNOS_MFC
	---help---
	  Use dma-buf container for MFC.
```

## drivers/misc/bbdpl/Kconfig
```kconfig
config BCM_GPS_SPI_DRIVER
    tristate "BRCM GPS SPI driver"
    depends on SPI
    help
        Support for BRCM GPS SPI driver.
```

## drivers/misc/debug/Kconfig
```kconfig
menuconfig MISC_DEBUG
	bool "Miscellaneous Debug Features"
	default y
	help
	  Provides a number of drivers related to miscellaneous debug features.

config PIXEL_DEBUG_TEST
	tristate "Pixel Debug Test Error Triggers"
	depends on ARM || ARM64
	depends on MISC_DEBUG
	help
	  Say m or y here to add support for commands that can trigger
	  intentional errors.
```

## drivers/misc/s5910/Kconfig
```kconfig
# SPDX-License-Identifier: GPL-2.0
#
#
config S5910
	tristate "S5910 Driver"
	default n
	depends on REGMAP_SPMI
	depends on SPMI_BITBANG
	depends on SPMI
	help
		S5910 Driver
```

## drivers/misc/sbb-mux/Kconfig
```kconfig
# SPDX-License-Identifier: GPL-2.0
#
# Sideband Bit Multiplexer driver for 'trigger' GPIOs.
#

menuconfig SBB_MUX
	tristate "Support for 'trigger' GPIOs"
	default n
	help
	  This option enables support for sideband / 'trigger' GPIOs.
	  If your board does not have GPIOs specifically routed to 'trigger'
	  pins, this driver is not necessary.
```

## drivers/pci/controller/dwc-whi/Kconfig
```kconfig
# SPDX-License-Identifier: GPL-2.0

config PCI_EXYNOS_GS
	tristate "Exynos GS PCIe controller"
	depends on PCI
	depends on OF
	depends on PCI_MSI_IRQ_DOMAIN
	select PCIEPORTBUS
	select PCIE_DW_HOST

config PCI_EXYNOS_CAL_GS201
	tristate "Samsung Exynos PCIe PHY CAL for GS201"
	depends on PCI
	depends on OF
	depends on PCI_MSI_IRQ_DOMAIN
	select PCIE_DW_HOST
	help
	  Enables support for the PCIe controller in the Samsung Exynos SoCs
	  for GS101 to work in host mode. The PCI controller is based on the
	  DesignWare hardware and therefore the driver re-uses the DesignWare
	  core functions to implement the driver.

config PCI_EXYNOS_CAL_GS101
	tristate "Samsung Exynos PCIe PHY CAL for GS101"
	depends on PCI
	depends on OF
	depends on PCI_MSI_IRQ_DOMAIN
	select PCIE_DW_HOST
```

## drivers/pci/controller/dwc/Kconfig
```kconfig
# SPDX-License-Identifier: GPL-2.0

config PCI_EXYNOS_GS
	tristate "Exynos GS PCIe controller"
	depends on PCI
	depends on OF
	depends on PCI_MSI_IRQ_DOMAIN
	select PCIEPORTBUS
	select PCIE_DW_HOST
	help
	  Enables support for the PCIe controller in the Samsung Exynos SoCs
	  for GS101 to work in host mode. The PCI controller is based on the
	  DesignWare hardware and therefore the driver re-uses the DesignWare
	  core functions to implement the driver.

config PCI_EXYNOS_CAL_ZUMA
	tristate "Samsung Exynos PCIe PHY CAL for ZUMA"
	depends on PCI
	depends on OF
	depends on PCI_MSI_IRQ_DOMAIN
	select PCIE_DW_HOST
```

## drivers/performance/lat_governors/Kconfig
```kconfig
# SPDX-License-Identifier: GPL-2.0-only

config GS_MEMLAT_GOVERNOR
	tristate "Google Memory Latency Governors"
	depends on GS_PERF_MON
	default n
	help
	  Latency governors providing votes for the memory subsystem.
	  The governors only compute target frequencies for the DSU, BCI, and DDR
	  then supplies them to the devfreq for processing.

config GS_DSULAT_GOVERNOR
	tristate "Google DSU Latency Governors"
	depends on GS_MEMLAT_GOVERNOR
	default n
	help
	  Config toggle sepecifically for DSU since some platforms
	  dont provide independent DSU frequency scaling. Dependent
	  on tick driven memory latency driver infrastructrue.
```

## drivers/phy/samsung/Kconfig
```kconfig
# SPDX-License-Identifier: GPL-2.0-only
#
# Phy drivers for Samsung platforms
#
config PHY_EXYNOS_USBDRD
	tristate "Exynos SoC series USB DRD PHY driver"
	help
	  Enable USB DRD PHY support for Exynos SoC series.
	  This driver provides PHY interface for USB 3.0 DRD controller
	  present on Exynos SoC series.

config PHY_EXYNOS_EUSB_REPEATER
	tristate "eUSB Repeater driver"
	help
	  Enable eUSB Repeater support.

config PHY_EXYNOS_USBDRD_EUSB
	tristate "Exynos SoC series eUSB DRD PHY driver"
	help
	  Enable eUSB DRD PHY support for Exynos SoC series.
	  This driver provides PHY interface for USB 3.0 DRD controller
	  present on Exynos SoC series.

config PHY_SAMSUNG_USB_GEN2_V4
	bool "Exynos SoC series USB DRD for GEN2 V4"
	default n
	help
	  Support SAMSUNG USB3.1 GEN2 V4 PHY. GEN2 V4 PHY needs
	  a different setting compared to GEN2 V2 PHY.
	  This driver provides PHY interface for USB3.1 GEN2 V4 PHY.

config PHY_EXYNOS_MIPI
	tristate "Samsung EXYNOS SoC MIPI CSI/DSI D/C-PHY driver"
	select GENERIC_PHY
	help
	  Support for MIPI CSI and MIPI DSI DPHY found on Samsung
	  and EXYNOS SoCs.

config PHY_EXYNOS_MIPI_DSIM
	tristate "Samsung EXYNOS SoC MIPI DSI D-PHY driver"
	select GENERIC_PHY
	help
	  Support for MIPI DSI DPHY found on Samsung
	  and EXYNOS SoCs.
```

## drivers/pinctrl/gs/Kconfig
```kconfig
# SPDX-License-Identifier: GPL-2.0
#
# GS Pin control drivers
#

config PINCTRL_EXYNOS_GS
	tristate "Pinctrl driver for GSxxx"
	depends on OF_GPIO
	depends on OF && GPIOLIB
	select PINMUX
	select PINCONF
```

## drivers/pinctrl/samsung/Kconfig
```kconfig
# SPDX-License-Identifier: GPL-2.0
#
# Samsung Pin control drivers
#
config PINCTRL_SAMSUNG
	tristate "Pinctrl driver data for Samsung SoCs"
	depends on OF_GPIO
	select PINMUX
	select PINCONF
	select PINCTRL_EXYNOS

config PINCTRL_EXYNOS
	bool "Pinctrl common driver part for Samsung Exynos SoCs"
	depends on OF_GPIO
	depends on OF && GPIOLIB
	select PINCTRL_EXYNOS_ARM if ARM
	select PINCTRL_EXYNOS_ARM64 if ARM64

config PINCTRL_EXYNOS_ARM
	bool "ARMv7-specific pinctrl driver for Samsung Exynos SoCs" if COMPILE_TEST
	depends on PINCTRL_EXYNOS

config PINCTRL_EXYNOS_ARM64
	bool "ARMv8-specific pinctrl driver for Samsung Exynos SoCs" if COMPILE_TEST
	depends on PINCTRL_EXYNOS

config PINCTRL_GS
	tristate "pinctrl driver data for GSxxx"
	depends on PINCTRL_EXYNOS

config PINCTRL_S3C24XX
	bool "Samsung S3C24XX SoC pinctrl driver"
	depends on OF_GPIO
	depends on ARCH_S3C24XX || COMPILE_TEST

config PINCTRL_S3C64XX
	bool "Samsung S3C64XX SoC pinctrl driver"
	depends on OF_GPIO
	depends on ARCH_S3C64XX || COMPILE_TEST
```

## drivers/power/Kconfig
```kconfig
# SPDX-License-Identifier: GPL-2.0-only
source "$(KCONFIG_SOC_GS_PREFIX)drivers/power/reset/Kconfig"
```

## drivers/power/reset/Kconfig
```kconfig
# SPDX-License-Identifier: GPL-2.0-only
if POWER_RESET

config DEBUG_REBOOT
	tristate "Add support for triggering debug reboot commands"
	help
	  Say y here to add support for reboot commands that triggers
	  intentional watchdog or panics. Note that it is still required
	  to either set Y to the enable module parameter or choose
	  CONFIG_DEBUG_REBOOT_DEFAULT_ON to enable this feature.

config DEBUG_REBOOT_DEFAULT_ON
	bool "Default enable debug reboot commands"
	depends on DEBUG_REBOOT
	help
	  Say y here to default enable reboot commands to trigger
	  intentional watchdogs or panics.

endif
```

## drivers/pwm/Kconfig
```kconfig
# SPDX-License-Identifier: GPL-2.0-only

if PWM

config PWM_EXYNOS
	tristate "Samsung PWM support"
	depends on PLAT_SAMSUNG || ARCH_EXYNOS || SOC_ZUMA || SOC_GS201
	help
	  Generic PWM framework driver for Samsung.
	  To compile this driver as a module, choose M here: the module
	  will be called pwm-samsung.
endif
```
