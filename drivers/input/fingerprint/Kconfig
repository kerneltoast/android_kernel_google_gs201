## drivers/soc/google/Kconfig
```kconfig
# SPDX-License-Identifier: GPL-2.0-only
#
# Google SoC drivers
#

menu "Google SoC drivers"

config SOC_GOOGLE
	bool "Google SoC driver support"

config SOC_GS101
	bool "Google GS101"
	depends on SOC_GOOGLE

config SOC_GS201
	bool "Google GS201"
	depends on SOC_GOOGLE

config BOARD_SLIDER
	bool "Google Slider Board"
	depends on SOC_GS101

config BOARD_CLOUDRIPPER
	bool "Google Cloudripper Board"
	depends on SOC_GS201

config BOARD_EMULATOR
	bool "Google Zuma emulator"
	help
	  Common configuration for both hybrid and full emulator.

config SOC_ZUMA
	bool "Google Zuma"
	depends on SOC_GOOGLE

config SOC_ZUMAPRO
	bool "Google Zuma Pro"
	depends on SOC_GOOGLE
	depends on SOC_ZUMA

config BOARD_RIPCURRENT
	bool "Google Ripcurrent Board"
	depends on SOC_ZUMA

config BOARD_ZUMA_EMULATOR
	bool "Google Zuma on full emulator"
	depends on SOC_ZUMA
	select BOARD_EMULATOR
	help
	Support Zuma on emulator

config BOARD_ZUMA_HYBRID
	bool "Google Zuma on hybrid emulator"
	depends on SOC_ZUMA
	select BOARD_EMULATOR
	help
	Support Zuma on hybrid emulator

config GS_CHIPID
	tristate "GS Chipid controller driver"
	depends on ARM64
	depends on SOC_GOOGLE
	select SOC_BUS
	default y

config EXYNOS_BCM_DBG
	tristate "EXYNOS_BCM_DBG driver support"
	help
	Enable exynos-bcm_dbg driver support

config EXYNOS_BCM_DBG_DUMP
	tristate "EXYNOS_BCM_DBG dump support"
	depends on EXYNOS_BCM_DBG
	default y if EXYNOS_BCM_DBG
	help
	Enable exynos-bcm_dbg dump support

config EXYNOS_BCM_DBG_DUMP_FILE
	bool "EXYNOS_BCM_DBG dump file support"
	depends on EXYNOS_BCM_DBG_DUMP
	default n
	help
	Enable exynos-bcm_dbg dump file support

config EXYNOS_BCM_DBG_PPMU
	bool "EXYNOS_BCM_DBG PPMU support"
	depends on EXYNOS_BCM_DBG
	default n if EXYNOS_BCM_DBG
	help
	Enable exynos-bcm_dbg PPMU perf_event support

config CAL_IF
       tristate "Exynos Chip Abstraction Layer Interface"
       help
       Support PMU/CMU CAL for Exynos SoC.

config CMUCAL
	tristate "Exynos CMU Chip Abstraction Layer"
	default y
	depends on CAL_IF
	help
	Support CMUCAL for Exynos SoC.

config CMUCAL_DEBUG
	tristate "CMUCAL Debug Interface"
	default y
	depends on CMUCAL

config CMUCAL_QCH_IGNORE_SUPPORT
	tristate "CMUCAL QCH IGNORE Support"
	default y
	depends on CMUCAL

config PMUCAL
        bool "Exynos PMU Chip Abstraction Layer"
        depends on CAL_IF
        default y
        help
        Support PMUCAL for Exynos SoC.

config PMUCAL_DBG
        tristate "Exynos PMUCAL debugging interface"
        depends on PMUCAL
        help
        Support PMUCAL debugging for Exynos SoC.

config EXYNOS_PMU_IF
	tristate "Exynos PMU controller Interface driver"
	help
	Support PMU register API for Exynos SoC.

config EXYNOS_PD
	tristate "Exynos PM domain Support"
	depends on CAL_IF && CMUCAL
	depends on PM
	select PM_GENERIC_DOMAINS

config EXYNOS_PD_DBG
	tristate "Exynos PM domain Support"
	depends on CAL_IF && CMUCAL
	depends on PM
	select PM_GENERIC_DOMAINS

config EXYNOS_PD_EL3
	tristate "Exynos PD Save/Restore Support"
	default m
	help
	Support Exynos Power Domain Save/Restore

config EXYNOS_PD_HSI0
	tristate "Exynos PD HSI0 driver"
	depends on EXYNOS_PD
	default m
	help
	Support PD driver to control HSI0 ldos.

config EXYNOS_PM
	tristate "Enable Exynos PM Support"
	help
	Support EXYNOS_PM for Exynos SoC.

config EXYNOS_CPUPM
	tristate "CPU Power Management driver"
	depends on PMUCAL
	help
	Support CPU Power Control for GS SoC.

source "$(KCONFIG_SOC_GS_PREFIX)drivers/soc/google/acpm/Kconfig"

config ACPM_DVFS
	tristate "ACPM DVFS manager"
	depends on CAL_IF && CMUCAL
	help
	Support ACPM DVFS for GS SoC.

config ECT
	tristate "Enable Exynos Characteristic Table File"
	default n
	help
	Support ECT for Exynos SoC.

config EXYNOS_DVFS_MANAGER
	tristate "Exynos DVFS Manager"
	help
	Enable DVFS Manager for Exynos SoC.
	This module controls constraint between each DVFS domains.

config EXYNOS_PM_QOS
	tristate "Exynos PM QOS"
	help
	Support Exynos PM QOS

config EXYNOS_CPUHP
	tristate "CPU Hotplug driver support"
	depends on HOTPLUG_CPU
	default n
	help
	Support CPU Hotplug for Exynos SoC.

config SLC_PARTITION_MANAGER
	tristate "PT API framework"
	default n
	help
	Enable PT framework for managing system level cache.

config GS_SLC_ACPM
	tristate "PT ACPM driver"
	depends on SLC_PARTITION_MANAGER && GS_ACPM
	default n
	help
	Support PT ACPM drvier

config SLC_PMON
	bool "Enable SLC perf counter support"
	depends on GS_SLC_ACPM
	default n
	help
	Enable SLC perf counter support in PT ACPM driver.

config VH_KERNEL
	bool "Vendor kernel modules"
	default y
	help
	Modules for vendor kernel hooks.

config PIXEL_STAT
	tristate "Enable Pixel statistics"
	default n
	help
	Support Pixel statistics.

config EXYNOS_SECURE_LOG
	tristate "Exynos Secure Log"
	default n
	help
	Support Exynos Secure Log

config EXYNOS_CONTENT_PATH_PROTECTION
	tristate "Exynos Content Path Protection"
	default n
	help
	  Enable content path protection of EXYNOS.

config PERF_TRACE_CTRS
	tristate "perf_trace_counters support"
	default n
	help
	Support perf_trace_counters

source "$(KCONFIG_SOC_GS_PREFIX)drivers/soc/google/gsa/Kconfig"

source "$(KCONFIG_SOC_GS_PREFIX)drivers/soc/google/debug/Kconfig"

source "$(KCONFIG_SOC_GS_PREFIX)drivers/soc/google/gnssif_spi/Kconfig"

source "$(KCONFIG_SOC_GS_PREFIX)drivers/soc/google/eh/Kconfig"

source "$(KCONFIG_SOC_GS_PREFIX)drivers/soc/google/gcma/Kconfig"

source "$(KCONFIG_SOC_GS_PREFIX)drivers/soc/google/pa_kill/Kconfig"

source "$(KCONFIG_SOC_GS_PREFIX)drivers/soc/google/smra/Kconfig"

source "$(KCONFIG_SOC_GS_PREFIX)drivers/soc/google/s2mpu/Kconfig"

source "$(KCONFIG_SOC_GS_PREFIX)drivers/soc/google/vh/kernel/Kconfig"

source "$(KCONFIG_SOC_GS_PREFIX)drivers/soc/google/boot_control/Kconfig"

config HARDLOCKUP_DEBUG
	tristate "Hardlockup Debugging"
	depends on ARM64

config HARDLOCKUP_WATCHDOG
	tristate "Hardlockup Watchdog"
	default n
	help
	The module is a driver for detecting individual core lockup.

config DBGCORE_DUMP
	tristate "Debug Core Framework"
	depends on DEBUG_SNAPSHOT && EXYNOS_ADV_TRACER
	default n
	help
	This module supports the Debug Core Framework functionality.

config SYSRQ_HOOK
	tristate "Sysrq hook to overwrite panic message"
	depends on MAGIC_SYSRQ
	default n
	help
	Modules for sysrq hooks.

config PKVM_S2MPU
	tristate "S2MPU driver compatible with pKVM"
	default n
	help
	This module is a driver for the stage-2 IOMMU controlled by hypervisor.

config PKVM_S2MPU_V9
	tristate "S2MPU V9 driver compatible with pKVM"
	default n
	help
	This module is a driver for the stage-2 IOMMU controlled by hypervisor.

config KERNEL_TOP
	tristate "Display processes statistic"
	default n
	help
	  This module exposes kernel function for modules to debugging
	  processes statistic.

config GOOGLE_MODEMCTL
	tristate "Common modem control interfaces"
	default n
	help
	  This module provides common helpers and control interfaces for modems
	  and clients that may want to interact with them.

endmenu
```

## drivers/soc/google/acpm/Kconfig
```kconfig
# SPDX-License-Identifier: GPL-2.0
#
# ACPM driver configuration
#

menuconfig GS_ACPM
	tristate "ACPM driver support"
	default n
	help
	  Enable ACPM support

if GS_ACPM

config ACPM_MFD
	bool "ACPM_MFD support"
	default y
	help
	  Enable ACPM_MFD support

config ACPM_FLEXPMU_DBG
	tristate "ACPM FLEXPMU DBG"
	default n
	help
	  Support FLEXPMU DBG for GS SoC

config ACPM_POWER_STATS
	tristate "GS Power stats collection"
	default n
	help
	  Manages the collection of power stats collected by the ACPM

config ACPM_MBOX_TEST
	tristate "ACPM_MBOX_TEST support"
	default n
	help
	  Enable ACPM_MBOX_TEST support

endif
```

## drivers/soc/google/cpif/Kconfig
```kconfig
# SPDX-License-Identifier: GPL-2.0
menuconfig EXYNOS_MODEM_IF
	tristate "Samsung Mobile CP Interface"
	default n
	help
	  Samsung Dual Modem Interface Driver

if EXYNOS_MODEM_IF

config SEC_MODEM_S5000AP
	tristate "Exynos ModAP S5xxxAP"
	select LINK_DEVICE_SHMEM
	select CP_SECURE_BOOT
	select MCU_IPC
	select SHM_IPC
	select CP_PMUCAL
	select CPIF_PAGE_RECYCLING
	default n

config SEC_MODEM_S5100
	tristate "Exynos S51xx"
	select BOOT_DEVICE_SPI
	select LINK_DEVICE_PCIE
	select CPIF_PAGE_RECYCLING
	default n

menu "Configuration Description"
config MCU_IPC
	tristate "MCU IPC Support"
	default n
	help
	  This enables MCU_IPC driver to control the MCU_IPC Device.
	  MCU_IPC is the Mailbox which has 16 interrupts for TX/RX each
	  and 256 bytes memory for communicating messages.
	  AP and CP can share the messages through this device.

config SHM_IPC
	tristate "Shared Memory for IPC support"
	default n
	help
	  This enables SHM_IPC driver to control the Shared memory
	  for AP-CP Interface.

config BOOT_DEVICE_SPI
	tristate "boot device: SPI"
	default n

config LINK_DEVICE_WITH_SBD_ARCH
	tristate "Link device with the SBD architecture from MIPI-LLI"
	default n

config CP_PKTPROC
	tristate "Support packet processor"
	default n
	help
	Packet processor

config CP_PKTPROC_UL
	tristate "Support packet processor for UL"
	default n
	help
	Packet processor UL

config LINK_DEVICE_SHMEM
	tristate "Real system-level shared-memory on a system bus"
	default n

config LINK_DEVICE_PCIE
	tristate "modem driver link device PCIe"
	default n

config CP_SECURE_BOOT
	tristate "Support CP Secure Boot"
	default n

config GPIO_DS_DETECT
	tristate "Support GPIO DS Detect"
	default n

config CP_UART_NOTI
	tristate "Support CP UART notification API"
	default n

config PMU_UART_SWITCH
	tristate "Support AP <-> CP UART switch by PMU"
	depends on CP_UART_NOTI
	default n

config CP_BTL
	tristate "Support CP BTL(Back Trace Log) feature"
	default n

config HW_REV_DETECT
	tristate "Support HW REV Detect"
	default n

config MODEM_IF_QOS
	tristate "Implement QoS"
	default n
	help
	  This enables QoS

config MODEM_IF_LEGACY_QOS
	tristate "Implement QoS for legacy buffer"
	select MODEM_IF_QOS
	default n
	help
	  This enables QoS for legacy buffer model

config SUSPEND_DURING_VOICE_CALL
	bool "control wake_lock by voice call start/end notification"
	depends on LINK_DEVICE_PCIE
	default n
	help
	  This enables AP suspend during PCM over PCIE

config CPIF_TP_MONITOR
	tristate "Support CP network throughput monitor"
	default n
	help
	  This enables CP network throughput monitor

config LINK_DEVICE_PCIE_IOCC
	bool "Use PCIE IOCC"
	depends on LINK_DEVICE_PCIE
	default n
	help
	  This enables PCIe IOCC

config LINK_DEVICE_PCIE_IOMMU
	bool "Use PCIE IOMMU"
	depends on LINK_DEVICE_PCIE && EXYNOS_PCIE_IOMMU
	default n
	help
	  This enables PCIe IOMMU

config CPIF_CHECK_SJTAG_STATUS
	tristate "Check secure JTAG status to disable CP memory dump"
	default n
	help
	  Check secure JTAG status to disable CP memory dump

config CP_LCD_NOTIFIER
	tristate "Enable LCD notifier for CP"
	default n
	help
	  This enables LCD notifier for CP

config LINK_DEVICE_PCIE_GPIO_WA
	bool "Workaround for discarded GPIOs"
	depends on LINK_DEVICE_PCIE
	default n
	help
	  Use a GPIO for the other purpose instead

config CP_WRESET_WA
	bool "CP warm reset WA due to WRSTBI disabled"
	depends on LINK_DEVICE_PCIE
	default n
	help
	  CP warm reset WA

config EXYNOS_DIT
	tristate "Enable DIT"
	default n
	help
	  Enable DIT (Direct Internet Packet Transfer)

config EXYNOS_DIT_VERSION
	hex "DIT version"
	depends on EXYNOS_DIT
	default 0x02010000
	help
	  DIT version

config CPIF_DIRECT_DM
	tristate "Enable direct dm path"
	default n
	help
	  This enables direct dm path

config CH_EXTENSION
	tristate "Enable Channel Extension"
	default n
	help
	  Enable Channel Extension

config CPIF_VENDOR_HOOK
	tristate "Enable Android vendor hook"
	default n
	help
	  This enables Android vendor hook

config CPIF_PAGE_RECYCLING
	tristate "Enable page recycling"
	default n
	help
	  This enables page recycling to improve alloc overhead

config CP_PKTPROC_CLAT
	tristate "Enable HW PKTPROC CLAT"
	default n
	help
	  Enable HW pktproc clat

config CP_PKTPROC_LRO
	tristate "Enable HW PKTPROC LRO"
	default n
	help
	  Enable HW pktproc LRO

config CP_THERMAL
    tristate "Enable CP thermal zones"
    depends on THERMAL
    help
      Enables support for reporting CP temperature sensor data to kernel thermal
      framework.

endmenu
endif
```
