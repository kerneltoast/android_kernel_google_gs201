// SPDX-License-Identifier: GPL-2.0-only
/*
 * Battery device tree entries
 *
 * Copyright 2020 Google LLC
 *
 */

maxim,config {

	/* R4_p1_gen.ini, 2021-01-21, b/174787673, generic model */
	maxim,default-a1-0k {
		maxim,batt-id-kohm = <0>;
		maxim,model-version = <0>;
		maxim,fg-model = /bits/ 16 <
			0x9760 0xa510 0xb100 0xb600 0xb7a0 0xb900 0xba70 0xbc70
			0xbde0 0xbfc0 0xc250 0xc510 0xc990 0xcea0 0xd040 0xd750
			0x0060 0x0120 0x0200 0x0710 0x0e80 0x0df0 0x1430 0x1bd0
			0x1520 0x0d70 0x0950 0x08e0 0x0800 0x0780 0x06b0 0x01e0
			0x0100 0x0100 0x0100 0x0100 0x0100 0x0100 0x0100 0x0100
			0x0100 0x0100 0x0100 0x0100 0x0100 0x0100 0x0100 0x0100
		>;
		maxim,fg-params = /bits/ 16 <
			/* 0x0036 */	0xf060	/* IAvgEmpty */
			/* 0x002a */	0x2038	/* RelaxCFG */
			/* 0x0028 */	0x260E	/* LearnCFG */
			/* 0x001D */	0x4217	/* Config */
			/* 0x00BB */	0x0090	/* Config2 */
			/* 0x0013 */	0x5F00	/* FullSOCthr */
			/* 0x0035 */	0x0994	/* FullCAPRep */
			/* 0x0018 */	0x0994	/* DesignCap */
			/* 0x0046 */	0x0c80	/* dPacc */
			/* 0x0045 */	0x0099	/* dQacc */
			/* 0x0023 */	0x0994	/* FullCAPNom */
			/* 0x003A */	0xA561	/* V_empty */
			/* 0x0012 */	0x1100	/* QResidual00 */
			/* 0x0022 */	0x0800	/* QResidual10 */
			/* 0x0032 */	0x0301	/* QResidual20 */
			/* 0x0042 */	0x0302	/* QResidual30 */
			/* 0x0038 */	0x0700	/* RCOMP0 */
			/* 0x0039 */	0x223E	/* TempCo */
			/* 0x001E */	0x0310	/* ICHGTerm */
			/* 0x002C */	0xED51	/* TGain */
			/* 0x002D */	0x1EBA	/* TOff */
			/* 0x00B9 */	0x0014	/* Curve */
			/* 0x002B */	0x3870	/* MiscCFG */
			/* 0x0004 */	0x0000	/* AtRate */
			/* 0x0049 */	0x2241	/* convgcfg */
			/* 0x0029 */	0xc623	/* FilterCFG */
			/* 0x003c */	0x2D00	/* TaskPeriod */
		>;
		maxim,fg-aafv = /bits/ 32 <
			200     0   95  0xff
			400    20   90  0xff
			600    40   85  0xff
			800    60   80  0xff
			1000   80   75  0xff
			2000  100   70  0xff
		>;
	};

	/* ATL: 3138_1_102621_BC59_RC2_send.043.model_ATL, 2021-11-18, b/204198596 */
	maxim,cos-a1-1k {
		maxim,batt-id-kohm = <1>;
		maxim,model-version = <1>;
		maxim,force-reset-model-data;
		maxim,fg-model = /bits/ 16 <
			0xa4e0 0xb750 0xb8a0 0xba60 0xbc10 0xbdd0 0xbf30 0xc070
			0xc1e0 0xc4b0 0xc7f0 0xcd80 0xd130 0xd4e0 0xd920 0xdca0
			0x0120 0x1240 0x0c00 0x12a0 0x1400 0x1700 0x1060 0x0fd0
			0x07e0 0x07f0 0x07c0 0x06d0 0x06c0 0x06f0 0x0640 0x0640
			0x0200 0x0200 0x0200 0x0200 0x0200 0x0200 0x0200 0x0200
			0x0200 0x0200 0x0200 0x0200 0x0200 0x0200 0x0200 0x0200
		>;
		maxim,fg-params = /bits/ 16 <
			/* 0x0036 */	0xf060	/* IAvgEmpty */
			/* 0x002a */	0x0839	/* RelaxCFG */
			/* 0x0028 */	0x260e	/* LearnCFG */
			/* 0x001D */	0x4217	/* Config */
			/* 0x00BB */	0x0090	/* Config2 */
			/* 0x0013 */	0x5f00	/* FullSOCthr */
			/* 0x0035 */	0x09C5	/* FullCAPRep */
			/* 0x0018 */	0x09C5	/* DesignCap */
			/* 0x0046 */	0x3200	/* dPacc */
			/* 0x0045 */	0x0271	/* dQacc */
			/* 0x0023 */	0x09C5	/* FullCAPNom */
			/* 0x003A */	0xA561	/* V_empty */
			/* 0x0012 */	0x2080	/* QResidual00 */
			/* 0x0022 */	0x0e80	/* QResidual10 */
			/* 0x0032 */	0x0580	/* QResidual20 */
			/* 0x0042 */	0x0480	/* QResidual30 */
			/* 0x0038 */	0x0770	/* RCOMP0 */
			/* 0x0039 */	0x2202	/* TempCo */
			/* 0x001E */	0x0628	/* ICHGTerm */
			/* 0x002C */	0xED51	/* TGain */
			/* 0x002D */	0x1EBA	/* TOff */
			/* 0x00B9 */	0x0014	/* Curve */
			/* 0x002B */	0x3870	/* MiscCFG */
			/* 0x0004 */	0x1900	/* AtRate */
			/* 0x0049 */	0x2241	/* convgcfg */
			/* 0x0029 */	0x0623	/* FilterCFG */
			/* 0x003c */	0x2D00	/* TaskPeriod */
		>;
		maxim,fg-aafv = /bits/ 32 <
			200     0   95  0xff
			400    20   90  0xff
			600    40   85  0xff
			800    60   80  0xff
			1000   80   75  0xff
			2000  100   70  0xff
		>;
	};

	/* LSN: 3139_1_102621_BC59_RC2_send.044.model_LSN, 2021-11-18, b/204198596 */
	maxim,lsn-a1-3k {
		maxim,batt-id-kohm = <3>;
		maxim,model-version = <1>;
		maxim,force-reset-model-data;
		maxim,fg-model = /bits/ 16 <
			0xa510 0xb740 0xb830 0xb930 0xbaf0 0xbc20 0xbd10 0xbe50
			0xbfa0 0xc240 0xc430 0xc6f0 0xcb30 0xd0d0 0xd690 0xdc30
			0x0130 0x1100 0x0f10 0x0d00 0x1400 0x1970 0x15e0 0x1600
			0x0dd0 0x07a0 0x07d0 0x07f0 0x06d0 0x06b0 0x06a0 0x06a0
			0x0200 0x0200 0x0200 0x0200 0x0200 0x0200 0x0200 0x0200
			0x0200 0x0200 0x0200 0x0200 0x0200 0x0200 0x0200 0x0200
		>;
		maxim,fg-params = /bits/ 16 <
			/* 0x0036 */	0xf060	/* IAvgEmpty */
			/* 0x002a */	0x0839	/* RelaxCFG */
			/* 0x0028 */	0x260e	/* LearnCFG */
			/* 0x001D */	0x4217	/* Config */
			/* 0x00BB */	0x0090	/* Config2 */
			/* 0x0013 */	0x5f00	/* FullSOCthr */
			/* 0x0035 */	0x09C5	/* FullCAPRep */
			/* 0x0018 */	0x09C5	/* DesignCap */
			/* 0x0046 */	0x3200	/* dPacc */
			/* 0x0045 */	0x0271	/* dQacc */
			/* 0x0023 */	0x09C5	/* FullCAPNom */
			/* 0x003A */	0xA561	/* V_empty */
			/* 0x0012 */	0x1e00	/* QResidual00 */
			/* 0x0022 */	0x0f00	/* QResidual10 */
			/* 0x0032 */	0x0780	/* QResidual20 */
			/* 0x0042 */	0x0580	/* QResidual30 */
			/* 0x0038 */	0x0740	/* RCOMP0 */
			/* 0x0039 */	0x0f02	/* TempCo */
			/* 0x001E */	0x0628	/* ICHGTerm */
			/* 0x002C */	0xED51	/* TGain */
			/* 0x002D */	0x1EBA	/* TOff */
			/* 0x00B9 */	0x0014	/* Curve */
			/* 0x002B */	0x3870	/* MiscCFG */
			/* 0x0004 */	0x1900	/* AtRate */
			/* 0x0049 */	0x2241	/* convgcfg */
			/* 0x0029 */	0x0623	/* FilterCFG */
			/* 0x003c */	0x2D00	/* TaskPeriod */
		>;
		maxim,fg-aafv = /bits/ 32 <
			200     0   95  0xff
			400    20   90  0xff
			600    40   85  0xff
			800    60   80  0xff
			1000   80   75  0xff
			2000  100   70  0xff
		>;
	};
};
