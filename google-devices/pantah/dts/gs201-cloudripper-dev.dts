// SPDX-License-Identifier: GPL-2.0-only
/*
 * Cloudripper DEV device tree source
 *
 * Copyright 2020 Google,LLC
 */

/dts-v1/;
/plugin/;

#include "gs201-cloudripper-common.dtsi"

#include "gs201-cloudripper-audio.dtsi"
#include "gs201-cloudripper-pmic.dtsi"
#include "gs201-cloudripper-touch.dtsi"
#include "gs201-cloudripper-display.dtsi"
#include "gs201/gs201-max20339-ovp.dtsi"
#include "gs201-cloudripper-thermal.dtsi"
#include "gs201-cloudripper-wcharger.dtsi"
#include "gs201-cloudripper-usecases.dtsi"

/ {
	board_id = <0x30101>;
	board_rev = <0x000000>;
	fragment@boardbase {
		target-path="/";
		__overlay__ {
			model = "GS201 Cloudripper DEV based on GS201";
			compatible = "google,GS201 CLOUDRIPPER", "google,GS201";
		};
	};
};

&serial_0 {
	status = "okay";
};

