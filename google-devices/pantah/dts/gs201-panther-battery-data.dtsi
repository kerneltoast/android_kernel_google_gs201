// SPDX-License-Identifier: GPL-2.0-only
/*
 * Battery device tree entries
 *
 * Copyright 2021 Google LLC
 *
 */

maxim,config {

	/* R4_p1_gen.ini, 2021-01-21, b/174787673, generic model */
	maxim,default-a1-0k {
		maxim,batt-id-kohm = <0>;
		maxim,model-version = <0>;
		maxim,fg-model = /bits/ 16 <
			0x9760 0xa510 0xb100 0xb600 0xb7a0 0xb900 0xba70 0xbc70
			0xbde0 0xbfc0 0xc250 0xc510 0xc990 0xcea0 0xd040 0xd750
			0x0060 0x0120 0x0200 0x0710 0x0e80 0x0df0 0x1430 0x1bd0
			0x1520 0x0d70 0x0950 0x08e0 0x0800 0x0780 0x06b0 0x01e0
			0x0100 0x0100 0x0100 0x0100 0x0100 0x0100 0x0100 0x0100
			0x0100 0x0100 0x0100 0x0100 0x0100 0x0100 0x0100 0x0100
		>;
		maxim,fg-params = /bits/ 16 <
			/* 0x0036 */	0xf060	/* IAvgEmpty */
			/* 0x002a */	0x2038	/* RelaxCFG */
			/* 0x0028 */	0x260E	/* LearnCFG */
			/* 0x001D */	0x4217	/* Config */
			/* 0x00BB */	0x0090	/* Config2 */
			/* 0x0013 */	0x5F00	/* FullSOCthr */
			/* 0x0035 */	0x0994	/* FullCAPRep */
			/* 0x0018 */	0x0994	/* DesignCap */
			/* 0x0046 */	0x0c80	/* dPacc */
			/* 0x0045 */	0x0099	/* dQacc */
			/* 0x0023 */	0x0994	/* FullCAPNom */
			/* 0x003A */	0xA561	/* V_empty */
			/* 0x0012 */	0x1100	/* QResidual00 */
			/* 0x0022 */	0x0800	/* QResidual10 */
			/* 0x0032 */	0x0301	/* QResidual20 */
			/* 0x0042 */	0x0302	/* QResidual30 */
			/* 0x0038 */	0x0700	/* RCOMP0 */
			/* 0x0039 */	0x223E	/* TempCo */
			/* 0x001E */	0x0310	/* ICHGTerm */
			/* 0x002C */	0xED51	/* TGain */
			/* 0x002D */	0x1EBA	/* TOff */
			/* 0x00B9 */	0x0014	/* Curve */
			/* 0x002B */	0x3870	/* MiscCFG */
			/* 0x0004 */	0x0000	/* AtRate */
			/* 0x0049 */	0x2241	/* convgcfg */
			/* 0x0029 */	0xc623	/* FilterCFG */
			/* 0x003c */	0x2D00	/* TaskPeriod */
		>;
		maxim,fg-aafv = /bits/ 32 <
			200     0   95  0xff
			400    20   90  0xff
			600    40   85  0xff
			800    60   80  0xff
			1000   80   75  0xff
			2000  100   70  0xff
		>;
	};

	/* ATL: 1_ATL_3197_021422_BC59_RC2_0217.txt, 2022-03-04, b/222603623#comment1 */
	maxim,cos-a1-1k {
		maxim,batt-id-kohm = <1>;
		maxim,model-version = <2>;
		maxim,force-reset-model-data;
		maxim,fg-model = /bits/ 16 <
			0x8c80 0xb770 0xb8f0 0xba50 0xbb40 0xbc30 0xbe00 0xbfd0
			0xc1b0 0xc3a0 0xc6b0 0xc9c0 0xd020 0xd300 0xd5e0 0xdc30
			0x0080 0x1070 0x1020 0x0ed0 0x0f00 0x1700 0x1530 0x0c20
			0x0c40 0x07f0 0x07f0 0x06f0 0x0710 0x06d0 0x06f0 0x06f0
			0x0200 0x0200 0x0200 0x0200 0x0200 0x0200 0x0200 0x0200
			0x0200 0x0200 0x0200 0x0200 0x0200 0x0200 0x0200 0x0200
		>;
		maxim,fg-params = /bits/ 16 <
			/* 0x0036 */	0xf060	/* IAvgEmpty */
			/* 0x002a */	0x0839	/* RelaxCFG */
			/* 0x0028 */	0x260e	/* LearnCFG */
			/* 0x001D */	0x4217	/* Config */
			/* 0x00BB */	0x0090	/* Config2 */
			/* 0x0013 */	0x5f00	/* FullSOCthr */
			/* 0x0035 */	0x0873	/* FullCAPRep */
			/* 0x0018 */	0x0873	/* DesignCap */
			/* 0x0046 */	0x3200	/* dPacc */
			/* 0x0045 */	0x021c	/* dQacc */
			/* 0x0023 */	0x0873	/* FullCAPNom */
			/* 0x003A */	0xa561	/* V_empty */
			/* 0x0012 */	0x1f00	/* QResidual00 */
			/* 0x0022 */	0x0d80	/* QResidual10 */
			/* 0x0032 */	0x0480	/* QResidual20 */
			/* 0x0042 */	0x0400	/* QResidual30 */
			/* 0x0038 */	0x0740	/* RCOMP0 */
			/* 0x0039 */	0x1a02	/* TempCo */
			/* 0x001E */	0x0557	/* ICHGTerm */
			/* 0x002C */	0xED51	/* TGain */
			/* 0x002D */	0x1EBA	/* TOff */
			/* 0x00B9 */	0x0014	/* Curve */
			/* 0x002B */	0x3870	/* MiscCFG */
			/* 0x0004 */	0x1900	/* AtRate */
			/* 0x0049 */	0x2241	/* convgcfg */
			/* 0x0029 */	0xc613	/* FilterCFG */
			/* 0x003c */	0x2D00	/* TaskPeriod */
		>;
		maxim,fg-aafv = /bits/ 32 <
			200     0   95  0xff
			400    20   90  0xff
			600    40   85  0xff
			800    60   80  0xff
			1000   80   75  0xff
			2000  100   70  0xff
		>;
	};

	/* LSN: 3_LSN_3198_021422_BC59_RC2_0217.txt, 2022-03-04, b/222603623#comment1 */
	maxim,lsn-a1-3k {
		maxim,batt-id-kohm = <3>;
		maxim,model-version = <2>;
		maxim,force-reset-model-data;
		maxim,fg-model = /bits/ 16 <
			0xa4f0 0xb750 0xb8b0 0xba50 0xbbe0 0xbd60 0xbe70 0xbf80
			0xc170 0xc320 0xc960 0xced0 0xd210 0xd580 0xd8a0 0xdc60
			0x0160 0x0f30 0x0e00 0x1210 0x1500 0x1800 0x1520 0x0da0
			0x0be0 0x07f0 0x06c0 0x06f0 0x06e0 0x06f0 0x05f0 0x05f0
			0x0200 0x0200 0x0200 0x0200 0x0200 0x0200 0x0200 0x0200
			0x0200 0x0200 0x0200 0x0200 0x0200 0x0200 0x0200 0x0200
		>;
		maxim,fg-params = /bits/ 16 <
			/* 0x0036 */	0xf060	/* IAvgEmpty */
			/* 0x002a */	0x0839	/* RelaxCFG */
			/* 0x0028 */	0x260e	/* LearnCFG */
			/* 0x001D */	0x4217	/* Config */
			/* 0x00BB */	0x0090	/* Config2 */
			/* 0x0013 */	0x5f00	/* FullSOCthr */
			/* 0x0035 */	0x0891	/* FullCAPRep */
			/* 0x0018 */	0x0891	/* DesignCap */
			/* 0x0046 */	0x3200	/* dPacc */
			/* 0x0045 */	0x0224	/* dQacc */
			/* 0x0023 */	0x0891	/* FullCAPNom */
			/* 0x003A */	0xa561	/* V_empty */
			/* 0x0012 */	0x2500	/* QResidual00 */
			/* 0x0022 */	0x1180	/* QResidual10 */
			/* 0x0032 */	0x0780	/* QResidual20 */
			/* 0x0042 */	0x0580	/* QResidual30 */
			/* 0x0038 */	0x0740	/* RCOMP0 */
			/* 0x0039 */	0x1802	/* TempCo */
			/* 0x001E */	0x0557	/* ICHGTerm */
			/* 0x002C */	0xED51	/* TGain */
			/* 0x002D */	0x1EBA	/* TOff */
			/* 0x00B9 */	0x0014	/* Curve */
			/* 0x002B */	0x3870	/* MiscCFG */
			/* 0x0004 */	0x1900	/* AtRate */
			/* 0x0049 */	0x2241	/* convgcfg */
			/* 0x0029 */	0xc613	/* FilterCFG */
			/* 0x003c */	0x2D00	/* TaskPeriod */
		>;
		maxim,fg-aafv = /bits/ 32 <
			200     0   95  0xff
			400    20   90  0xff
			600    40   85  0xff
			800    60   80  0xff
			1000   80   75  0xff
			2000  100   70  0xff
		>;
	};
};
