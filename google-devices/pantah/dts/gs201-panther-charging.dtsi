// SPDX-License-Identifier: GPL-2.0-only
/*
 * Battery device tree entries specific to panther
 *
 * Copyright 2021 Google,LLC
 *
 */


&pca9468_dc {
	pca9468,input-current-limit = <2200000>;	/* 4.4A max */
	pca9468,spread-spectrum;
};

&google_charger {
	google,thermal-mitigation = <4300000 3680000 2300000 1000000>;
	google,wlc-fcc-thermal-mitigation = <4300000 4300000 2300000 1150000 1000000>;
	google,thermal-stats-lvl-map = <0 8 16 25>;
};

&google_cpm {
	/* google,mdis_in =  &max77759tcpc, "wireless" */
	/* google,mdis_out = "main-charger", "pca94xx-mains"; */

	// thermal budgets
	google,mdis-thermal-mitigation =
	<3500000 3352000 3208000 3068000 2932000 2800000 2672000 2548000 2428000
	 2312000 2200000 2092000 1988000 1888000 1792000 1700000 1612000 1528000
	 1448000 1372000 1300000 1232000 1168000 1108000 1052000 1000000>;

	// source ONLINE selection criteria
	google,mdis-out-sel-online = <1 2>;
	// PD+main-charger, WLC+main-charger
	google,mdis-out0-limits =
	<4000000 3860000 3720000 3580000 3440000 3300000 3160000 3020000 2880000
	 2740000 2600000 2460000 2320000 2180000 2040000 1900000 1760000 1620000
	 1480000 1340000 1200000 1060000 920000  780000  640000  500000
	 1100000 1072000 1044000 1016000 988000  960000  932000  904000  876000 848000
	 820000  792000  764000  736000  708000  680000  652000  624000  596000 568000
	 540000  512000  484000  456000  428000  400000>;

	// PPS_CP+pca94xx-mains, // WLC_CP+pca94xx-mains
	google,mdis-out1-limits =
	<4500000 4360000 4220000 4080000 3940000 3800000 3660000 3520000 3380000
	 3240000 3100000 2960000 2820000 2680000 2540000 2400000 2260000 2120000
	 1980000 1840000 1700000 1560000 1420000 1280000 1140000 1000000
	 4600000 4420000 4240000 4060000 3880000 3700000 3520000 3340000 3160000
	 2980000 2800000 2620000 2440000 2260000 2080000 1900000 1720000 1540000
	 1360000 1180000 1000000 900000  800000  700000  600000  500000>;
};
