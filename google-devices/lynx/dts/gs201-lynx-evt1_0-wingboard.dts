// SPDX-License-Identifier: GPL-2.0-only
/*
 * Lynx device tree source
 *
 * Copyright 2022 Google,LLC
 */

/dts-v1/;
/plugin/;

#include "gs201-lynx-common.dtsi"
#include "gs201-lynx-touch.dtsi"

/ {
	board_id = <0x30503>;
	board_rev = <0x10001>;
	fragment@boardbase {
		target-path="/";
		__overlay__ {
			model = "GS201 LYNX EVT 1.0 Wingboard based on GS201";
			compatible = "google,GS201 LYNX", "google,GS201";
		};
	};
};

&serial_0 {
	status = "okay";
};
