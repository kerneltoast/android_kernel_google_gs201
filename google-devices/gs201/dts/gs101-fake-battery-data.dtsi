// SPDX-License-Identifier: GPL-2.0-only
/*
 * Battery device tree entries
 *
 * Copyright 2020 Google LLC
 *
 */

maxim,config {
	/* for fake battery: 0xAA */
	maxim,default-fake-batt {
		maxim,batt-id-kohm = <170>;
		maxim,model-version = <2>;
		maxim,force-reset-model-data;
		maxim,fg-model = /bits/ 16 <
			0x9760 0xa510 0xb100 0xb600 0xb7a0 0xb900 0xba70 0xbc70
			0xbde0 0xbfc0 0xc250 0xc510 0xc990 0xcea0 0xd040 0xd750
			0x0060 0x0120 0x0200 0x0710 0x0e80 0x0df0 0x1430 0x1bd0
			0x1520 0x0d70 0x0950 0x08e0 0x0800 0x0780 0x06b0 0x01e0
			0x0100 0x0100 0x0100 0x0100 0x0100 0x0100 0x0100 0x0100
			0x0100 0x0100 0x0100 0x0100 0x0100 0x0100 0x0100 0x0100
		>;
		maxim,fg-params = /bits/ 16 <
			/* 0x0036 */	0xf060	/* IAvgEmpty */
			/* 0x002a */	0x2038	/* RelaxCFG */
			/* 0x0028 */	0x260E	/* LearnCFG */
			/* 0x001D */	0x4217	/* Config */
			/* 0x00BB */	0x0090	/* Config2 */
			/* 0x0013 */	0x5F00	/* FullSOCthr */
			/* 0x0035 */	0x08D6	/* FullCAPRep */
			/* 0x0018 */	0x08D6	/* DesignCap */
			/* 0x0046 */	0x0c80	/* dPacc */
			/* 0x0045 */	0x008D	/* dQacc */
			/* 0x0023 */	0x08D6	/* FullCAPNom */
			/* 0x003A */	0xA561	/* V_empty */
			/* 0x0012 */	0x1100	/* QResidual00 */
			/* 0x0022 */	0x0800	/* QResidual10 */
			/* 0x0032 */	0x0301	/* QResidual20 */
			/* 0x0042 */	0x0302	/* QResidual30 */
			/* 0x0038 */	0x0700	/* RCOMP0 */
			/* 0x0039 */	0x223E	/* TempCo */
			/* 0x001E */	0x02d3	/* ICHGTerm */
			/* 0x002C */	0xED51	/* TGain */
			/* 0x002D */	0x1EBA	/* TOff */
			/* 0x00B9 */	0x0014	/* Curve */
			/* 0x002B */	0x3870	/* MiscCFG */
			/* 0x0004 */	0x0000	/* AtRate */
			/* 0x0049 */	0x2241	/* convgcfg */
			/* 0x0029 */	0xc623	/* FilterCFG */
			/* 0x003c */	0x2D00	/* TaskPeriod */
		>;
	};
};
