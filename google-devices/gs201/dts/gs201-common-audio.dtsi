// SPDX-License-Identifier: GPL-2.0-only
/*
 * Google GS201 common audio device tree source
 *
 * Copyright (c) 2021 Google, LLC
 *		https://www.google.com
 *
*/

#include "gs201-cs40l26a-config.dtsi"
