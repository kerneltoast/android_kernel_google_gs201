// SPDX-License-Identifier: GPL-2.0-only
/*
 * GS201 PPMU device tree source
 *
 * Copyright (c) 2021  Google LLC.
 *
 */

#include <dt-bindings/soc/google/exynos-bcm_dbg.h>

/ {
	gs201-ppmu {
		compatible = "samsung,exynos-bcm_dbg";

		pd-name = "pd-csis", "pd-ipp", "pd-tnr", "pd-bo", "pd-g2d",
			  "pd-misc", "pd-dpu", "pd-pdp", "pd-g3aa", "pd-dns",
			  "pd-mcsc", "pd-gdc", "pd-mfc", "pd-hsi2", "pd-eh",
			  "pd-tpu", "pd-gsa", "pd-aoc", "pd-hsi0", "pd-hsi1",
			  "pd-aur", "pd-itp";

		max_define_event = <PRE_DEFINE_EVT_MAX>;
		/* define_event_index ev0 ev1 ev2 ev3 ev4 ev5 ev6 ev7 */
		define_events = <NO_PRE_DEFINE_EVT	0x0  0x0  0x0  0x0  0x0  0x0  0x0  0x0>,
				<LATENCY_FMT_EVT	0x4  0x2  0x26 0x24 0x5  0x3  0x27 0x25>,
				<MO_FMT_EVT		0x4  0x0  0x24 0x24 0x5  0x1  0x25 0x25>,
				<BURST_LENGTH_FMT_EVT	0x4  0x2  0x4  0x26 0x5  0x3  0x5  0x27>,
				<REQ_BLOCK_FMT_EVT	0x2  0x10 0x10 0x26 0x3  0x11 0x11 0x27>,
				<DATA_BLOCK_FMT_EVT	0x4  0x12 0x12 0x6  0x5  0x13 0x13 0x14>,
				<REQ_TYPE_FMT_EVT	0x2  0x15 0x18 0x1B 0x3  0x16 0x19 0x1C>;
		default_define_event = <LATENCY_FMT_EVT>;

		/* sm_id_mask sm_id_value */
		define_filter_id = <NO_PRE_DEFINE_EVT	0x0  0x0>,
				<LATENCY_FMT_EVT	0x0  0x0>,
				<MO_FMT_EVT		0x0  0x0>,
				<BURST_LENGTH_FMT_EVT	0x0  0x0>,
				<REQ_BLOCK_FMT_EVT	0x0  0x0>,
				<DATA_BLOCK_FMT_EVT	0x0  0x0>,
				<REQ_TYPE_FMT_EVT	0x0  0x0>;
		/* ev0 ev1 ev2 ev3 ev4 ev5 ev6 ev7 */
		define_filter_id_active =
				<NO_PRE_DEFINE_EVT	0x0  0x0  0x0  0x0  0x0  0x0  0x0  0x0>,
				<LATENCY_FMT_EVT	0x0  0x0  0x0  0x0  0x0  0x0  0x0  0x0>,
				<MO_FMT_EVT		0x0  0x0  0x0  0x0  0x0  0x0  0x0  0x0>,
				<BURST_LENGTH_FMT_EVT	0x0  0x0  0x0  0x0  0x0  0x0  0x0  0x0>,
				<REQ_BLOCK_FMT_EVT	0x0  0x0  0x0  0x0  0x0  0x0  0x0  0x0>,
				<DATA_BLOCK_FMT_EVT	0x0  0x0  0x0  0x0  0x0  0x0  0x0  0x0>,
				<REQ_TYPE_FMT_EVT	0x0  0x0  0x0  0x0  0x0  0x0  0x0  0x0>;
		/* sm_other_type0 sm_other_mask0 sm_other_value0 */
		define_filter_other_0 = <NO_PRE_DEFINE_EVT	0x0  0x0  0x0>,
					<LATENCY_FMT_EVT	0x0  0x0  0x0>,
					<MO_FMT_EVT		0x0  0x0  0x0>,
					<BURST_LENGTH_FMT_EVT	0x0  0x0  0x0>,
					<REQ_BLOCK_FMT_EVT	0x0  0x0  0x0>,
					<DATA_BLOCK_FMT_EVT	0x0  0x0  0x0>,
					<REQ_TYPE_FMT_EVT	0x0  0x0  0x0>;
		/* sm_other_type1 sm_other_mask1 sm_other_value1 */
		define_filter_other_1 = <NO_PRE_DEFINE_EVT	0x0  0x0  0x0>,
					<LATENCY_FMT_EVT	0x0  0x0  0x0>,
					<MO_FMT_EVT		0x0  0x0  0x0>,
					<BURST_LENGTH_FMT_EVT	0x0  0x0  0x0>,
					<REQ_BLOCK_FMT_EVT	0x0  0x0  0x0>,
					<DATA_BLOCK_FMT_EVT	0x0  0x0  0x0>,
					<REQ_TYPE_FMT_EVT	0x0  0x0  0x0>;
		/* ev0 ev1 ev2 ev3 ev4 ev5 ev6 ev7 */
		define_filter_other_active =
				<NO_PRE_DEFINE_EVT	0x0  0x0  0x0  0x0  0x0  0x0  0x0  0x0>,
				<LATENCY_FMT_EVT	0x0  0x0  0x0  0x0  0x0  0x0  0x0  0x0>,
				<MO_FMT_EVT		0x0  0x0  0x0  0x0  0x0  0x0  0x0  0x0>,
				<BURST_LENGTH_FMT_EVT	0x0  0x0  0x0  0x0  0x0  0x0  0x0  0x0>,
				<REQ_BLOCK_FMT_EVT	0x0  0x0  0x0  0x0  0x0  0x0  0x0  0x0>,
				<DATA_BLOCK_FMT_EVT	0x0  0x0  0x0  0x0  0x0  0x0  0x0  0x0>,
				<REQ_TYPE_FMT_EVT	0x0  0x0  0x0  0x0  0x0  0x0  0x0  0x0>;

		/* peak_mask peak_id */
		define_sample_id = <NO_PRE_DEFINE_EVT	0x0  0x0>,
				<LATENCY_FMT_EVT	0x0  0x0>,
				<MO_FMT_EVT		0x0  0x0>,
				<BURST_LENGTH_FMT_EVT	0x0  0x0>,
				<REQ_BLOCK_FMT_EVT	0x0  0x0>,
				<DATA_BLOCK_FMT_EVT	0x0  0x0>,
				<REQ_TYPE_FMT_EVT	0x0  0x0>;
		/* ev0 ev1 ev2 ev3 ev4 ev5 ev6 ev7 */
		define_sample_id_enable =
				<NO_PRE_DEFINE_EVT	0x0  0x0  0x0  0x0  0x0  0x0  0x0  0x0>,
				<LATENCY_FMT_EVT	0x0  0x0  0x1  0x0  0x0  0x0  0x1  0x0>,
				<MO_FMT_EVT		0x0  0x0  0x1  0x0  0x0  0x0  0x1  0x0>,
				<BURST_LENGTH_FMT_EVT	0x0  0x0  0x1  0x1  0x0  0x0  0x1  0x1>,
				<REQ_BLOCK_FMT_EVT	0x0  0x0  0x1  0x1  0x0  0x0  0x1  0x1>,
				<DATA_BLOCK_FMT_EVT	0x0  0x0  0x1  0x0  0x0  0x0  0x1  0x0>,
				<REQ_TYPE_FMT_EVT	0x0  0x0  0x0  0x0  0x0  0x0  0x0  0x0>;

		bcm_ip_nr = <84>;
		bcm_ip_print_nr = <10>;

		ip-name = "csis_d1", "csis_d0", "ipp", "msa", "d8_tnr", "d7_tnr",
			  "d6_tnr", "d5_tnr", "d4_tnr", "d3_tnr", "d2_tnr",
			  "d1_tnr", "d0_tnr", "bo", "d2_g2d", "d1_g2d",
			  "d0_g2d", "misc", "dpu2", "dpu1", "dpu0",
			  "pdp_vra", "g3aa", "d1_dns", "d0-dns", "d1_mcsc", "d0_mcsc",
			  "d1_itsc", "d0_itsc", "d3_gdc", "d2_gdc", "d1_gdc", "d0_gdc", "d2_scsc",
			  "d1_scsc", "d0_scsc", "d1_mfc", "d0_mfc", "hsi2", "tpu",
			  "gpu0", "gpu1", "gpu2", "gpu3", "bus2_m0",
			  "bus2_m1", "bus2_m2", "bus2_m3", "gsacore", "aoc",
			  "usb", "hsi0_bus0", "hsi0_aoc", "hsi1", "ace_cpucl1",
			  "ace_cpucl0", "cpu0", "cpu1", "cpu2", "cpu3",
			  "core_m0", "core_m1", "core_m2", "core_m3", "core_cci",
			  "core_dp", "bus0_m0",
			  "slc_ch0_1", "slc_ch0_0", "slc_ch1_1", "slc_ch1_0", "slc_ch2_1",
			  "slc_ch2_0", "slc_ch3_1", "slc_ch3_0", "slc_bcast_1", "slc_bcast_0",
			  "bus1_m0", "bus1_m1", "bus1_m2", "bus1_m3", "aur0", "aur1", "itp";

		initial_run_bcm_ip = <0>, <1>, <2>, <3>, <4>, <5>, <6>, <7>, <8>, <9>, <10>,
				<11>, <12>, <13>, <14>, <15>, <16>, <17>, <18>,	<19>, <20>,
				<21>, <22>, <23>, <24>, <25>, <26>, <27>, <28>, <29>, <30>,
				<31>, <32>, <33>, <34>, <35>, <36>, <37>, <38>, <39>, <40>,
				<41>, <42>, <43>, <44>, <45>, <46>, <47>,
				<51>, <52>, <53>, <54>, <55>, <56>, <57>, <58>, <59>, <60>,
				<61>, <62>, <63>, <64>, <65>, <66>, <67>, <68>, <69>, <70>,
				<71>, <72>, <73>, <74>,             <77>, <78>, <79>, <80>,
				<81>, <82>, <83>;

		initial_bcm_run = <BCM_STOP>;
		/* usec (max 1000000 usec) */
		initial_period = <1000>;
		initial_bcm_mode = <BCM_MODE_INTERVAL>;
		available_stop_owner = <PANIC_HANDLE CAMERA_DRIVER MODEM_IF ITMON_HANDLE>;
		buff_size = <0x100000>;

		ipc_bcm_event {
			plugin-len = <5>;
			plugin-name = "BCM";
		};
	};
};
