// SPDX-License-Identifier: GPL-2.0-only
/*
 * Usecases specific to the gs101 platform
 *
 * Copyright 2020 Google,LLC
 *
 */

/* system use cases */
&max77759_chg {
	max77759,bst-on = <&max777x9_gpio 4 GPIO_ACTIVE_HIGH>;
	max77759,bst-sel = <&s2mpg10_gpio 3 GPIO_ACTIVE_HIGH>;
	max77759,extbst-ctl = <&max77759_tcpc_gpio 0 GPIO_ACTIVE_HIGH>;
	max77759,extbst-mode = <&s2mpg10_gpio 4 GPIO_ACTIVE_HIGH>;
	max77759,ls1-en = <&max20339_gpio 0 GPIO_ACTIVE_HIGH>;
	max77759,ls2-en = <&max20339_gpio 1 GPIO_ACTIVE_HIGH>;
	max77759,sw-en = <&max20339_gpio 4 GPIO_ACTIVE_HIGH>;
	max77759,lsw1-is_open = <&max20339_gpio 5 GPIO_ACTIVE_HIGH>;
	max77759,lsw1-is_closed = <&max20339_gpio 6 GPIO_ACTIVE_HIGH>;
	max77759,vin-is_valid =  <&max20339_gpio 3 GPIO_ACTIVE_HIGH>;
	max77759,otg-enable =  <&max20339_gpio 7 GPIO_ACTIVE_HIGH>;
	max77759,cpout-en =  <&p9xxx_gpio 1 GPIO_ACTIVE_HIGH>;
	max77759,cpout-ctl =  <&p9xxx_gpio 3 GPIO_ACTIVE_HIGH>;
};
