// SPDX-License-Identifier: GPL-2.0-only
/*
 * Raven Proto Wingboard device tree.
 * Identical to Raven 1.0 but with wingboard RF
 * and 1.1 Camera PMIC.
 *
 * Copyright 2021 Google,LLC
 */

/dts-v1/;
/plugin/;

#define GS101_RAVEN_WINGBOARD 1
#include "gs101-raven-proto1.dtsi"

/ {
	board_id = <0x20202>;
	board_rev = <0x010001>;
	fragment@boardbase {
		target-path="/";
		__overlay__ {
			model = "Raven Proto Wingboard";
			compatible = "google,GS101 Raven", "google,GS101";
		};
	};
};
