// SPDX-License-Identifier: GPL-2.0-only
/*
 * Ravenclaw device tree source
 *
 * Copyright 2021 Google,LLC
 */

#include <dt-bindings/regulator/samsung,s2mpg-regulator.h>

#include "gs201-cloudripper-common.dtsi"

#include "gs201-ravenclaw-audio.dtsi"
#include "gs201-ravenclaw-display.dtsi"
#include "gs201-ravenclaw-touch.dtsi"

#include "gs201-ravenclaw-usecases.dtsi"

/* UWB */
&s_ldo16_reg {
	regulator-always-on;
	regulator-initial-mode = <SEC_OPMODE_ON>;
};
&s_ldo17_reg {
	regulator-always-on;
	regulator-initial-mode = <SEC_OPMODE_ON>;
};
