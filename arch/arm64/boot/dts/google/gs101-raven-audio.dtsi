// SPDX-License-Identifier: GPL-2.0-only
/*
 * Google GS101 Whitefin 2 v2 audio device tree source
 *
 * Copyright (c) 2020 Google, LLC
 *		https://www.google.com
 *
*/

#include "gs101-raviole-audio.dtsi"

&aoc {
	aoc-board-cfg = "r4";
	aoc-board-id = <0x20202>;
	aoc-board-rev = <0x10000>;
};
