// SPDX-License-Identifier: GPL-2.0-only
/*
 * Android Virtualization Framework Debug Policy device tree source
 *
 * Copyright 2022 Google Inc.
 *
 * This program is free software; you can redistribute it and/or modify
 * it under the terms of the GNU General Public License version 2 as
 * published by the Free Software Foundation.
 */

&avf {
	version = <0>;
	variant = "eng";

	guest {
		default {
			ramdump = <1>;
		};
	};
}; /* end of avf */
