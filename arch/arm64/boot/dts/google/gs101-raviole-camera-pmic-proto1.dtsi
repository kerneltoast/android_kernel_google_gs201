// SPDX-License-Identifier: GPL-2.0-only
/*
 * gs101 pmic device tree source for raviole
 *
 * Copyright 2020 Google LLC.
 *
 */

#include <dt-bindings/gpio/gpio.h>
#include <dt-bindings/pinctrl/samsung.h>

&slg51000 {
	dlg,op-mode = <1>;
	dlg,reg-init =
	<0x1109 0x75>, <0x110C 0x40>, <0x110D 0x00>, <0x110E 0x00>,
	<0x1111 0x06>, <0x1112 0x1B>, <0x1133 0x05>, <0x1500 0x80>,
	<0x1501 0x80>, <0x1502 0x80>, <0x1503 0x80>, <0x1504 0x00>,
	<0x1505 0x00>, <0x1600 0x00>, <0x1601 0x00>, <0x1602 0x00>,
	<0x1603 0x00>, <0x1604 0x00>, <0x1605 0x00>, <0x1606 0x00>,
	<0x1607 0x00>, <0x1608 0x00>, <0x1609 0x00>, <0x160A 0x00>,
	<0x160B 0x00>, <0x1700 0x00>, <0x1701 0x00>, <0x1702 0x00>,
	<0x1703 0x00>, <0x1704 0x00>, <0x1705 0x00>, <0x1706 0x00>,
	<0x1707 0x00>, <0x1708 0x00>, <0x1709 0x00>, <0x170A 0x00>,
	<0x170B 0x00>, <0x170C 0x00>, <0x170D 0x00>, <0x170E 0x00>,
	<0x170F 0x00>, <0x1710 0x00>, <0x1711 0x00>, <0x1712 0x00>,
	<0x1713 0x00>, <0x1714 0x00>, <0x1715 0x02>, <0x1716 0x03>,
	<0x1717 0x04>, <0x1718 0x05>, <0x1719 0x06>, <0x171A 0x07>,
	<0x171B 0x08>, <0x171C 0x00>, <0x171D 0x00>, <0x171E 0x00>,
	<0x171F 0x00>, <0x1720 0x00>, <0x1721 0x00>, <0x1722 0x00>,
	<0x1723 0x00>, <0x1724 0x00>, <0x1725 0x00>, <0x1726 0x00>,
	<0x1727 0x00>, <0x1728 0x00>, <0x1729 0x00>, <0x172A 0x00>,
	<0x172B 0x00>, <0x172C 0x00>, <0x172D 0x00>, <0x172E 0x00>,
	<0x172F 0x00>, <0x1730 0x00>, <0x1731 0x00>, <0x1732 0x00>,
	<0x1733 0x00>, <0x1734 0x00>, <0x1735 0x00>, <0x1736 0x00>,
	<0x1737 0x00>, <0x1738 0x00>, <0x1739 0x00>, <0x173A 0x00>,
	<0x173B 0x00>, <0x173C 0x00>, <0x173D 0x00>, <0x173E 0x00>,
	<0x173F 0x00>, <0x1900 0x00>, <0x1901 0x00>, <0x1902 0x00>,
	<0x1903 0x00>, <0x1904 0x00>, <0x1905 0x00>, <0x1906 0x08>,
	<0x1907 0x08>, <0x1908 0x08>, <0x1909 0x08>, <0x190A 0x08>,
	<0x190B 0x08>, <0x190C 0x08>, <0x190D 0x08>, <0x190E 0x08>,
	<0x190F 0x08>, <0x1910 0x08>, <0x1911 0x08>, <0x1912 0xFF>,
	<0x1913 0x3F>, <0x1914 0xFC>, <0x1915 0x00>, <0x1916 0x00>,
	<0x2000 0x82>, <0x2060 0x28>, <0x2061 0xDC>, <0x2063 0x0B>,
	<0x2200 0x82>, <0x2260 0x28>, <0x2261 0xDC>, <0x2263 0x0B>,
	<0x2300 0xA5>, <0x2360 0x00>, <0x2361 0xFF>, <0x2363 0x0B>,
	<0x2364 0x02>, <0x2365 0x2D>, <0x2500 0x3C>, <0x2560 0x00>,
	<0x2561 0xFF>, <0x2563 0x0B>, <0x2564 0x0A>, <0x2565 0x2D>,
	<0x2700 0x8C>, <0x2760 0x14>, <0x2761 0xA0>, <0x2763 0x02>,
	<0x2764 0xAB>, <0x2765 0x0A>, <0x2766 0x40>, <0x2900 0x8C>,
	<0x2960 0x14>, <0x2961 0xA0>, <0x2963 0x02>, <0x2964 0xAB>,
	<0x2965 0x08>, <0x2966 0x40>, <0x3100 0x3C>, <0x3160 0x00>,
	<0x3161 0xFF>, <0x3163 0x0B>, <0x3164 0x00>, <0x3165 0x2D>,
	<0x8000 0x00>;
};