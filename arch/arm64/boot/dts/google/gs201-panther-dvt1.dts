// SPDX-License-Identifier: GPL-2.0-only
/*
 * Panther device tree source
 *
 * Copyright 2021 Google,LLC
 */

/dts-v1/;
/plugin/;

#include "gs201-panther-common.dtsi"
#include "gs201-pantah-pmic-odpm-1.dtsi"

/ {
	board_id = <0x30404>;
	board_rev = <0x10000>;
	fragment@boardbase {
		target-path="/";
		__overlay__ {
			model = "GS201 PANTHER DVT 1.0 based on GS201";
			compatible = "google,GS201 PANTHER", "google,GS201";
		};
	};
};

&serial_0 {
	status = "okay";
};
