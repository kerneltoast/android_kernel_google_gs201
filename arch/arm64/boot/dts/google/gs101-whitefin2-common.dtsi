// SPDX-License-Identifier: GPL-2.0-only
/*
 * Whitefin2 common device tree source
 *
 * Copyright 2020 Google,LLC
 */

#include "gs101-whitefin-common.dtsi"

#include "gs101-slider-gsa-gsc.dtsi"
#include "gs101-slider2-gps.dtsi"
#include "gs101-whitefin2-battery.dtsi"
#include "gs101-whitefin2-cp-s5200-sit.dtsi"
#include "gs101-whitefin2-pmic.dtsi"
#include "gs101-whitefin2-thermal.dtsi"
#include "gs101-whitefin2-bcl.dtsi"
#include "gs101-whitefin2-wcharger.dtsi"
