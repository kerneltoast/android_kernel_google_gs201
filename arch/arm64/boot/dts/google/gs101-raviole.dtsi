// SPDX-License-Identifier: GPL-2.0-only
/*
 * Device tree common source between Oriole and Raven.
 *
 * Copyright 2021 Google,LLC
 */

#include "gs101-common.dtsi"

#include "gs101-raviole-battery.dtsi"
#include "gs101-raviole-camera-pmic.dtsi"
#include "gs101-raviole-ese.dtsi"
#include "gs101-raviole-fingerprint.dtsi"
#include "gs101-raviole-ldaf.dtsi"
#include "gs101-raviole-sbbm.dtsi"
#include "gs101-raviole-thermal.dtsi"
#include "gs101-raviole-usb.dtsi"
#include "gs101-slider-gsa-gsc.dtsi"
#include "gs101-slider2-gps.dtsi"
#include "gs101-whitefin-cp-s5200-sit-common.dtsi"
#include "gs101-whitefin-display.dtsi"
#include "gs101-whitefin-nfc.dtsi"
#include "gs101-whitefin2-cp-s5200-sit.dtsi"
#include "gs101-whitefin2-pmic.dtsi"
#include "gs101-whitefin2-bcl.dtsi"
