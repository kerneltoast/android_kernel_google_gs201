// SPDX-License-Identifier: GPL-2.0-only
/*
 * Google Ravenclaw device tree source
 *
 * Copyright 2021 Google Inc.
 *
 */

#include <dt-bindings/pinctrl/samsung.h>

/*
 * AP2AOC: XHSI1_GPIO2 - GPH1[0] -> XAOC_GPIO13 - gpio_in[87]
 * AOC2AP: XAOC_GPIO8 - gpio_in[74] -> XEINT_19 - GPA8[7]
 */
&tbn {
	compatible = "touch_bus_negotiator";
	tbn,aoc2ap_gpio = <&gpa8 7 GPIO_ACTIVE_LOW>;
};

&spi_0 {
	spitouch: touchscreen@0 {
		sec,panel_map = <&samsung_s6e3hc3 0>;

		sec,touch_offload_id = /bits/ 8 <'0' '0' 'r' '4'>;
		sec,mm2px = /bits/ 8 <20>;
		sec,encoded_enable = <1>;

		sec,firmware_name = "s6sy79x.bin";
		sec,mis_cal_check = <1>;
		sec,heatmap_mode = <1>;

		sec,max_coords = <1440 3120>;

		controller-data {
			samsung,spi-feedback-delay = <0>;
			samsung,spi-chip-select-mode = <0>;
		};
	};
};
