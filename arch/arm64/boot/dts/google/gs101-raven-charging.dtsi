// SPDX-License-Identifier: GPL-2.0-only
/*
 * Battery device tree entries specific to raven
 *
 * Copyright 2021 Google,LLC
 *
 */


&pca9468_dc {
	pca9468,input-current-limit = <2500000>; /* 5A max */
};

&google_charger {
	google,thermal-mitigation = <5000000 4000000 2500000 1000000>;
	google,wlc-fcc-thermal-mitigation = <5000000 5000000 4000000 2500000 1000000>;
};
