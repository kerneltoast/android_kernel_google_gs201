// SPDX-License-Identifier: GPL-2.0-only
/*
 * Oriole Proto 1.0 common device tree source
 *
 * Copyright 2021 Google,LLC
 */
#include "gs101-oriole-evt1.dtsi"

#include "gs101-oriole-camera-proto1.dtsi"
#include "gs101-raviole-camera-pmic-proto1.dtsi"
#include "gs101-raviole-ldaf-proto1.dtsi"
#include "gs101-raviole-nfc-proto.dtsi"