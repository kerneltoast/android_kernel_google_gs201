// SPDX-License-Identifier: GPL-2.0-only
/*
 * Raven Proto 1.1 device tree source overrides vs evt1
 *
 * Copyright 2021 Google,LLC
 */

/dts-v1/;
/plugin/;

#include "gs101-raven-evt1.dtsi"
#include "gs101-raviole-nfc-proto.dtsi"
#include "gs101-raviole-wcharger-proto.dtsi"

/ {
	board_id = <0x20202>;
	board_rev = <0x010100>;
	fragment@boardbase {
		target-path="/";
		__overlay__ {
			model = "Raven Proto 1.1";
			compatible = "google,GS101 Raven", "google,GS101";
		};
	};
};
