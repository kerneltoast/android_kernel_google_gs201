// SPDX-License-Identifier: GPL-2.0-only
/*
 * Battery device tree entries
 *
 * Copyright 2021 Google LLC
 *
 */

maxim,config {

	/* R4_p1_gen.ini, 2021-01-21, b/174787673, generic model */
	maxim,default-a1-0k {
		maxim,batt-id-kohm = <0>;
		maxim,model-version = <0>;
		maxim,fg-model = /bits/ 16 <
			0x9760 0xa510 0xb100 0xb600 0xb7a0 0xb900 0xba70 0xbc70
			0xbde0 0xbfc0 0xc250 0xc510 0xc990 0xcea0 0xd040 0xd750
			0x0060 0x0120 0x0200 0x0710 0x0e80 0x0df0 0x1430 0x1bd0
			0x1520 0x0d70 0x0950 0x08e0 0x0800 0x0780 0x06b0 0x01e0
			0x0100 0x0100 0x0100 0x0100 0x0100 0x0100 0x0100 0x0100
			0x0100 0x0100 0x0100 0x0100 0x0100 0x0100 0x0100 0x0100
		>;
		maxim,fg-params = /bits/ 16 <
			/* 0x0036 */	0xf060	/* IAvgEmpty */
			/* 0x002a */	0x2038	/* RelaxCFG */
			/* 0x0028 */	0x260E	/* LearnCFG */
			/* 0x001D */	0x4217	/* Config */
			/* 0x00BB */	0x0090	/* Config2 */
			/* 0x0013 */	0x5F00	/* FullSOCthr */
			/* 0x0035 */	0x0994	/* FullCAPRep */
			/* 0x0018 */	0x0994	/* DesignCap */
			/* 0x0046 */	0x0c80	/* dPacc */
			/* 0x0045 */	0x0099	/* dQacc */
			/* 0x0023 */	0x0994	/* FullCAPNom */
			/* 0x003A */	0xA561	/* V_empty */
			/* 0x0012 */	0x1100	/* QResidual00 */
			/* 0x0022 */	0x0800	/* QResidual10 */
			/* 0x0032 */	0x0301	/* QResidual20 */
			/* 0x0042 */	0x0302	/* QResidual30 */
			/* 0x0038 */	0x0700	/* RCOMP0 */
			/* 0x0039 */	0x223E	/* TempCo */
			/* 0x001E */	0x0310	/* ICHGTerm */
			/* 0x002C */	0xED51	/* TGain */
			/* 0x002D */	0x1EBA	/* TOff */
			/* 0x00B9 */	0x0014	/* Curve */
			/* 0x002B */	0x3870	/* MiscCFG */
			/* 0x0004 */	0x0000	/* AtRate */
			/* 0x0049 */	0x2241	/* convgcfg */
			/* 0x0029 */	0xc623	/* FilterCFG */
			/* 0x003c */	0x2D00	/* TaskPeriod */
		>;
	};

	/* ATL: 1_ATL_3140_1_101821_BC59_RC2_1122.txt, 2021-11-22, b/197795522#comment9 */
	maxim,cos-a1-1k {
		maxim,batt-id-kohm = <1>;
		maxim,model-version = <1>;
		maxim,force-reset-model-data;
		maxim,fg-model = /bits/ 16 <
			0x9590 0xaed0 0xb3b0 0xb890 0xb8e0 0xb920 0xbb60 0xbc70
			0xbde0 0xbf40 0xc210 0xc730 0xc920 0xcf20 0xd600 0xdcd0
			0x0020 0x0310 0x0240 0x2c30 0x2f50 0x0b20 0x1650 0x1410
			0x1700 0x0f90 0x07c0 0x07f0 0x07b0 0x0690 0x06f0 0x06f0
			0x0200 0x0200 0x0200 0x0200 0x0200 0x0200 0x0200 0x0200
			0x0200 0x0200 0x0200 0x0200 0x0200 0x0200 0x0200 0x0200
		>;
		maxim,fg-params = /bits/ 16 <
			/* 0x0036 */	0xf060	/* IAvgEmpty */
			/* 0x002a */	0x0839	/* RelaxCFG */
			/* 0x0028 */	0x260e	/* LearnCFG */
			/* 0x001D */	0x4217	/* Config */
			/* 0x00BB */	0x0090	/* Config2 */
			/* 0x0013 */	0x5f00	/* FullSOCthr */
			/* 0x0035 */	0x089e	/* FullCAPRep */
			/* 0x0018 */	0x0882	/* DesignCap */
			/* 0x0046 */	0x3200	/* dPacc */
			/* 0x0045 */	0x0220	/* dQacc */
			/* 0x0023 */	0x089e	/* FullCAPNom */
			/* 0x003A */	0xa561	/* V_empty */
			/* 0x0012 */	0x1f00	/* QResidual00 */
			/* 0x0022 */	0x0e00	/* QResidual10 */
			/* 0x0032 */	0x0580	/* QResidual20 */
			/* 0x0042 */	0x0480	/* QResidual30 */
			/* 0x0038 */	0x06f0	/* RCOMP0 */
			/* 0x0039 */	0x2202	/* TempCo */
			/* 0x001E */	0x0557	/* ICHGTerm */
			/* 0x002C */	0xED51	/* TGain */
			/* 0x002D */	0x1EBA	/* TOff */
			/* 0x00B9 */	0x0014	/* Curve */
			/* 0x002B */	0x3870	/* MiscCFG */
			/* 0x0004 */	0x1900	/* AtRate */
			/* 0x0049 */	0x2241	/* convgcfg */
			/* 0x0029 */	0xc623	/* FilterCFG */
			/* 0x003c */	0x2D00	/* TaskPeriod */
		>;
	};

	/* LSN: 3_LSN_3141_1_101621_BC59_RC2_1122.txt, 2021-11-22, b/197795522#comment9 */
	maxim,lsn-a1-3k {
		maxim,batt-id-kohm = <3>;
		maxim,model-version = <1>;
		maxim,force-reset-model-data;
		maxim,fg-model = /bits/ 16 <
			0xa4f0 0xb6f0 0xb8c0 0xba00 0xbbb0 0xbc70 0xbe40 0xbf60
			0xc130 0xc350 0xc630 0xc920 0xcfd0 0xd460 0xd820 0xdc20
			0x0140 0x0970 0x1200 0x1000 0x0f40 0x1910 0x1740 0x0db0
			0x0af0 0x0860 0x07f0 0x06f0 0x0680 0x0760 0x06e0 0x06e0
			0x0200 0x0200 0x0200 0x0200 0x0200 0x0200 0x0200 0x0200
			0x0200 0x0200 0x0200 0x0200 0x0200 0x0200 0x0200 0x0200
		>;
		maxim,fg-params = /bits/ 16 <
			/* 0x0036 */	0xf060	/* IAvgEmpty */
			/* 0x002a */	0x0839	/* RelaxCFG */
			/* 0x0028 */	0x260e	/* LearnCFG */
			/* 0x001D */	0x4217	/* Config */
			/* 0x00BB */	0x0090	/* Config2 */
			/* 0x0013 */	0x5f00	/* FullSOCthr */
			/* 0x0035 */	0x089b	/* FullCAPRep */
			/* 0x0018 */	0x0882	/* DesignCap */
			/* 0x0046 */	0x3200	/* dPacc */
			/* 0x0045 */	0x0220	/* dQacc */
			/* 0x0023 */	0x089b	/* FullCAPNom */
			/* 0x003A */	0xa561	/* V_empty */
			/* 0x0012 */	0x2400	/* QResidual00 */
			/* 0x0022 */	0x1100	/* QResidual10 */
			/* 0x0032 */	0x0780	/* QResidual20 */
			/* 0x0042 */	0x0500	/* QResidual30 */
			/* 0x0038 */	0x0720	/* RCOMP0 */
			/* 0x0039 */	0x1c02	/* TempCo */
			/* 0x001E */	0x0557	/* ICHGTerm */
			/* 0x002C */	0xED51	/* TGain */
			/* 0x002D */	0x1EBA	/* TOff */
			/* 0x00B9 */	0x0014	/* Curve */
			/* 0x002B */	0x3870	/* MiscCFG */
			/* 0x0004 */	0x1900	/* AtRate */
			/* 0x0049 */	0x2241	/* convgcfg */
			/* 0x0029 */	0xc623	/* FilterCFG */
			/* 0x003c */	0x2D00	/* TaskPeriod */
		>;
	};
};
