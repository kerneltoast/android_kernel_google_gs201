// SPDX-License-Identifier: GPL-2.0-only
/*
 * Samsung CP interface device tree source
 *
 * Copyright (c) 2019-2020 Samsung Electronics Co., Ltd.
 *             http://www.samsung.com
 */

#include <dt-bindings/soc/google/exynos-dit.h>

/ {
	dit {
		compatible = "samsung,exynos-dit";
		status = "okay";

		interrupt-parent = <&gic>;
		interrupts = <GIC_SPI IRQ_DIT_RxDst0_MISC IRQ_TYPE_LEVEL_HIGH>,
			<GIC_SPI IRQ_DIT_RxDst1_MISC IRQ_TYPE_LEVEL_HIGH>,
			<GIC_SPI IRQ_DIT_RxDst2_MISC IRQ_TYPE_LEVEL_HIGH>,
			<GIC_SPI IRQ_DIT_Tx_MISC IRQ_TYPE_LEVEL_HIGH>,
			<GIC_SPI IRQ_DIT_Err_MISC IRQ_TYPE_LEVEL_HIGH>;
		interrupt-names = "DIT-RxDst0", "DIT-RxDst1", "DIT-RxDst2", "DIT-Tx", "DIT-Err";

		reg = <0x0 0x10190000 0x00010000>, <0x0 0x10030000 0x00002000>;
		reg-names = "dit", "sysreg";

		/* DIT_SHARABILITY_CON or DIT_BUS_CON */
		dit_sharability_offset = <0x00001108>;
		dit_sharability_value = <0x00110011>;

		/* xx(major).yy(mid).zz(minor).rr(reserved) */
		dit_hw_version = <0x02010000>;
		dit_hw_capabilities = <(DIT_CAP_MASK_NONE)>;

		dit_use_tx = <1>;
		dit_use_rx = <1>;
		dit_use_clat = <0>;
		dit_hal_linked = <1>;
		dit_rx_extra_desc_ring_len = <2048>;

		dit_irq_affinity = <2>;
	};
};
