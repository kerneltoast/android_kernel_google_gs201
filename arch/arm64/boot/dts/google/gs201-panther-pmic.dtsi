// SPDX-License-Identifier: GPL-2.0-only
/*
 * Panther-specific PMIC settings
 *
 * Copyright 2021 Google LLC.
 *
 */

/* Display: Keep vddi-supply always on */
&s_bucka_reg {
	regulator-always-on;
};

/* Display: vci-supply voltage */
&m_ldo27_reg {
	regulator-min-microvolt = <3025000>;
	regulator-max-microvolt = <3025000>;
};
