// SPDX-License-Identifier: GPL-2.0-only
/*
 * Wireless Charger device tree entries.
 *
 * Copyright 2020 Google Inc.
 */

#include "gs101-raviole-wcharger.dtsi"

&hsi2c_8 {
	p9412@3c {
		fod = [97 36 91 2e 97 10 9b 05 9f f3 9f ee 19 06 01 3c];
		fod_epp = [8a 6d 86 56 8e 3b 8b 3e 8c 33 91 0b 20 13 01 50];
		fod_hpp = [A4 72 8F 78 8B 6B 88 5C 89 51 8E 29];
		google,q_value = <67>;
	};
};
