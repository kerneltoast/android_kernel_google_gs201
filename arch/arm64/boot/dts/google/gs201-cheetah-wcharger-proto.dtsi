// SPDX-License-Identifier: GPL-2.0-only
/*
 * Wireless Charger device tree entries.
 *
 * Copyright 2022 Google Inc.
 */

&hsi2c_15 {
	p9412@3c {
		fod = [B2 2E 93 3B 8B 2B 94 0E 98 02 9E ED 19 06 01 3C];
		fod_epp = [AD 54 83 7F 89 46 87 46 8A 37 8D 1F 32 11 01 50];
		google,q_value = <56>;
		idt,has_rtx = <0>;
	};
};
