// SPDX-License-Identifier: GPL-2.0-only
/*
 * gs101 pmic latest device tree source
 *
 * Copyright 2020 Google LLC.
 *
 */

#ifndef RAVIOLE_EVT1_AND_OLDER
&s_ext5_rail {
	shunt-res-uohms = <10000>;
	schematic-name = "VSYS_PWR_WLAN_BT";
	subsys-name = "WLAN-BT";
};

&ch9 {
	rail-name = "VSEN_C5";
};
#endif
