// SPDX-License-Identifier: GPL-2.0-only
/*
 * Raven DVT device tree source
 *
 * Copyright 2021 Google,LLC
 */

/dts-v1/;
/plugin/;

#include "gs101-raven.dtsi"
/ {
	board_id = <0x20204>;
	board_rev = <0x010000>;
	fragment@boardbase {
		target-path="/";
		__overlay__ {
			model = "Raven DVT";
			compatible = "google,GS101 Raven", "google,GS101";
		};
	};
};
