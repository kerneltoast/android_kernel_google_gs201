// SPDX-License-Identifier: GPL-2.0-only
/*
 * Common devicetree base for all slider/slider2 configs.
 *
 * Copyright 2021 Google LLC
 *
 */

#include "gs101-common.dtsi"

#include "gs101-slider-battery.dtsi"
#include "gs101-slider-bcl.dtsi"
#include "gs101-slider-display.dtsi"
#include "gs101-slider-fingerprint.dtsi"
#include "gs101-slider-gsa-gsc.dtsi"
#include "gs101-slider-nfc.dtsi"
#include "gs101-slider-pmic.dtsi"
#include "gs101-slider-serial.dtsi"
#include "gs101-slider-sbbm.dtsi"
#include "gs101-slider-thermal.dtsi"
#include "gs101-slider-touch.dtsi"
#include "gs101-slider-wcharger.dtsi"
