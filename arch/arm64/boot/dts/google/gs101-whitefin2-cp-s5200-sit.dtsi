// SPDX-License-Identifier: GPL-2.0-only
/*
 * Whitefin2-specific s5200 settings.
 *
 * Copyright 2020 Google, LLC.
 *
 */
/ {
	fragment@modemif {
		target-path = "/";
		__overlay__ {
			cpif {
				gpio_cp2ap_phone_active = <&gpa8 5 0x1>;
			};
		};
	};
};

&pinctrl_1 {
	s5100_cp2ap_phone_active: s5100_cp2ap_phone_active {
		samsung,pins = "gpa8-5";
		samsung,pin-function = <EXYNOS_PIN_FUNC_EINT>;
		samsung,pin-pud = <EXYNOS_PIN_PULL_NONE>;
		samsung,pin-con-pdn = <EXYNOS_PIN_PULL_UP>;
	};
};
