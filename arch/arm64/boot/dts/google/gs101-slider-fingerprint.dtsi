// SPDX-License-Identifier: GPL-2.0-only
/*
 * Goodix fps device tree source
 *
 * Copyright 2020 Google,LLC.
 */

&odm {
	goodixfp {
		status = "okay";
		compatible = "goodix,fingerprint";
		interrupt-parent = <&gpa6>;
		interrupts = <7 0>;
		spi-max-frequency = <1000000>;
		pinctrl-names = "default";
		fp-gpio-irq = <&gpa6 7 GPIO_ACTIVE_HIGH>;
		fp-gpio-reset = <&gpp4 3 GPIO_ACTIVE_LOW>;
	};
};
