// SPDX-License-Identifier: GPL-2.0-only
/*
 * Raven EVT 1.0 device tree source
 *
 * Copyright 2021 Google,LLC
 */

/dts-v1/;
/plugin/;

#include "gs101-raven-evt1.dtsi"
/ {
	board_id = <0x20203>;
	board_rev = <0x010000>;
	fragment@boardbase {
		target-path="/";
		__overlay__ {
			model = "Raven EVT 1.0";
			compatible = "google,GS101 Raven", "google,GS101";
		};
	};
};
