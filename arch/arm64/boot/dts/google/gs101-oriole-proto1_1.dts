// SPDX-License-Identifier: GPL-2.0-only
/*
 * Oriole Proto 1.1 Device Tree
 *
 * Copyright 2020 Google,LLC
 */

/dts-v1/;
/plugin/;

#include "gs101-oriole-evt1.dtsi"
#include "gs101-raviole-nfc-proto.dtsi"
#include "gs101-raviole-wcharger-proto.dtsi"

/ {
	board_id = <0x20302>;
	board_rev = <0x10100>;
	fragment@boardbase {
		target-path="/";
		__overlay__ {
			model = "Oriole Proto 1.1";
			compatible = "google,GS101 Oriole", "google,GS101";
		};
	};
};
