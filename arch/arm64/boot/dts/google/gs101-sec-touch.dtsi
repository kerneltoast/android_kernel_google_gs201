// SPDX-License-Identifier: GPL-2.0-only
/*
 * Google Whitefin device tree source
 *
 * Copyright 2020 Google Inc.
 *
 */

#include "gs101-common-touch.dtsi"

&spitouch {
	status = "ok";
	compatible = "sec,sec_ts";

	spi-max-frequency = <10000000>;
	spi-cpol;
	spi-cpha;

	pinctrl-names = "on_state", "off_state";

	sec,irq_gpio = <&gpa9 0 0>;
	sec,reset_gpio = <&gpp26 0 0>;
	sec,firmware_name = "s6sy79x.bin";
	sec,mis_cal_check = <1>;
	sec,heatmap_mode = <1>;

	sec,max_coords = <1440 3120>;

	controller-data {
		samsung,spi-feedback-delay = <0>;
		samsung,spi-chip-select-mode = <0>;
	};
};
