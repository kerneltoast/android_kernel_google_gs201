// SPDX-License-Identifier: GPL-2.0-only
/*
 * Passport device tree source
 *
 * Copyright 2021 Google Inc.
 *
 * This program is free software; you can redistribute it and/or modify
 * it under the terms of the GNU General Public License version 2 as
 * published by the Free Software Foundation.
 */

/dts-v1/;
/plugin/;

#include "gs101-passport-common.dtsi"

/ {
	fragment@boardbase {
		target-path="/";
		__overlay__ {
			model = "GS101 PASSPORT DEV based on GS101";
			compatible = "google,GS101 PASSPORT", "google,GS101";
			board_id = <0x231>;
			board_rev = <0x100>;
		};
	};
};
