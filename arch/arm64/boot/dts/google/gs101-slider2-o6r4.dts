// SPDX-License-Identifier: GPL-2.0-only
/*
 * Device tree for a slider2 reworked so that
 * the two secure elements are on different busses,
 * similar to Oriole and Raven.
 *
 * Copyright 2021 Google LLC
 *
 */

/dts-v1/;
/plugin/;

#include "gs101-slider2-common.dtsi"
#include "gs101-slider2-o6r4-ese.dtsi"

/ {
	board_id = <0x20001>;
	board_rev = <0x10101>;
	fragment@boardbase {
		target-path = "/";
		__overlay__ {
			model = "GS101 SLIDER2-O6R4SPI board based on GS101";
			compatible = "google,GS101", "google,GS101 SLIDER2-O6R4";
		};
	};
};
