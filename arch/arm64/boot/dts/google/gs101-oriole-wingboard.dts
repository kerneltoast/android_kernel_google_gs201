// SPDX-License-Identifier: GPL-2.0-only
/*
 * Oriole Wingboard device tree source
 *
 * Copyright 2020 Google,LLC
 */

/dts-v1/;
/plugin/;

#define GS101_ORIOLE_WINGBOARD 1
#include "gs101-oriole-proto1.dtsi"

/ {
	board_id = <0x20302>;
	board_rev = <0x10001>;
	fragment@boardbase {
		target-path="/";
		__overlay__ {
			model = "Oriole Proto Wingboard";
			compatible = "google,GS101 Oriole", "google,GS101";
		};
	};
};
