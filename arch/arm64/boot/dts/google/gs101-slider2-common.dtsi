// SPDX-License-Identifier: GPL-2.0-only
/*
 * Devicetree for slider2 - common across slider2 and
 * the ese-spi-reworked and poorly named slider2-o6r4.
 *
 * Copyright 2021 Google LLC
 *
 */

#define WC_BUS &hsi2c_8

#include "gs101-slider-common.dtsi"

#include "gs101-camera-slider2.dtsi"
#include "gs101-slider2-audio.dtsi"
#include "gs101-slider2-battery.dtsi"
#include "gs101-slider2-cp-s5200-sit.dtsi"
#include "gs101-slider2-gps.dtsi"
