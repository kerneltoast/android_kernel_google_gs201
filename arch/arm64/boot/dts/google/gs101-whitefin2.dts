// SPDX-License-Identifier: GPL-2.0-only
/*
 * Whitefin2 part 1 device tree source
 *
 * Copyright 2020 Google,LLC
 */

/dts-v1/;
/plugin/;

#include "gs101-whitefin2-common.dtsi"
#include "gs101-whitefin2-audio.dtsi"

/ {
	board_id = <0x201>;
	board_rev = <0x201>;
	fragment@boardbase {
		target-path="/";
		__overlay__ {
			model = "GS101 WHITEFIN2 based on GS101";
			compatible = "google,GS101 WHITEFIN2", "google,GS101";
		};
	};
};
