// SPDX-License-Identifier: GPL-2.0-only
/*
 * Google Raven touch device tree source
 *
 * Copyright 2020 Google LLC.
 *
 */

#include "gs101-sec-touch.dtsi"

&spitouch {
	sec,panel_map = <&samsung_s6e3hc3 0>;
	sec,touch_offload_id = /bits/ 8 <'0' '0' 'r' '4'>;
	sec,mm2px = /bits/ 8 <20>;
	sec,encoded_enable = <1>;
	sec,fod_coords = <720 2361>;
};

&m_ldo25_reg {
	regulator-min-microvolt = <1800000>;
	regulator-max-microvolt = <1800000>;
};

&m_ldo26_reg {
	regulator-min-microvolt = <3300000>;
	regulator-max-microvolt = <3300000>;
};
