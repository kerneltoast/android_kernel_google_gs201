// SPDX-License-Identifier: GPL-2.0-only
/*
 * gs101 ldaf(Laser Detection Auto Focus) device tree source
 * Copyright 2020 Google LLC.
 *
 */

#include <dt-bindings/gpio/gpio.h>

&pinctrl_1 {
	ldaf_irq: ldaf-irq {
		samsung,pins = "gpa7-1"; /* XEINT_9 */
		samsung,pin-function = <EXYNOS_PIN_FUNC_INPUT>;
		samsung,pin-pud = <EXYNOS_PIN_PULL_NONE>;
	};
};

&hsi2c_1 {
	/* VL53L1 */
	status = "ok";
	#address-cells = <1>;
	#size-cells = <0>;
	stmvl53l1: stmvl53l1@29 {
		compatible = "st,stmvl53l1";
		reg = <0x29>;
		/* XAPC_MCLK7: GPP15[0] GPIO162 */
		xsdn-gpio = <&gpp15 0 GPIO_ACTIVE_LOW>;
		/* XAPC_GPIO5: GPP22[1] GPIO191 */
		pwren-gpio = <&gpp22 1 GPIO_ACTIVE_HIGH>;
		/* XEINT_9: GPA7[1] GPIO54 */
		intr-gpio = <&gpa7 1 GPIO_ACTIVE_LOW>;

		vio-type = "regulator";
		vio-supply = <&slg51000_ldo1>;
		vio-voltage = <0>;

		pinctrl-names = "default";
		pinctrl-0 = <&ldaf_irq>;

		status = "ok";
	};
};
