// SPDX-License-Identifier: GPL-2.0-only
/*
 * Google Oriole touch device tree source
 *
 * Copyright 2020 Google LLC.
 */

#include "gs101-fts-touch.dtsi"

&spitouch {
	st,dchip_id = /bits/ 8 <0x36 0x48>;

	/* Temporarily disable the panel_map. While the DTS compiles
	 * successfully, its presence causes a kernel panic during
	 * boot because the panels below are not defined in the maran
	 * kernel.
	 */
	st,panel_map = <&samsung_s6e3fc3 0>;
	/* TODO: remove hardcoded max-coords when the extinfo can be
	 * fetched.
	 */
	st,max-coords = <1079 2399>;
	st,udfps-coords = <540 1769>;

	st,touch_offload_id = /bits/ 8 <'0' '0' 'o' '6'>;
	st,firmware_names = "ftm5_fw_o6.ftb";
	st,limits_names = "stm_fts_production_limits_o6.csv";
};
