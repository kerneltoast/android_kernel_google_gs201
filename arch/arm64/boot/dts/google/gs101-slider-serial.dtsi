// SPDX-License-Identifier: GPL-2.0-only

/ {
	fragment@serial0 {
		target-path = "/";
		__overlay__ {
			uart@10A00000 {
				pinctrl-names = "default";
				pinctrl-0 = <&uart0_bus>;
			};
		};
	};
};
