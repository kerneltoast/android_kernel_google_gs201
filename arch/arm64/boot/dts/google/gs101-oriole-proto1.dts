// SPDX-License-Identifier: GPL-2.0-only
/*
 * Oriole Early SMT device tree source
 *
 * Copyright 2020 Google,LLC
 */

/dts-v1/;
/plugin/;

#include "gs101-oriole-evt1.dtsi"
#include "gs101-raviole-camera-pmic-proto1.dtsi"
#include "gs101-raviole-ldaf-proto1.dtsi"
#include "gs101-oriole-camera-proto1.dtsi"
#include "gs101-oriole-touch-proto1.dtsi"
#include "gs101-raviole-wcharger-proto.dtsi"

/ {
	board_id = <0x20302>;
	board_rev = <0x10000>;
	fragment@boardbase {
		target-path="/";
		__overlay__ {
			model = "Oriole Proto 1.0";
			compatible = "google,GS101 Oriole", "google,GS101";
		};
	};
};
