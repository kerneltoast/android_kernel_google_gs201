// SPDX-License-Identifier: GPL-2.0-only
/*
 * slider2 board device tree source
 *
 * Copyright 2021 Google LLC
 *
 */

/dts-v1/;
/plugin/;

#include "gs101-slider2-common.dtsi"
#include "gs101-slider-ese.dtsi"

/ {
	board_id = <0x201>;
	board_rev = <0x101>;
	fragment@boardbase {
		target-path = "/";
		__overlay__ {
			model = "GS101 SLIDER2 board based on GS101";
			compatible = "google,GS101", "google,GS101 SLIDER2";
		};
	};
};
