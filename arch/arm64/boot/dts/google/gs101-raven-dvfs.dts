// SPDX-License-Identifier: GPL-2.0-only
/*
 * Raven Proto with B0 and DVFS 0.3.0 device tree source
 *
 * Copyright 2020 Google,LLC
 */

/dts-v1/;
/plugin/;

#include "gs101-raviole.dtsi"
#include "gs101-raven-audio.dtsi"
#include "gs101-raven-touch.dtsi"
/ {
	board_id = <0x20202>;
	board_rev = <0x010001>;
	fragment@boardbase {
		target-path="/";
		__overlay__ {
			model = "Raven Proto 1.0 B0 DVFS 0.3.0";
			compatible = "google,GS101 Raven", "google,GS101";
		};
	};

	&aoc {
		force-vnom = <1>;
	};
};
