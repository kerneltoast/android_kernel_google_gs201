// SPDX-License-Identifier: GPL-2.0-only
/*
 * Wireless Charger device tree entries.
 *
 * Copyright 2020 Google Inc.
 */

#include <dt-bindings/pinctrl/samsung.h>
#include <dt-bindings/interrupt-controller/irq.h>


&hsi2c_8 {
	p9412@3c {
		idt,has_rtx = <1>;
		idt,gpio_extben = <&gpp1 3 GPIO_ACTIVE_HIGH>;
		idt,has_wlc_dc = <0>;
	};
};
