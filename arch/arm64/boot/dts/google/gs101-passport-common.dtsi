// SPDX-License-Identifier: GPL-2.0-only
/*
 * Common device tree parts for passport
 *
 * Copyright 2021 Google Inc.
 *
 * This program is free software; you can redistribute it and/or modify
 * it under the terms of the GNU General Public License version 2 as
 * published by the Free Software Foundation.
 */

#include "gs101-slider-common.dtsi"
