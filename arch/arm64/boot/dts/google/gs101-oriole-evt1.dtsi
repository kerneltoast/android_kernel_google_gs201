// SPDX-License-Identifier: GPL-2.0-only
/*
 * Oriole EVT 1.0 Device Tree
 * Includes Oriole EVT device tree + changes for EVT1 devices.
 * Copyright 2021 Google,LLC
 */

#define RAVIOLE_EVT1_AND_OLDER 1
#include "gs101-oriole-evt1_1.dtsi"
#include "gs101-oriole-pmic-evt1.dtsi"
#include "gs101-raviole-fingerprint-evt.dtsi"
#include "gs101-raviole-pmic-evt1.dtsi"
#include "gs101-raviole-thermal-evt.dtsi"
