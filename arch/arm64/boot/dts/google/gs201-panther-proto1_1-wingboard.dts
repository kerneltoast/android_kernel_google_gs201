// SPDX-License-Identifier: GPL-2.0-only
/*
 * Panther device tree source
 *
 * Copyright 2021 Google,LLC
 */

/dts-v1/;
/plugin/;

#include "gs201-common.dtsi"
#include "gs201-cloudripper-battery.dtsi"
#include "gs201-cloudripper-bcl.dtsi"
#include "gs201-cloudripper-bluetooth.dtsi"
#include "gs201-cloudripper-charging.dtsi"
#include "gs201-cloudripper-cp-s5300-sit.dtsi"
#include "gs201-cloudripper-ese.dtsi"
#include "gs201-cloudripper-gsa-gsc.dtsi"
#include "gs201-cloudripper-nfc.dtsi"
#include "gs201-cloudripper-sbbm.dtsi"
#include "gs201-cloudripper-wlan.dtsi"

#include "gs201-ravenclaw-fingerprint.dtsi"
#include "gs201-ravenclaw-wcharger.dtsi"
#include "gs201-ravenclaw-usecases.dtsi"

#include "gs201-pantah-camera-pmic.dtsi"
#include "gs201-cheetah-camera.dtsi"
#include "gs201-panther-display.dtsi"
#include "gs201-panther-pmic.dtsi"
#include "gs201-panther-touch.dtsi"
#include "gs201-panther-thermal.dtsi"
#include "gs201-panther-audio.dtsi"
#include "gs101-faceauth-dma-heap.dtsi"

/ {
	board_id = <0x30402>;
	board_rev = <0x10101>;
	fragment@boardbase {
		target-path="/";
		__overlay__ {
			model = "GS201 PANTHER Proto 1.1 Wingboard based on GS201";
			compatible = "google,GS201 PANTHER", "google,GS201";
		};
	};
};

&serial_0 {
	status = "okay";
};
