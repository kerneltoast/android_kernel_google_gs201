// SPDX-License-Identifier: GPL-2.0-only
/*
 * Google GS101 Whitefin 2 v2 audio device tree source
 *
 * Copyright (c) 2020 Google, LLC
 *		https://www.google.com
 *
*/

#include "gs101-raviole-audio.dtsi"

&aoc_audio_cfg{
	aoc-audio-config = "o6";
};

&aoc {
	board_id = <0x20302>;
	board_rev = <0x10000>;
};
