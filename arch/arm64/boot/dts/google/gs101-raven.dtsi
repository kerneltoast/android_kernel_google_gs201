// SPDX-License-Identifier: GPL-2.0-only
/*
 * Raven DVT common devicetree
 *
 * Copyright 2021 Google,LLC
 */

#include "gs101-raviole.dtsi"
#include "gs101-raven-audio.dtsi"
#include "gs101-raven-battery.dtsi"

#ifndef ORIOLE_EVT_WINGBOARD
#include "gs101-raven-camera.dtsi"
#include "gs101-raven-display.dtsi"
#include "gs101-raven-touch.dtsi"
#include "gs101-raven-uwb.dtsi"
#endif /* ORIOLE_EVT_WINGBOARD */

#include "gs101-raven-wcharger.dtsi"
#include "gs101-raviole-charging.dtsi"
#include "gs101-raviole-usecases.dtsi"
#include "gs101-raven-charging.dtsi"
#include "gs101-raven-bluetooth.dtsi"
