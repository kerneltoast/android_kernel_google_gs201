// SPDX-License-Identifier: GPL-2.0-only
/*
 * Whitefin1-specific s5200 settings.
 *
 * Copyright 2020 Google, LLC.
 *
 */

/ {
	fragment@modemif {
		target-path = "/";
		__overlay__ {
			#address-cells = <2>;
			#size-cells = <1>;
			cpif {
				gpio_cp2ap_phone_active = <&gph1 2 0x1>;

				/*
				 * The pad assignment of CP2AP_ACTIVE is not in PAD_ALIVE
				 * to be registered wake-up source. (Bug 152900487)
				 * CP2AP_ACTIVE is assigned to XEINT_17 for factor designs.
				 */
				mif,cp2ap_active_not_alive = <1>;
			};
		};
	};
};

&pinctrl_6 {
	s5100_cp2ap_phone_active: s5100_cp2ap_phone_active {
		samsung,pins = "gph1-2";
		samsung,pin-function = <EXYNOS_PIN_FUNC_EINT>;
		samsung,pin-pud = <EXYNOS_PIN_PULL_NONE>;
		samsung,pin-con-pdn = <EXYNOS_PIN_PULL_UP>;
	};
};
