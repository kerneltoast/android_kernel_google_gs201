## google-modules/soc/gs/drivers/regulator/Kconfig
```kconfig
# SPDX-License-Identifier: GPL-2.0-only

if REGULATOR

config REGULATOR_MAX77826_GS
	tristate "GS-specific Maxim MAX77826 regulator"
	help
	  If you say yes here you get support for Maxim MAX77826 PMIC.

config DRV_SAMSUNG_PMIC
	tristate "Samsung PMIC sysfs system"
	depends on I2C
	help
	  This driver supports a Samsung PMIC sysfs.
	  The sysfs directory made by this config includes directories of
	  regulator and powermeter of S2MPGs.
	  They provide Speedy read and write function through for debugging.

config REGULATOR_S2MPG10
	tristate "Samsung S2MPG10 voltage regulator"
	depends on MFD_S2MPG10
	help
	  This driver supports a Samsung S2MPG10 voltage output regulator
	  via speedy bus. S2MPG10 is comprised of high efficient Buck converters
	  including Dual-Phase Buck converter, Buck-Boost converter and
	  various LDOs. This driver file includes functions for reading and
	  writing output voltage, controlling operation mode, setting ramp
	  rate of each regulator.

config REGULATOR_S2MPG11
	tristate "Samsung S2MPG11 voltage regulator"
	depends on MFD_S2MPG11
	help
	  This driver supports a Samsung S2MPG11 voltage output regulator
	  via I2C bus. S2MPG11 is comprised of high efficient Buck converters
	  including Dual-Phase Buck converter, Buck-Boost converter and
	  various LDOs. This driver file includes functions for reading and
	  writing output voltage, controlling operation mode, setting ramp
	  rate of each regulator.

config REGULATOR_S2MPG14
	tristate "Samsung S2MPG14 voltage regulator"
	depends on MFD_S2MPG14
	help
	  This driver supports a Samsung S2MPG14 voltage output regulator
	  via spmi bus. S2MPG14 is comprised of high efficient Buck converters
	  including Dual-Phase Buck converter, Buck-Boost converter and
	  various LDOs. This driver file includes functions for reading and
	  writing output voltage, controlling operation mode, setting ramp
	  rate of each regulator.

config REGULATOR_S2MPG15
	tristate "Samsung S2MPG15 voltage regulator"
	depends on MFD_S2MPG15
	help
	  This driver supports a Samsung S2MPG15 voltage output regulator
	  via spmi bus. S2MPG15 is comprised of high efficient Buck converters
	  including Dual-Phase Buck converter, Buck-Boost converter and
	  various LDOs. This driver file includes functions for reading and
	  writing output voltage, controlling operation mode, setting ramp
	  rate of each regulator.

config POWERMETER_S2MPG10
	tristate "Samsung S2MPG10 Powermeter"
	depends on MFD_S2MPG10
	help
	  This driver supports a Samsung S2MPG10 powermeter which has 8 ADC
	  channels for saving current and voltage data of each regulator.
	  The sysfs files in the sysfs directory created by the config
	  DRV_SAMSUNG_PMIC is are made by this driver for debugging.

config POWERMETER_S2MPG11
	tristate "Samsung S2MPG11 Powermeter"
	depends on MFD_S2MPG11
	help
	  This driver supports a Samsung S2MPG11 powermeter which has 8 ADC
	  channels for saving current and voltage data of each regulator.
	  The sysfs files in the sysfs directory created by the config
	  DRV_SAMSUNG_PMIC is are made by this driver for debugging.

config REGULATOR_S2MPG12
	tristate "Samsung S2MPG12 voltage regulator"
	depends on MFD_S2MPG12
	help
	  This driver supports a Samsung S2MPG12 voltage output regulator
	  via I2C bus. S2MPG12 is comprised of high efficient Buck converters
	  including Dual-Phase Buck converter, Buck-Boost converter, various LDOs.

config REGULATOR_S2MPG13
	tristate "Samsung S2MPG13 voltage regulator"
	depends on MFD_S2MPG13
	help
	  This driver supports a Samsung S2MPG13 voltage output regulator
	  via I2C bus. S2MPG13 is comprised of high efficient Buck converters
	  including Dual-Phase Buck converter, Buck-Boost converter, various LDOs.

config POWERMETER_S2MPG14
	tristate "Samsung S2MPG14 Powermeter"
	depends on MFD_S2MPG14
	help
	  This driver supports a Samsung S2MPG14 powermeter which has 14 ADC
	  channels for saving current and voltage data of each regulator.
	  The sysfs files in the sysfs directory created by the config
	  DRV_SAMSUNG_PMIC is are made by this driver for debugging.

config POWERMETER_S2MPG15
	tristate "Samsung S2MPG15 Powermeter"
	depends on MFD_S2MPG15
	help
	  This driver supports a Samsung S2MPG15 powermeter which has 14 ADC
	  channels for saving current and voltage data of each regulator.
	  The sysfs files in the sysfs directory created by the config
	  DRV_SAMSUNG_PMIC is are made by this driver for debugging.

config REGULATOR_SLG51000_GS
	tristate "Dialog Semiconductor SLG51000 regulators for some GS SoCs"
	depends on I2C
	select REGMAP_I2C
	help
	  Say y here to support for the Dialog Semiconductor SLG51000 for GS
	  SOCs. The SLG51000 is seven compact and customizable low dropout
	  regulators.

config REGULATOR_SLG51002
	tristate "Dialog Semiconductor SLG51002 regulators"
	depends on I2C
	select REGMAP_I2C
	help
	  Say y here to support for the Dialog Semiconductor SLG51002.
	  The SLG51002 is eight compact and customizable low dropout
	  regulators.

config REGULATOR_RT6160_GS
	tristate "Richtek RT6160 BuckBoost voltage regulator for some GS SoCs"
	depends on I2C
	select REGMAP_I2C
	help
	  This adds support for voltage regulator in Richtek RT6160.
	  This device automatically change voltage output mode from
	  Buck or Boost. The mode transition depend on the input source voltage.
	  The wide output range is from 2025mV to 5200mV and can be used on most
	  common application scenario.


endif
```

## google-modules/soc/gs/drivers/rtc/Kconfig
```kconfig
# SPDX-License-Identifier: GPL-2.0-only
#
# RTC class/drivers configuration
#

if I2C

config RTC_DRV_S2MPG10
        tristate "Samsung PMIC S2MPG10 RTC"
        depends on MFD_S2MPG10
        help
          If you say yes here you will get support for the
          RTC of Samsung PMIC series.
          This driver can also be built as a module. If so, the module
          will be called rtc-s2mpg10.

config RTC_DRV_S2MPG12
	tristate "Samsung PMIC S2MPG12 RTC"
	depends on MFD_S2MPG12
	help
	  If you say yes here you will get support for the
	  RTC of Samsung PMIC series.
	  This driver can also be built as a module. If so, the module
	  will be called rtc-s2mpg12.

config RTC_DRV_S2MPG14
        tristate "Samsung PMIC S2MPG14 RTC"
        depends on MFD_S2MPG14
        help
          If you say yes here you will get support for the
          RTC of Samsung PMIC series.
          This driver can also be built as a module. If so, the module
          will be called rtc-s2mpg14.

endif # I2C
```

## google-modules/soc/gs/drivers/soc/google/gsa/Kconfig
```kconfig
# SPDX-License-Identifier: GPL-2.0

config GSA
	tristate "GSA driver"
	default n

config GSA_PKVM
	tristate "Support pKVM"
	depends on GSA
	depends on PKVM_S2MPU_V9 || PKVM_S2MPU
	default n

config GSA_GSC
	tristate "GSC Proxy"
	depends on GSA
	default n

config TZ_PROT
	tristate "TZ Prot"
	depends on GSA
	default n
```

## google-modules/soc/gs/drivers/soc/google/s2mpu/Kconfig
```kconfig
# SPDX-License-Identifier: GPL-2.0

config GS_S2MPU
	tristate "S2MPU driver"
	depends on ARM64
	depends on SOC_GS101
```

## google-modules/soc/gs/drivers/soc/google/vh/kernel/sched/Kconfig
```kconfig
# SPDX-License-Identifier: GPL-2.0-only

config VH_SCHED
	tristate "Vendor hooks for kernel scheduler"
	depends on VH_KERNEL
	default n

config VH_SCHED_MAX_CPU_NR
	int "CPU number on this platform"
	default 9

config VH_PREEMPTIRQ_TRACEPOINTS
	tristate "Vendor hooks for long preemptirq trace points"
	depends on VH_SCHED
	default n

config TICK_DRIVEN_LATGOV
	tristate "Service latency governers in sched vh."
	default n

config UCLAMP_STATS
	bool "Uclamp stats"
	depends on VH_SCHED
	default n

config USE_VENDOR_GROUP_UTIL
        bool "Use cpu util based on vendor groups"
        depends on VH_SCHED
        default y

config USE_GROUP_THROTTLE
	bool "Use group throttle of vendor groups"
	depends on VH_SCHED
	default y

config RVH_SCHED_LIB
	bool "Library with additional scheduler options"
	depends on VH_SCHED
	default y

config USE_UPDATE_SINGLE
	bool "Use sugov_update_single function for single-cpu cluster"
	depends on VH_SCHED
	default n

config VH_PRIO_INHERITANCE
	bool "Enable prio inheritance vendor hooks"
	depends on VH_SCHED
	default y
```

## google-modules/soc/gs/drivers/spi/Kconfig
```kconfig
# SPDX-License-Identifier: GPL-2.0-only
#

if SPI
if SPI_MASTER

config SPI_S3C64XX_GS
	tristate "Samsung S3C64XX series type SPI in Google SoCs"
	help
	  SPI driver for Samsung S3C64XX and newer SoCs.

endif # SPI_MASTER
endif # SPI
```

## google-modules/soc/gs/drivers/spmi/Kconfig
```kconfig
# SPDX-License-Identifier: GPL-2.0-only
#

if SPMI

config SPMI_BITBANG
	tristate "SPMI BITBANG Driver"
	default n
	depends on SPMI
	help
		SPMI Bitbang Driver

endif # SPMI
```

## google-modules/soc/gs/drivers/thermal/Kconfig
```kconfig
# SPDX-License-Identifier: GPL-2.0-only
#
# Generic thermal drivers configuration
#

if THERMAL

menu "Samsung thermal drivers"
depends on (ARCH_EXYNOS || SOC_GOOGLE) || COMPILE_TEST
source "$(KCONFIG_SOC_GS_PREFIX)drivers/thermal/samsung/Kconfig"
source "$(KCONFIG_SOC_GS_PREFIX)drivers/thermal/google/Kconfig"
endmenu

endif
```

## google-modules/soc/gs/drivers/thermal/samsung/Kconfig
```kconfig
# SPDX-License-Identifier: GPL-2.0-only
config GS_THERMAL_V3
	tristate "GS thermal management unit driver"
	depends on THERMAL_OF
	depends on HAS_IOMEM
	help
	  If you say yes here you get support for the TMU (Thermal Management
	  Unit) driver for GS SoCs. This driver initialises
	  the TMU, reports temperature and handles cooling action if defined.
	  This driver uses the GS thermal APIs and TMU configuration
	  data from the supported SoCs.

config EXYNOS_ACPM_THERMAL
	tristate "Exynos ACPM TMU plug-in support"
	depends on GS_THERMAL_V3
	help
	  This feature supports ACPM TMU plug-in for Exynos thermal driver.

config EXYNOS_CPU_THERMAL
	tristate "EXYNOS cpu cooling support"
	depends on GS_THERMAL_V3
	help
	  This implements the generic cpu cooling mechanism through frequency
	  reduction. An ACPI version of this already exists
	  (drivers/acpi/processor_thermal.c).
	  This will be useful for platforms using the generic thermal interface
	  and not the ACPI interface.
	  If you want this support, you should say Y here.

config GPU_THERMAL
	tristate "gpu cooling support"
	depends on GS_THERMAL_V3
	help
	  This implements the gpu cooling mechanism through frequency
	  reduction.
	  If you want this support, you should say Y here.

config ISP_THERMAL
	tristate "isp cooling support"
	depends on GS_THERMAL_V3
	help
	  This implements the isp cooling mechanism through fps
	  reduction.
	  If you want this support, you should say Y here.
```

## google-modules/soc/gs/drivers/tty/serial/Kconfig
```kconfig
# SPDX-License-Identifier: GPL-2.0
#
# Serial device configuration
#

config SERIAL_EXYNOS
	tristate "Exynos SoC serial support"
	depends on SERIAL_SAMSUNG
	select SERIAL_CORE
	help
	  Support for the on-chip UARTs on the Samsung Exynos series CPUs,
	  providing /dev/ttySAC0, 1 and 2 (note, some machines may not
	  provide all of these ports, depending on how the serial port
	  pins are configured.

config SERIAL_EXYNOS_UARTS
	int
	depends on SERIAL_EXYNOS
	default 24
	help
	  Select the number of available UART ports for the Samsung
	  Exynos serial driver
```

## google-modules/soc/gs/drivers/usb/Kconfig
```kconfig
# SPDX-License-Identifier: GPL-2.0
#
# USB device configuration
#

if USB_SUPPORT

if USB

source "$(KCONFIG_SOC_GS_PREFIX)drivers/usb/host/Kconfig"

endif

source "$(KCONFIG_SOC_GS_PREFIX)drivers/usb/dwc3/Kconfig"

source "$(KCONFIG_SOC_GS_PREFIX)drivers/usb/gadget/Kconfig"

source "$(KCONFIG_SOC_GS_PREFIX)drivers/usb/typec/Kconfig"

endif # USB_SUPPORT
```

## google-modules/soc/gs/drivers/usb/typec/Kconfig
```kconfig
# SPDX-License-Identifier: GPL-2.0

if TYPEC

source "$(KCONFIG_SOC_GS_PREFIX)drivers/usb/typec/tcpm/Kconfig"

endif # TYPEC
```

## google-modules/soc/gs/drivers/usb/typec/tcpm/Kconfig
```kconfig
# SPDX-License-Identifier: GPL-2.0

source "$(KCONFIG_SOC_GS_PREFIX)drivers/usb/typec/tcpm/google/Kconfig"
```

## google-modules/soc/gs/drivers/usb/typec/tcpm/google/Kconfig
```kconfig
# SPDX-License-Identifier: GPL-2.0-only
#
# Copyright (C) 2021, Google LLC

if TYPEC_TCPM

config USB_PSY
	tristate

config TYPEC_COOLING_DEV
	tristate "USB TYPE-C port cooling device"
	depends on EXTCON
	select THERMAL
	select GOOGLE_VOTABLE
	help
	  Type-C port passive cooling device to throttle when the port is hot.

config GOOGLE_TCPCI_SHIM
	tristate "Type-C Port Controller Shim Interface Driver"
	depends on I2C
	select REGMAP_I2C
	help
	  Type-C Port Controller Shim Interface Driver for TCPCI-compliant
	  controller.

config TYPEC_FUSB307
	tristate "Fairchild FUSB307B Type-C chip driver"
	select USB_PSY
	select GOOGLE_TCPCI_SHIM
	help
	  The Fairchild FUSB307 Type-C chip driver that works with
	  Type-C Port Controller Manager to provide USB PD and USB
	  Type-C functionalities.

config TYPEC_MAX77759
	tristate "Maxim MAX77759 Type-C driver"
	select USB_PSY
	select GOOGLE_TCPCI_SHIM
	help
	  MAX77759 TCPCI driver to interface with TCPM.

config TYPEC_MAX77759_CONTAMINANT
	tristate "Maxim MAX77759 specific contaminant detection routines"
	depends on TYPEC_MAX77759
	help
	  Maxim MAX77759 specific contaminant detection routines.

config TYPEC_MAX77779_CONTAMINANT
        tristate "Maxim MAX77779 specific contaminant detection routines"
        depends on TYPEC_MAX77759
        help
          Maxim MAX77779 specific contaminant detection routiness.

endif # TYPEC_TCPM

config POGO_TRANSPORT
	tristate "Pogo transport management driver"
	depends on TYPEC_MAX77759
	select GOOGLE_LOGBUFFER
	help
	  Pogo transport management driver
```

## google-modules/touch/common/Kconfig
```kconfig
config TOUCHSCREEN_HEATMAP
	tristate "Heatmap support for touchscreen"
	depends on (TOUCHSCREEN_FTS || TOUCHSCREEN_SEC_TS)
	select VIDEOBUF2_VMALLOC
	help
	  Do not explicitly select this option. The drivers that utilize
	  this module must select this in their Kconfig.

config TOUCHSCREEN_TBN
	tristate "Touch Bus Negotiator for Google Pixel"
	depends on (TOUCHSCREEN_FTS || TOUCHSCREEN_SEC_TS)
	help
	  Say Y here if you have a Google Pixel device. This module enables
	  support for kernel touch drivers to coordinate bus access with remote
	  processors (e.g. sensor DSP processor), which is required to enable
	  low power touch gesture detection in processors other than AP.

	  If unsure, say N.

	  To compile this driver as a module, choose M here: the module will be
	  called touch_bus_negotiator.

config TOUCHSCREEN_TBN_AOC_CHANNEL_MODE
	bool "AOC channel mode for TBN"
	depends on TOUCHSCREEN_TBN
	help
	  Say Y here if you want to enable AOC channel mode for TBN.

	  If unsure, say N.

config TOUCHSCREEN_OFFLOAD
	tristate "Touchscreen algorithm offload"
	depends on (TOUCHSCREEN_FTS || TOUCHSCREEN_SEC_TS)
	help
	  Say Y here to enable touchscreen algorithm offload. This module allows
	  the touchscreen driver to feed heatmap data into a char device to be
	  consumed by a client outside the kernel.

	  If unsure, say N.

config GOOG_TOUCH_INTERFACE
	tristate "Google Touch Interface (GTI)"
	depends on TOUCHSCREEN_OFFLOAD
	depends on TOUCHSCREEN_HEATMAP
	help
	  Say Y here if you want to enable the Google Touch Interface driver.

	  If unsure, say N.
```
