## google-modules/touch/goodix/Kconfig
```kconfig
#
# Goodix touchscreen driver configuration
#
menuconfig TOUCHSCREEN_GOODIX_BRL
	tristate "Goodix berlin touchscreen"
	help
	  Say Y here if you have a Goodix berlin series touch controller
	  to your system.

	  If build module, say M.
	  If unsure, say N.

if TOUCHSCREEN_GOODIX_BRL

config TOUCHSCREEN_GOODIX_BRL_SPI
	bool "support SPI bus connection"
	depends on SPI_MASTER
	help
	  Say Y here if the touchscreen is connected via SPI bus.

endif

config TOUCHSCREEN_PM
	bool "touch power manager"
	help
	  Say Y here if the touchscreen is connected via SPI bus.

config TOUCHSCREEN_MOTION_FILTER
	bool "touch motion filter"
	help
	  Say Y here if motion filter is enabled.
```

## google-modules/video/gchips/Kconfig
```kconfig
# SPDX-License-Identifier: GPL-2.0-only
#
# BigWave configuration
#
comment "BigWave video codec"

config BIGWAVE
	tristate "BigWave video codec"
	depends on EXYNOS_BTS
	default n
	select PM
	help
	Driver for BigWave video codec
```

## gs201_defconfig
```kconfig
# In-tree kernel configs. Note that these configs are only applied to
# non-GKI modules. Make sure they're compatible with GKI.
CONFIG_LOG_BUF_SHIFT=22
# CONFIG_MODULE_SIG_ALL is not set
CONFIG_CFG80211=m
CONFIG_NL80211_TESTMODE=y
# CONFIG_CFG80211_DEFAULT_PS is not set
# CONFIG_CFG80211_CRDA_SUPPORT is not set
CONFIG_MAC80211=m
CONFIG_EEPROM_AT24=m
CONFIG_CHR_DEV_SG=m
CONFIG_I2C_CHARDEV=m
CONFIG_SPI_SPIDEV=m
CONFIG_SOFT_WATCHDOG=m
CONFIG_ARM_DSU_PMU=m

# private/google-modules/soc/gs/drivers/block/zram/Kconfig
CONFIG_ZRAM_GS=m
CONFIG_ZCOMP_CPU=m
CONFIG_ZCOMP_EH=m
CONFIG_ZRAM_GS_WRITEBACK=y

# private/google-modules/soc/gs/drivers/bts/Kconfig
CONFIG_EXYNOS_BTS=m

# private/google-modules/soc/gs/drivers/clk/gs/Kconfig
CONFIG_EXYNOS_GS_COMMON_CLK=m

# private/google-modules/soc/gs/drivers/clocksource/Kconfig
CONFIG_CLKSRC_EXYNOS_MCT_GS=m

# private/google-modules/soc/gs/drivers/cpufreq/Kconfig
CONFIG_ARM_EXYNOS_ACME=m

# private/google-modules/soc/gs/drivers/devfreq-whi/google/Kconfig
CONFIG_ARM_EXYNOS_DEVFREQ=m
CONFIG_EXYNOS_ALT_DVFS=m

# private/google-modules/soc/gs/drivers/dma-buf/heaps/Kconfig
CONFIG_DMABUF_SAMSUNG_HEAPS=m
CONFIG_DMABUF_HEAPS_SAMSUNG_CHUNK=y
CONFIG_DMABUF_HEAPS_SAMSUNG_CMA=y
CONFIG_DMABUF_HEAPS_SAMSUNG_CARVEOUT=y
CONFIG_DMABUF_HEAPS_SAMSUNG_SYSTEM=y

# private/google-modules/soc/gs/drivers/dma/Kconfig
CONFIG_SAMSUNG_DMADEV=m

# private/google-modules/soc/gs/drivers/i2c/busses/Kconfig
CONFIG_I2C_EXYNOS5_GS=m
CONFIG_I2C_ACPM=m

# private/google-modules/soc/gs/drivers/iio/Kconfig
CONFIG_ODPM=m

# private/google-modules/soc/gs/drivers/input/Kconfig
CONFIG_INPUT_KEYDEBUG=m
CONFIG_INPUT_STMVL53L1=m
CONFIG_GOODIX_FINGERPRINT=m
CONFIG_KEYBOARD_S2MPG12=m

# private/google-modules/soc/gs/drivers/iommu/Kconfig
CONFIG_SAMSUNG_IOMMU=m
CONFIG_EXYNOS_PCIE_IOMMU=m
CONFIG_IOVAD_BEST_FIT_ALGO=m

# private/google-modules/soc/gs/drivers/media/platform/Kconfig
CONFIG_VIDEO_EXYNOS_MFC=m
CONFIG_VIDEO_EXYNOS_SMFC=m

# private/google-modules/soc/gs/drivers/mfd/Kconfig
CONFIG_MFD_S2MPG12=m
CONFIG_MFD_S2MPG13=m
CONFIG_MFD_S2MPG1X_GPIO=m
CONFIG_MFD_SLG51000=m
CONFIG_MFD_SLG51002=m

# private/google-modules/soc/gs/drivers/misc/Kconfig
CONFIG_SUBSYSTEM_COREDUMP=m
CONFIG_SBB_MUX=m

# private/google-modules/soc/gs/drivers/pci/controller/dwc-whi/Kconfig
CONFIG_PCI_EXYNOS_GS=m
CONFIG_PCI_EXYNOS_CAL_GS201=m

# private/google-modules/soc/gs/drivers/performance/gs_perf_mon/Kconfig
CONFIG_GS_PERF_MON=m

# private/google-modules/soc/gs/drivers/performance/lat_governors/Kconfig
CONFIG_GS_MEMLAT_GOVERNOR=m

# private/google-modules/soc/gs/drivers/phy/Kconfig
CONFIG_PHY_EXYNOS_USBDRD=m
CONFIG_PHY_SAMSUNG_USB_GEN2_V4=y
CONFIG_PHY_EXYNOS_MIPI=m
CONFIG_PHY_EXYNOS_MIPI_DSIM=m

# private/google-modules/soc/gs/drivers/pinctrl/Kconfig
CONFIG_PINCTRL_EXYNOS_GS=m
CONFIG_PINCTRL_SLG51000=m
CONFIG_PINCTRL_SLG51002=m

# private/google-modules/soc/gs/drivers/power/Kconfig
CONFIG_DEBUG_REBOOT=m

# private/google-modules/soc/gs/drivers/pwm/Kconfig
CONFIG_PWM_EXYNOS=m

# private/google-modules/soc/gs/drivers/regulator/Kconfig
CONFIG_REGULATOR_S2MPG12=m
CONFIG_REGULATOR_S2MPG13=m
CONFIG_REGULATOR_SLG51000_GS=m
CONFIG_REGULATOR_SLG51002=m

# private/google-modules/soc/gs/drivers/rtc/Kconfig
CONFIG_RTC_DRV_S2MPG12=m

# private/google-modules/soc/gs/drivers/soc/google/Kconfig
CONFIG_SOC_GOOGLE=y
CONFIG_SOC_GS201=y
CONFIG_BOARD_CLOUDRIPPER=y
CONFIG_GS_CHIPID=m
CONFIG_EXYNOS_BCM_DBG=m
CONFIG_EXYNOS_BCM_DBG_PPMU=y
CONFIG_CAL_IF=m
CONFIG_EXYNOS_PMU_IF=m
CONFIG_EXYNOS_PD=m
CONFIG_EXYNOS_PD_DBG=m
CONFIG_EXYNOS_PM=m
CONFIG_EXYNOS_CPUPM=m
CONFIG_GS_ACPM=m
CONFIG_ACPM_FLEXPMU_DBG=m
CONFIG_ACPM_POWER_STATS=m
CONFIG_ACPM_MBOX_TEST=m
CONFIG_ACPM_DVFS=m
CONFIG_ECT=m
CONFIG_EXYNOS_DVFS_MANAGER=m
CONFIG_EXYNOS_PM_QOS=m
CONFIG_EXYNOS_CPUHP=m
CONFIG_SLC_PARTITION_MANAGER=m
CONFIG_GS_SLC_ACPM=m
CONFIG_SLC_PMON=y
CONFIG_PIXEL_STAT=m
CONFIG_EXYNOS_SECURE_LOG=m
CONFIG_EXYNOS_CONTENT_PATH_PROTECTION=m
CONFIG_GOOGLE_MODEMCTL=m
CONFIG_GSA=m
CONFIG_GSA_PKVM=m
CONFIG_GSA_GSC=m
CONFIG_DEBUG_SNAPSHOT=m
CONFIG_DEBUG_SNAPSHOT_DEBUG_KINFO=m
CONFIG_EXYNOS_EHLD=m
CONFIG_EXYNOS_DEBUG_TEST=m
CONFIG_PIXEL_DEBUG_TEST=m
CONFIG_EXYNOS_ITMON=m
CONFIG_EXYNOS_CORESIGHT=m
CONFIG_EXYNOS_ECC_HANDLER=m
CONFIG_EXYNOS_CORESIGHT_ETM=m
CONFIG_EXYNOS_CORESIGHT_ETF=y
CONFIG_EXYNOS_CORESIGHT_ETR=y
CONFIG_EXYNOS_ADV_TRACER=m
CONFIG_EXYNOS_ADV_TRACER_S2D=m
CONFIG_PIXEL_BOOT_METRICS=m
CONFIG_PIXEL_SUSPEND_DIAG=m
CONFIG_GS_SJTAG=m
CONFIG_ETM2DRAM=m
CONFIG_SMRA=m
CONFIG_VH_SYSTRACE=m
CONFIG_PIXEL_EM=m
CONFIG_PIXEL_METRICS=m
CONFIG_VH_FS=m
CONFIG_VH_MM=m
CONFIG_VH_CGROUP=m
CONFIG_VH_THERMAL=m
CONFIG_VH_SCHED=m
CONFIG_VH_SCHED_MAX_CPU_NR=8
CONFIG_VH_PREEMPTIRQ_TRACEPOINTS=m
CONFIG_TICK_DRIVEN_LATGOV=y
CONFIG_HARDLOCKUP_DEBUG=m
CONFIG_HARDLOCKUP_WATCHDOG=m
CONFIG_DBGCORE_DUMP=m
CONFIG_SYSRQ_HOOK=m
CONFIG_PKVM_S2MPU=m
CONFIG_KERNEL_TOP=m

# private/google-modules/soc/gs/drivers/spi/Kconfig
CONFIG_SPI_S3C64XX_GS=m

# private/google-modules/soc/gs/drivers/thermal/Kconfig
CONFIG_GS_THERMAL_V3=m
CONFIG_EXYNOS_ACPM_THERMAL=m
CONFIG_EXYNOS_CPU_THERMAL=m
CONFIG_GPU_THERMAL=m
CONFIG_GSOC_PMIC_THERMAL=m

# private/google-modules/soc/gs/drivers/tty/serial/Kconfig
CONFIG_SERIAL_EXYNOS=m

# private/google-modules/soc/gs/drivers/ufs/Kconfig
CONFIG_SCSI_UFS_EXYNOS_GS=m
CONFIG_SCSI_UFS_CRYPTO_SW_KEYS_MODE=y
CONFIG_SCSI_UFS_PIXEL_FIPS140=m

# private/google-modules/soc/gs/drivers/usb/Kconfig
CONFIG_USB_XHCI_EXYNOS=m
CONFIG_USB_DWC3_EXYNOS_GS=m
CONFIG_USB_CONFIGFS_F_DM=m
CONFIG_USB_CONFIGFS_F_ETR_MIU=m
CONFIG_TYPEC_COOLING_DEV=m
CONFIG_TYPEC_MAX77759=m
CONFIG_TYPEC_MAX77759_CONTAMINANT=m
CONFIG_TYPEC_MAX77779_CONTAMINANT=m

# private/google-modules/soc/gs/drivers/video/Kconfig
CONFIG_EXYNOS_GRAPHICS_G2D=m

# private/google-modules/soc/gs/drivers/video/backlight/Kconfig
CONFIG_BACKLIGHT_RT4539_GS=m

# private/google-modules/soc/gs/drivers/watchdog/Kconfig
CONFIG_S3C2410_WATCHDOG_GS=m
CONFIG_S3C2410_SHUTDOWN_REBOOT=y

# private/google-modules/bms/misc/Kconfig
CONFIG_GOOGLE_LOGBUFFER=m

# private/google-modules/display/common/Kconfig
CONFIG_GS_DRM_PANEL_UNIFIED=m

# private/google-modules/display/samsung/Kconfig
CONFIG_DRM_SAMSUNG=m
CONFIG_DRM_SAMSUNG_DP=y
CONFIG_DRM_SAMSUNG_DP_AUDIO=y

# private/google-modules/display/samsung/panel/Kconfig
CONFIG_DRM_PANEL_GOOGLE_COMMON=m
CONFIG_DRM_PANEL_SAMSUNG_COMMON=m
CONFIG_DRM_PANEL_SAMSUNG_EMUL=m
CONFIG_DRM_PANEL_SAMSUNG_S6E3HC2=m
CONFIG_DRM_PANEL_SAMSUNG_S6E3FC3=m
CONFIG_DRM_PANEL_SAMSUNG_S6E3FC3_P10=m
CONFIG_DRM_PANEL_SAMSUNG_SOFEF01=m
CONFIG_DRM_PANEL_SAMSUNG_S6E3HC3=m
CONFIG_DRM_PANEL_SAMSUNG_S6E3HC3_C10=m
CONFIG_DRM_PANEL_SAMSUNG_S6E3HC4=m
CONFIG_DRM_PANEL_BOE_NT37290=m

# private/google-modules/fingerprint/goodix/fps_touch_handler/Kconfig
CONFIG_FPS_TOUCH_HANDLER=m

# private/google-modules/power/mitigation/Kconfig
CONFIG_GOOGLE_BCL=m

# private/google-modules/power/reset/Kconfig
CONFIG_PIXEL_POWER_REBOOT=m

# private/google-modules/trusty/drivers/trusty/Kconfig
CONFIG_TRUSTY=m
CONFIG_TRUSTY_DMA_BUF_FFA_TAG=y
CONFIG_TRUSTY_CRASH_IS_PANIC=y
```

## mali_kbase/platform/pixel/Kconfig
```kconfig
# SPDX-License-Identifier: GPL-2.0

#
# Mali Pixel integration configuration
#
# Copyright 2020 Google LLC.
#

config MALI_PIXEL_GPU_QOS
	bool "Enable QOS requests for GPU"
	depends on MALI_MIDGARD_DVFS && PM_DEVFREQ && CPU_FREQ
	default y
	help
		Turns on quality of service (QOS) requests on MIF, INT
		and the CPU clusters based on GPU utilization. Frequency
		values, thresholds and hysteresis valus are specified for
		each GPU OPP in the GPU device tree entry.

config MALI_PIXEL_GPU_BTS
	bool "Enable Bus Traffic Shaping for GPU"
	depends on MALI_PIXEL_GPU_QOS && EXYNOS_BTS
	default y
	help
		Enables the setting of Bus Traffic Shaping scenarios when
		GPU utilization is at a specific level. Configuration for
		this feature is specified on the GPU device tree entry and
		allows for setting the BTS scenario to use, and the GPU OPP
		at which it is triggered.

config MALI_PIXEL_GPU_THERMAL
	bool "Enable support for constraining GPU clocks due to thermal events"
	depends on MALI_MIDGARD_DVFS && GPU_THERMAL && EXYNOS_THERMAL_V2
	default y
	help
		Sets up the GPU driver to register for thermal events that
		require it to clock down the GPU to remain within thermal
		bounds.

config MALI_PIXEL_GPU_SECURE_RENDERING
	bool "Enable Pixel GPU Secure Rendering Support"
	depends on MALI_MIDGARD && ION_EXYNOS && EXYNOS_CONTENT_PATH_PROTECTION
	default y
	help
		Enables support for the GPU to render into secure memory.
```

## misc/Kconfig
```kconfig
config GOOGLE_VOTABLE
	tristate "Google votable interface"
	help
	  Say Y here to enable the google voter API. The module is used from
	  GBMS to arbitrate the access and manage the state of shared resources.

	  To compile this driver as a module, choose M here: the module will be
	  called gvotable.

config GOOGLE_LOGBUFFER
	tristate "Google logbuffer"
	help
	  Say Y here to enable the logbuffer driver from Google LLC. The driver
	  exposes an API that allow drivers in GBMS and TCPM to log internal
	  and debug information that cannot be routed to syslog to a separate
	  ringbuffer. The content of the ringbuffer is accessible as a character
	  device.

	  To compile this driver as a module, choose M here: the module will be
	  called logbuffer.
```

## pantah_defconfig
```kconfig
# private/google-modules/radio/samsung/s5300/Kconfig
CONFIG_EXYNOS_MODEM_IF=m
CONFIG_SEC_MODEM_S5100=m
CONFIG_SHM_IPC=m
CONFIG_CP_PKTPROC=m
CONFIG_CP_PKTPROC_UL=m
CONFIG_MODEM_IF_QOS=m
CONFIG_CPIF_AP_SUSPEND_DURING_VOICE_CALL=y
CONFIG_CPIF_TP_MONITOR=m
CONFIG_LINK_DEVICE_PCIE_IOCC=y
CONFIG_LINK_DEVICE_PCIE_IOMMU=y
CONFIG_CH_EXTENSION=m
CONFIG_CP_THERMAL=m

# private/google-modules/touch/common/Kconfig
CONFIG_TOUCHSCREEN_TBN=m
CONFIG_TOUCHSCREEN_OFFLOAD=m
CONFIG_GOOG_TOUCH_INTERFACE=m

# private/google-modules/touch/sec/Kconfig
CONFIG_TOUCHSCREEN_SEC_TS=m
```

## samsung/Kconfig
```kconfig
config DRM_SAMSUNG
	tristate "DRM Support for Samsung EXYNOS Series"
	depends on OF && DRM && (SOC_EXYNOS9820 || SOC_GS101 || SOC_GS201) && ION
	select DRM_KMS_HELPER
	select VIDEOMODE_HELPERS
	help
	  Choose this option if you have a Samsung EXYNOS SoC chipset.
	  If M is selected the module will be called exynosdrm. It will
	  control various panel drivers and display hardware on Samsung
	  Exynos SoC chipset.

if DRM_SAMSUNG

config DRM_SAMSUNG_DPP
	bool "DPP on Exynos"
	default DRM_SAMSUNG
	depends on DRM_SAMSUNG
	help
	  This enables support for DPP(Display Pre Processor) device on
	  Samsung Exynos SoC. It will support scaling, rotation, compression
	  and so on.

comment "CRTCs"

config DRM_SAMSUNG_DECON
	bool "DECON on Exynos"
	depends on !FB_S3C && !DRM_EXYNOS
	default DRM_SAMSUNG
	help
	  Choose this option if you want to use Exynos DECON for DRM. It
	  will control DECON hardware. It can blend all windows connected
	  to DPP.

comment "Encoders and Bridges"

config DRM_SAMSUNG_DSI
	bool "MIPI-DSI host"
	depends on DRM_SAMSUNG_DECON
	select DRM_MIPI_DSI
	select DRM_PANEL
	default DRM_SAMSUNG
	help
	  This enables support for Exynos MIPI-DSI device. It will encode
	  data as mipi standard and transfer to the mipi panel. It also
	  supports to read and write mipi command to and from the mipi panel.
	  So, this driver can use various panel feature.

config DRM_SAMSUNG_WB
	bool "WB on Exynos"
	depends on DRM_SAMSUNG_DECON
	default DRM_SAMSUNG
	help
	  This enables support for Exynos Concurrent Writeback device.
	  It can be attached writeback at runtime. It will dump blended
	  output buffer which is displaying on LCD.
	  This means that both writeback and LCD display can be operated
	  simultaneously.

endif
```

## tas256x/Kconfig
```kconfig
menuconfig SND_SOC_TAS256X
    tristate "Texas Instruments TAS256X SmartAmp(R)"

if SND_SOC_TAS256X
config TAS256X_REGMAP
    bool "Use of RegMap API"
    depends on SND_SOC_TAS256X
    help
      Enable support for TAS256X regmap driver.
      This includes i2c i2c driver structure,
      IRQ processing, registers read and write
      by i2c operations.

config TAS256X_CODEC
    bool "Codec Driver support"
    depends on SND_SOC_TAS256X
    help
      Enable support for TAS256X codec driver.
      This includes codec driver interfaces
      and functions.

config PLATFORM_EXYNOS
    bool "Exynos platform support"
    depends on SND_SOC_TAS256X
    default n
    help
      Enable support for Exynos platform.

config TAS25XX_ALGO
    bool "TAS256X Calib Driver Support"
    depends on SND_SOC_TAS256X
    help
      Enable support for TAS25XX Calibration driver.
      This includes TAS256X Calibration driver interfaces
      and functions.

config PLATFORM_QCOM
    bool "QCOM platform support"
    depends on TAS25XX_ALGO
    default y
    help
      Enable support for Qcom platform.

config TAS256X_REGBIN_PARSER
    bool "REG Bin File support"
    depends on SND_SOC_TAS256X
    default y
    help
      Enable support for REG Bin File.

config TISA_KBIN_INTF
    bool "Kbin file method support"
    depends on SND_SOC_TAS256X
    default n
    help
      Enable support for KBin file method

config CONFIG_TAS25XX_CALIB_VAL_BIG
    bool "For bigdata & calibration support"
    depends on SND_SOC_TAS256X
    default n
    help
      Enable support for bigdata & calibration.

#config TAS2558_CODEC

config TAS256X_MISC
    bool "Misc Driver support"

endif # SND_SOC_TAS256X
```
