## google-modules/bms/Documentation/devicetree/bindings/bms/hl7132.yaml
```yaml
# SPDX-License-Identifier: (GPL-2.0-only OR BSD-2-Clause)
# Copyright 2024 Google LLC
%YAML 1.2
---

$schema: http://devicetree.org/meta-schemas/core.yaml#

title: Google HL7132 driver

maintainers:
  - Baltazar Ortiz <baltazarortiz@google.com>

description:
  HL7132 parallel charger driver.

properties:
  # A dictionary of DT properties for this binding schema
  compatible:
    enum:
      - hl7132

  hl7132,psy_name:
    description: HL7132 power supply name
    $ref: /schemas/types.yaml#/definitions/string

  hl7132,vbat_reg-voltage:
    description: VBAT regulation threshold
    $ref: /schemas/types.yaml#/definitions/uint32

  hl7132,input-itopoff:
    description: Input topoff current
    $ref: /schemas/types.yaml#/definitions/uint32

  hl7132,switching-frequency:
    description: Switching frequency value.
    $ref: /schemas/types.yaml#/definitions/uint32

  hl7132,usb-port-tz-name:
    description: USB connector thermal zone
    $ref: /schemas/types.yaml#/definitions/string

  hl7132,google_cpm:
    description: google_cpm phandle

required:
  - compatible
  - reg
  - pinctrl-names
```

## google-modules/bms/Documentation/devicetree/bindings/bms/ln8411_driver.yaml
```yaml
# SPDX-License-Identifier: GPL-2.0
# Copyright 2024 Google LLC
%YAML 1.2
---

$schema: http://devicetree.org/meta-schemas/core.yaml#

title: LN8411 driver

maintainers:
  - Prasanna Prapancham <prapancham@google.com>

description: |
  LN8411 Parallel Charger driver.

properties:
  # A dictionary of DT properties for this binding schema
  compatible:
    enum:
      - ln8411

  reg:
    description: i2c address of the charger.

  ln8411,psy_name:
    description: ln8411 charger power supply name
    $ref: /schemas/types.yaml#/definitions/string

  ln8411,irq-gpio:
    description: IRQ gpio

  ln8411,input-current-limit:
    description: Input current limit.
    $ref: /schemas/types.yaml#/definitions/uint32

  ln8411,ta-max-vol-4_1:
    description: Travel Adapter 4-1 mode max voltage limit.
    $ref: /schemas/types.yaml#/definitions/uint32

  ln8411,ta-max-vol-2_1:
    description: Travel Adapter 2-1 mode max voltage limit.
    $ref: /schemas/types.yaml#/definitions/uint32

  ln8411,input-itopoff:
    description: Input topoff current. Used to detect end of charge. Units -uV
    $ref: /schemas/types.yaml#/definitions/uint32

  ln8411,iin-max-offset:
    description: Max input current offset. Units uA.
    $ref: /schemas/types.yaml#/definitions/uint32

  ln8411,iin-cc_comp-offset:
    description: Max input constant charge current compensation offset. Units uA.
    $ref: /schemas/types.yaml#/definitions/uint32

  ln8411,si-fet-ovp-drive:
    description: Set safety switch to 10V Si FET
    type: boolean

  google,usb-port-tz-name:
    description: USBC thermal zone name
    $ref: /schemas/types.yaml#/definitions/string

  ln8411,google_cpm:
    description: Google CPM phandle
    $ref: /schemas/types.yaml#/definitions/phandle

  ln8411_gpio:
    description: ln8411 GPIO controller config

required:
  - compatible
  - reg
  - gpio-controller
```

## google-modules/bms/Documentation/devicetree/bindings/bms/max20339.yaml
```yaml
# SPDX-License-Identifier: GPL-2.0
# Copyright 2024 Google LLC
%YAML 1.2
---

$schema: http://devicetree.org/meta-schemas/core.yaml#

title: max20339 driver

maintainers:
  - Daniel Okazaki <dtokazaki@google.com>
  - Prasanna Prapancham <prapancham@google.com>
  - Jack Wu <wjack@google.com>
  - Ken Yang <yangken@google.com>
  - Baltazar Ortiz <baltazarortiz@google.com>

description: |
  Overvoltage protection device

properties:
  # A dictionary of DT properties for this binding schema
  compatible:
    enum:
      - max20339ovp

  reg:
    description: i2c address of the device.

  max20339,irq-gpio:
    description: IRQ gpio

  max20339_gpio:
    description: max20339 GPIO controller config

required:
  - compatible
  - reg
  - gpio-controller
```

## google-modules/bms/Documentation/devicetree/bindings/bms/max77729_charger.yaml
```yaml
# SPDX-License-Identifier: GPL-2.0
# Copyright 2024 Google LLC
%YAML 1.2
---

$schema: http://devicetree.org/meta-schemas/core.yaml#

title: max77729 charger driver

maintainers:
  - Daniel Okazaki <dtokazaki@google.com>
  - Prasanna Prapancham <prapancham@google.com>
  - Jack Wu <wjack@google.com>
  - Ken Yang <yangken@google.com>
  - Baltazar Ortiz <baltazarortiz@google.com>

description: |
  max77729 charger driver.

properties:
  # A dictionary of DT properties for this binding schema
  compatible:
    enum:
      - maxim,max77729chrg

  reg:
    description: i2c address of the charger.

  max77729,psy-name:
    description: max77729 charger power supply name
    $ref: /schemas/types.yaml#/definitions/string

  max77729,irq-gpio:
    description: IRQ gpio

required:
  - compatible
  - reg
```

## google-modules/bms/Documentation/devicetree/bindings/bms/max77729_pmic.yaml
```yaml
# SPDX-License-Identifier: GPL-2.0
# Copyright 2024 Google LLC
%YAML 1.2
---

$schema: http://devicetree.org/meta-schemas/core.yaml#

title: max77729 pmic driver

maintainers:
  - Daniel Okazaki <dtokazaki@google.com>
  - Prasanna Prapancham <prapancham@google.com>
  - Jack Wu <wjack@google.com>
  - Ken Yang <yangken@google.com>
  - Baltazar Ortiz <baltazarortiz@google.com>

description: |
  max77729/max77759 pmic driver

properties:
  # A dictionary of DT properties for this binding schema
  compatible:
    enum:
      - maxim,max77729pmic
      - maxim,max77759pmic

  reg:
    description: i2c address of the pmic.

  max77759,max_m5:
    description: Fuel Gauge driver phandle
    $ref: /schemas/types.yaml#/definitions/phandle

  goog,maxq-poll:
    description: Enable polling mode in maxq opcode driver.
    type: boolean

  max777x9,irq-gpio:
    description: IRQ gpio

  max777x9_gpio:
    description: GPIO controller configuration

required:
  - compatible
  - reg
  - pinctrl-names
  - pinctrl-0
```

## google-modules/bms/Documentation/devicetree/bindings/bms/max77759_charger.yaml
```yaml
# SPDX-License-Identifier: GPL-2.0
# Copyright 2024 Google LLC
%YAML 1.2
---

$schema: http://devicetree.org/meta-schemas/core.yaml#

title: max77759 charger driver

maintainers:
  - Daniel Okazaki <dtokazaki@google.com>
  - Prasanna Prapancham <prapancham@google.com>
  - Jack Wu <wjack@google.com>
  - Ken Yang <yangken@google.com>
  - Baltazar Ortiz <baltazarortiz@google.com>

description: |
  max77759 charger driver

properties:
  # A dictionary of DT properties for this binding schema
  compatible:
    enum:
      - maxim,max77759chrg

  reg:
    description: i2c address of the charger.

  max77759,psy-name:
    description: max77759 charger power supply name
    $ref: /schemas/types.yaml#/definitions/string

  google,max77759-thm2-monitor:
    description: Enable thm2 monitoring
    type: boolean

  max77759,usb-mon:
    description: When not set, disables thm2 monitoring.
    When set, leaves thm2 register as is.
    type: boolean

  max77759,otg-fccm-vbatt-upperbd:
    description: Upper batt voltage threshold to enable external boost for OTG.
    $ref: /schemas/types.yaml#/definitions/uint32

  max77759,otg-fccm-vbatt-lowerbd:
    description: Lower batt voltage threshold to disable external boost for OTG.
    $ref: /schemas/types.yaml#/definitions/uint32

  max77759,chg-term-voltage:
    description: Charge termination voltage.
    $ref: /schemas/types.yaml#/definitions/uint32

  max77759,chg-term-volt-debounce:
    description: Charge termination voltage debounce voltage.
    $ref: /schemas/types.yaml#/definitions/uint32

  max77759,usb-otg-mv:
    description: OTG bypass output voltage
    $ref: /schemas/types.yaml#/definitions/uint32

  max77759,dcin-is-dock:
    description: DC input is a dock.
    type: boolean

  max77759,wcin-inlim-period:
    description: Number of milliseconds between ilim tracking polling.
    $ref: /schemas/types.yaml#/definitions/uint32

  max77759,wcin-inlim-headroom:
    description: Headroom above actual current allowed.
    $ref: /schemas/types.yaml#/definitions/uint32

  max77759,wcin_inlim_step:
    description: Maximum step size per timestep.
    $ref: /schemas/types.yaml#/definitions/uint32

  max77759_gpio:
    description: GPIO controller config.

  max77759,irq-gpio:
    description: IRQ gpio

  max77759,pmic:
    description: max77759 PMIC device phandle.
    $ref: /schemas/types.yaml#/definitions/phandle

  max77759,max_m5:
    description: max77759 Fuel Gauge device phandle.
    $ref: /schemas/types.yaml#/definitions/phandle

  max77759,dc-psy-type-wireless:
    description: DC input is a wireless power supply.
    type: boolean

  max77759,dc-psy-name:
    description: Name of DC power supply
    $ref: /schemas/types.yaml#/definitions/string

  max77759,bst-on:
    description: external boost enable gpio.

  max77759,bst-sel:
    description: external boost select gpio.

  max77759,extbst-ctl:
    description: external boost control gpio.

  max77759,pogo-ovp-en:
    description: pogo pin charging overvoltage protection enable gpio.

  max77759,pogo-vout-sw-en:
    description: pogo pin charging vout software enable gpio.

  max77759,vin-is_valid:
    description: NBC workaround for OTG gpio.

  max77759,lsw1-is_closed:
    description: Load switch 1 closed gpio.

  max77759,lsw1-is_open:
    description: Load switch 1 open gpio.

  max77759,otg-enable:
    description: OTG enable gpio.

  max77759,wlc-en:
    description: WLC enable gpio.

  max77759,wlc-vbus_en:
    description: WLC vbus enable gpio.

  max77759,cpout-en:
    description: WLC cpout gpio

  max77759,wlc-spoof:
    description: WLC spoof gpio. Used during thermal throttling.

  max77759,cpout-ctl:
    description: WLC cpout control gpio.

  max77759,cpout_21-en:
    description: WLC cpout control gpio. 2:1 cpout mode.

  max77759,ls1-en:
    description: Load Switch 1 enable gpio.

  max77759,ls2-en:
    description: Load Switch 2 enable gpio.

  max77759,sw-en:
    description: OTG+RTXL enable gpio.

  max77759,extbst-mode:
    description: External boost mode gpio.

  max77759,rx-to-rx-otg-en:
    description: wlc_rx to wlc_rx + otg supported.
    type: boolean

  max77759,ext-otg-only:
    description: external boost OTG only.
    type: boolean

  max77759,bst-lsw-sequence:
    description: use boost on first on/off sequence of wlc_tx.
    type: boolean

  max77759,wlc-otg-extbst-en:
    description: only enable external boost when in wlc+otg mode
    type: boolean

  max77759,gpio_dc_switch:
    description: WLC DC mode enable gpio.

required:
  - compatible
  - reg
  - #thermal-sensor-cells

dependencies:
  max77759,otg-fccm-vbatt-lowerbd: [ 'max77759,otg-fccm-vbatt-upperbd' ]
  max77759,chg-term-volt-debounce: [ 'max77759,chg-term-voltage' ]
```

## google-modules/bms/Documentation/devicetree/bindings/bms/max77779_charger.yaml
```yaml
# SPDX-License-Identifier: GPL-2.0
# Copyright 2024 Google LLC
%YAML 1.2
---

$schema: http://devicetree.org/meta-schemas/core.yaml#

title: max77779 charger driver

maintainers:
  - Daniel Okazaki <dtokazaki@google.com>
  - Prasanna Prapancham <prapancham@google.com>
  - Jack Wu <wjack@google.com>
  - Ken Yang <yangken@google.com>
  - Baltazar Ortiz <baltazarortiz@google.com>

description: |
  max77779 charger driver.

properties:
  # A dictionary of DT properties for this binding schema
  compatible:
    enum:
      - maxim,max77779chrg-i2c

  reg:
    description: address of the charger.

  max77779,psy-name:
    description: max77779 charger power supply name
    $ref: /schemas/types.yaml#/definitions/string

  google,max77779-thm2-monitor:
    description: Enable thm2 monitoring
    type: boolean

  max77779,usb-mon:
    description: When not set, disables thm2 monitoring.
    When set, leaves thm2 register as is.
    type: boolean

  max77779,chg-term-voltage:
    description: Charge termination voltage.
    $ref: /schemas/types.yaml#/definitions/uint32

  max77779,chg-term-volt-debounce:
    description: Charge termination voltage debounce voltage.
    $ref: /schemas/types.yaml#/definitions/uint32

  max77779,usb-otg-mv:
    description: OTG bypass output voltage
    $ref: /schemas/types.yaml#/definitions/uint32

  max77779,dcin-is-dock:
    description: DC input is a dock.
    type: boolean

  max77779,wcin-inlim-period:
    description: Number of milliseconds between ilim tracking polling.
    $ref: /schemas/types.yaml#/definitions/uint32

  max77779,wcin-inlim-headroom:
    description: Headroom above actual current allowed.
    $ref: /schemas/types.yaml#/definitions/uint32

  max77779,wcin_inlim_step:
    description: Maximum step size per timestep.
    $ref: /schemas/types.yaml#/definitions/uint32

  max77779_gpio:
    description: GPIO controller config.

  max77779,dc-psy-type-wireless:
    description: DC input is a wireless power supply.
    type: boolean

  max77779,dc-psy-name:
    description: Name of DC power supply
    $ref: /schemas/types.yaml#/definitions/string

  max77779,disable-internal-irq-handler:
    description: Only run the top level charger interrupt handler and route to
    registered IRQ handlers. Skip the internal IRQ handler.
    type: boolean

  max77779,pmic:
    description: max77779 PMIC device phandle.
    $ref: /schemas/types.yaml#/definitions/phandle

  max77779,bst-on:
    description: external boost enable gpio.

  max77779,extbst-ctl:
    description: external boost control gpio.

  max77779,extbst-mode:
    description: External boost mode gpio.

  max77779,wlc-en:
    description: WLC enable gpio.

  max77779,wlc-spoof:
    description: WLC spoof gpio. Used during thermal throttling.

  max77779,wlc-spoof-vbyp:
    description: WLC spoof vbypass gpio.

  max77779,rx-to-rx-otg-en:
    description: wlc_rx to wlc_rx + otg supported.
    type: boolean

  max77779,ext-otg-only:
    description: external boost OTG only.
    type: boolean

  max77779,reverse_12-en:
    description: reverse 1:2 mode supported.
    type: boolean

  max77779,rtx-ready:
    description: RTX usecase ready gpio.

  max77779,rtx-available:
    description: RTX usecase available gpio.

required:
  - compatible
  - reg

dependencies:
  max77779,chg-term-volt-debounce: [ 'max77779,chg-term-voltage' ]
```

## google-modules/bms/Documentation/devicetree/bindings/bms/max77779_i2cm.yaml
```yaml
# SPDX-License-Identifier: (GPL-2.0 OR BSD-2-Clause)
%YAML 1.2
---
$schema: http://devicetree.org/meta-schemas/core.yaml#

title: max77779_i2cm i2c bridge driver

maintainers:
  - James Wylder <jwylder@google.com>
  - Daniel Okazaki <dtokazaki@google.com>
  - Prasanna Prapancham <prapancham@google.com>
  - Jack Wu <wjack@google.com>
  - Ken Yang <yangken@google.com>
  - Baltazar Ortiz <baltazarortiz@google.com>

description: |

  The max77779_i2cm driver provides an i2c bridge through the max77779 IF-PMIC.

properties:
  max77779,timeout:
    description:
       Value to write to the TIMEOUT REGISTER on the IF-PMIC. This maps to
       the internal PMIC timeout for transactions on the remote side bus.
    maxItems: 1

  max77779,completion_timeout_ms:
       Time in milliseconds to wait for the Transaction complete IRQ from
       the IF-PMIC.

  max77779,speed:
       Register value for remote bus speed.
```
