## google-modules/bms/Documentation/devicetree/bindings/bms/rt9471.yaml
```yaml
# SPDX-License-Identifier: GPL-2.0
# Copyright 2024 Google LLC
%YAML 1.2
---

$schema: http://devicetree.org/meta-schemas/core.yaml#

title: RT9471 driver

maintainers:
  - Jack Wu <wjack@google.com>

description: |
  RT9471 Buck Charger driver

properties:
  # A dictionary of DT properties for this binding schema
  compatible:
    enum:
      - richtek,rt9471
      - richtek,swchg

  reg:
    description: i2c address of the charger.

  rt9471:
    description: Main charger config block

  charger_name:
    description: rt9471 charger name. In rt9471 block.
    $ref: /schemas/types.yaml#/definitions/string

  rt,intr_gpio:
    description: IRQ gpio

  rt,ceb_gpio:
    description: Charge enable gpio

  ichg:
    description: Charging current. In rt9471 block.
    $ref: /schemas/types.yaml#/definitions/uint32

  aicr:
    description: Average input current regulation. In rt9471 block.
    $ref: /schemas/types.yaml#/definitions/uint32

  mivr:
    description: Minimum input voltage regulation. In rt9471 block.
    $ref: /schemas/types.yaml#/definitions/uint32

  vac_ovp:
    description: VAC Over-voltage-protection threshold. In rt9471 block.
    $ref: /schemas/types.yaml#/definitions/uint32

  cv:
    description: Constant voltage config. In rt9471 block.
    $ref: /schemas/types.yaml#/definitions/uint32

  ieoc:
    description: End of charge current. In rt9471 block.
    $ref: /schemas/types.yaml#/definitions/uint32

  safe-tmr:
    description: Charge safe timer. In rt9471 block.
    $ref: /schemas/types.yaml#/definitions/uint32

  wdt:
    description: Watchdog timer. In rt9471 block.
    $ref: /schemas/types.yaml#/definitions/uint32

  mivr-track:
    description: Minimum input voltage regulation track. In rt9471 block.
    $ref: /schemas/types.yaml#/definitions/uint32

  en-safe-tmr:
    description: Enable charge safe timer. In rt9471 block.
    type: boolean

  en-te:
    description: Enable charge termination. In rt9471 block.
    type: boolean

  en-jeita:
    description: Enable JEITA thermal control. In rt9471 block.
    type: boolean

  ceb-invert:
    description: Charge enable invert logic. In rt9471 block.
    type: boolean

  dis-i2c-tout:
    description: Disable i2c timeout function. In rt9471 block.
    type: boolean

  en-qon-rst:
    description: BATFET enable input low for 10 seconds, disable BATFET. In rt9471 block.
    type: boolean

  auto-aicr:
    description: Auto set IAICR by BC1.2 done or PSEL change. In rt9471 block.
    type: boolean

  interrupt-names:
    description: map interrupt to name and unmask interrupt
    $ref: /schemas/types.yaml#/definitions/string-array

  rt9471_gpio:
    description: GPIO controller config.

required:
  - compatible
  - reg
  - interrupt-names
```

## google-modules/bms/Kconfig
```kconfig
menuconfig GOOGLE_BMS
	bool "Google, LLC. Charging and Fuel Gauge support"
	help
	  Say Y here to enable Google, LLC. support for Battery and Charging.

if GOOGLE_BMS

config GOOGLE_BATTERY_CHARGING
	tristate "Google Battery and Charging Control"
	select GOOGLE_CHARGER
	select GOOGLE_BATTERY
	help
	  Say Y here to enable new Google Gen Features.
	  This option selects Google Battery and Multi Step Charging enabling
	  new features such as battery controlled charge tables and charge path
	  resistance compensation. New gen features require configuration in
	  device tree.

config GOOGLE_CHARGER
	tristate "Google Multi Step Charging"
	help
	  Say Y here to choose the Google Multi Step Charging control.
	  The driver implements a multi CC-CV steps charging using battery
	  temperature and voltage to set the charger constant charging
	  current and float voltage.

config GOOGLE_BATTERY
	tristate "Google Battery"
	help
	  Say Y here to choose the Google Battery.
	  The driver handles charge tables, recharge threshold, state of charge,
	  battery statistics such as bin count and other features common to all
	  google battery powered devices.

config GOOGLE_DUAL_BATT_GAUGE
        tristate "Google Dual Battery Gauge"
        help
          Say Y here to choose the Google Dual Battery Gauge.
          The driver handles 2 battery gauges and called by google battery.

config GOOGLE_CPM
	tristate "Google Charging Policy Manager"
	help
	  Say Y here to enable the Charging Policy Manager.
	  The driver manages multiple chargers (eg primary, secondary).

config GOOGLE_DOCK
        tristate "Google Dock"
        help
          Say Y here to choose the Google Dock.
          The driver handles dock driver and called by google charger.

config GOOGLE_CCD
        tristate "Google Charger Combine Driver"
        help
          Say Y here to choose the Charger Combine Driver.
          The driver handles multiple chargers and called by google charger.

config USB_OVERHEAT_MITIGATION
	tristate "Google USB Overheat Mitigation"
	help
	  Say Y here to enable Google USB overheat mitigation

config PMIC_VOTER_COMPAT
	tristate "QC Pmic Voter compatibility shim"
	help
	  Say Y here to enable voter compatibility shim layer.
	  This option enables a call interface between the legacy voter
	  interface and the Google Voting interface.

config GOOGLE_BEE
	tristate "Google Battery EEPROM"
	help
	  Say Y here to enable the support for google battery EEPROM
	  The EEPROM contains the battery type, lifetime data and other
	  infomation.

endif	# GOOGLE_BMS

config CHARGER_P9221
	tristate "IDT P9221 wireless power receiver driver"
	depends on I2C
	help
	  This driver provides support for the IDT P9221 wireless
	  power receiver.

config CHARGER_MAX77729
	tristate "Maxim MAX77729 battery charger driver"
	depends on I2C && OF
	help
	  Say Y to enable support for the Maxim MAX77729 battery charger.

config CHARGER_MAX77759
	tristate "Maxim MAX77759 battery charger driver"
	depends on I2C && OF
	help
	  Say Y to enable support for the Maxim MAX77759 battery charger.

config CHARGER_MAX77779
	tristate "Maxim MAX77779 battery charger driver"
	depends on OF
	help
	  Say Y to enable support for the Maxim MAX77779 battery charger.
choice
	default CHARGER_MAX77779_I2C
	prompt "MAX77779 Charger Bus module"
config CHARGER_MAX77779_I2C
	bool "I2C"
	depends on I2C
	select REGMAP_I2C
endchoice

config FG_MAX77779
	tristate "Maxim MAX77779 battery fuel gauge driver"
	depends on OF
	help
	  Say Y to enable support for the Maxim MAX77779 battery fg.
choice
	default FG_MAX77779_I2C
	prompt "MAX77779 FG Bus module"
config FG_MAX77779_I2C
	bool "I2C"
	depends on I2C
	select REGMAP_I2C
endchoice

config VIMON_MAX77779
	tristate "Maxim MAX77779 VIMON driver"
	depends on OF
	help
	  Say Y to enable support for the Maxim MAX77779 VIMON.
choice
	default VIMON_MAX77779_I2C
	prompt "MAX77779 Vimon Bus module"
config VIMON_MAX77779_I2C
	bool "I2C"
	depends on I2C
	select REGMAP_I2C
endchoice

config PMIC_MAX77729
	tristate "Maxim MAX77729 PMIC driver"
	depends on I2C && OF
	help
	  Say Y to enable support for the Maxim MAX77729 PMIC.

config UIC_MAX77729
	tristate "Maxim MAX77729 TCPCI driver"
	depends on I2C && OF
	help
	  Say Y to enable support for the Maxim MAX77729 TCPCI.

config PCA9468
	tristate "NXP PCA9468 Direct charger"
	depends on I2C && OF
	help
	  Say Y to enable support for the PCA9648 direct charger.

config MAX20339
	tristate "Maxim MAX20339 input protection chip"
	depends on I2C && OF
	help
	  Say Y to enable support for Max20339 OVP and LS circuits.

config MAXQ_MAX77759
	tristate "Maxim MAX77759 MAXQ"
	depends on I2C && PMIC_MAX77729
	help
	  Say Y to enable support for MAX77759 MAXQ support.

config LN8411
	tristate "LN8411 Direct charger"
	depends on I2C && OF
	help
	  Say Y to enable support for the LN8411 direct charger.

config MAX77779_I2CM
	tristate "Maxim 77779 I2C Bridge Bus"
	depends on OF
	help
	  Bus to bridge I2C to Maxim 77779
choice
	default MAX77779_I2CM_I2C
	prompt "MAX77779 I2CM Bus module"
config MAX77779_I2CM_I2C
	bool "I2C"
	depends on I2C
	select REGMAP_I2C
endchoice

config MAX77779_PMIC
	tristate "Maxim 77779 PMIC"
	depends on OF
	help
	  Handle IRQs for Sequoia
choice
	default MAX77779_PMIC_I2C
	prompt "MAX77779 PMIC Bus module"
config MAX77779_PMIC_I2C
	bool "I2C"
	depends on I2C
	select REGMAP_I2C
endchoice

config MAX77779_PMIC_IRQ
	tristate "Maxim 77779 PMIC IRQ"
	depends on OF && MAX77779_PMIC
	help
	  Handle IRQs for Sequoia

config MAX77779_PMIC_PINCTRL
	tristate "Maxim 77779 PMIC PINCTRL"
	depends on OF && MAX77779_PMIC
	help
	  Handle PINCTRL for Sequoia

config MAX77779_PMIC_SGPIO
	tristate "Maxim 77779 PMIC SGPIO"
	depends on OF && MAX77779_PMIC
	help
	  Handle GPIOS for Sequoia

config MAX77779_SP
	tristate "Maxim 77779 Scratchpad"
	depends on OF
	help
	  Handle Scratchpad for Sequoia
choice
	default MAX77779_SP_I2C
	prompt "MAX77779 Scratchpad Bus module"
config MAX77779_SP_I2C
	bool "I2C"
	depends on I2C
	select REGMAP_I2C
endchoice

config FWUPDATE_MAX77779
	tristate "Maxim 77779 Firmware Update"
	depends on I2C && OF
	select FW_LOADER
	help
	  Handle firmware update for Sequoia

config CHARGER_RT9471
	tristate "Richtek RT9470/RT9470D/RT9471/RT9471D battery charger driver"
	depends on I2C
	help
	  Say Y to enable support for Richtek RT9470, RT9470D,
	  RT9471 and RT9471D battery chargers.
	  RT9470D and RT9471D support BC1.2, but not RT9470 and RT9471

config HL7132
	tristate "HL7132 Direct charger"
	depends on I2C && OF
	help
	  Say Y to enable support for the HL7132 direct charger.
```

## google-modules/display/common/Kconfig
```kconfig
# SPDX-License-Identifier: MIT

menu "GS Display Configuration"
	depends on DRM

config GS_DRM_PANEL_UNIFIED
	tristate "Support for GS Unified panel driver"
	depends on OF && DRM
	select DRM_DISPLAY_HELPER
	select DRM_DISPLAY_DP_HELPER
	help
	  Choose this option to support the unified panel driver framework.
	  This option is designed to be decoupled from DPU code
	  to reduce interdependency. This feature is currently in development
	  and is not meant for use on in-market devices.

config GS_PANEL_SIMPLE
	tristate "Support for simple gs_panel, primarily for simulation"
	depends on GS_DRM_PANEL_UNIFIED
	help
	  Select this option to enable support for the simple (sim) panel

config DEBUG_PANEL_TEST
	bool "Support for panel test module"
	default n
	help
	  Select this option to enable support for panel test modules

config COMMON_PANEL_TEST
	tristate "Support for common panel test module"
	depends on DEBUG_PANEL_TEST
	help
	  Select this option to enable support for the common panel test

endmenu
```

## google-modules/display/samsung/Kconfig
```kconfig
# SPDX-License-Identifier: MIT

config DRM_SAMSUNG
	tristate "DRM Support for Samsung EXYNOS Series"
	depends on OF && DRM && (SOC_EXYNOS9820 || SOC_GS101 || SOC_GS201 || SOC_ZUMA)
	select DRM_KMS_HELPER
	select DRM_DISPLAY_DP_HELPER
	select DRM_DISPLAY_HDCP_HELPER
	select DRM_DISPLAY_HELPER
	select VIDEOMODE_HELPERS
	help
	  Choose this option if you have a Samsung EXYNOS SoC chipset.
	  If M is selected the module will be called exynosdrm. It will
	  control various panel drivers and display hardware on Samsung
	  Exynos SoC chipset.

if DRM_SAMSUNG

config DRM_SAMSUNG_DPP
	bool "DPP on Exynos"
	default DRM_SAMSUNG
	depends on DRM_SAMSUNG
	help
	  This enables support for DPP(Display Pre Processor) device on
	  Samsung Exynos SoC. It will support scaling, rotation, compression
	  and so on.

comment "CRTCs"

config DRM_SAMSUNG_DECON
	bool "DECON on Exynos"
	depends on !FB_S3C && !DRM_EXYNOS
	default DRM_SAMSUNG
	help
	  Choose this option if you want to use Exynos DECON for DRM. It
	  will control DECON hardware. It can blend all windows connected
	  to DPP.

comment "Encoders and Bridges"

config DRM_SAMSUNG_DSI
	bool "MIPI-DSI host"
	depends on DRM_SAMSUNG_DECON
	select DRM_MIPI_DSI
	select DRM_PANEL
	default DRM_SAMSUNG
	help
	  This enables support for Exynos MIPI-DSI device. It will encode
	  data as mipi standard and transfer to the mipi panel. It also
	  supports to read and write mipi command to and from the mipi panel.
	  So, this driver can use various panel feature.

config DSIM_LOGBUFF
	bool "DSIM logbuffer"
	depends on DRM_SAMSUNG_DSI
	default n
	help
	  This enables support for logging DSI commands in a logbuffer.

config DRM_SAMSUNG_WB
	bool "WB on Exynos"
	depends on DRM_SAMSUNG_DECON
	default DRM_SAMSUNG
	help
	  This enables support for Exynos Concurrent Writeback device.
	  It can be attached writeback at runtime. It will dump blended
	  output buffer which is displaying on LCD.
	  This means that both writeback and LCD display can be operated
	  simultaneously.

config DRM_SAMSUNG_DP
	bool "DP on Exynos"
	depends on DRM_SAMSUNG_DECON
	default n
	help
	  This enables support for Exynos DisplayPort device. It will encode
	  data as DP standard and transfer to the DP Dongle(USB type C to DP) or monitor.

config DRM_SAMSUNG_DP_AUDIO
	bool "DP Audio on Exynos"
	depends on DRM_SAMSUNG_DP
	help
	  This enables Audio support for Exynos DisplayPort device.

config DRM_SAMSUNG_TUI
	bool "TUI reverse proxy on Exynos"
	depends on DRM_SAMSUNG
	default DRM_SAMSUNG
	help
	  This enables the TUI reverse proxy which allows the TA to allocate
	  framebuffer.

config QUEUE_DDIC_CMD_CALL_BACK
	bool "dsim driver send callback after queue command"
	depends on !GS_DRM_PANEL_UNIFIED
	default n
	help
	  This will enable sending a notification to exynos panel
	  when a command is queued on dsim driver.

endif
```

## google-modules/display/samsung/panel/Kconfig
```kconfig
# SPDX-License-Identifier: GPL-2.0-only
config DRM_PANEL_GOOGLE_COMMON
	tristate "Google common panel driver"
	depends on DRM && DRM_PANEL

config DRM_PANEL_SAMSUNG_COMMON
	tristate "Samsung common panel driver"
	depends on DRM && DRM_PANEL

config DRM_PANEL_SAMSUNG_EMUL
	tristate "Samsung emulator panel"
	depends on DRM && DRM_PANEL

config DRM_PANEL_SAMSUNG_S6E3HC2
	tristate "Samsung S6E3HC2 panel"
	depends on DRM && DRM_PANEL

config DRM_PANEL_SAMSUNG_S6E3FC3
	tristate "Samsung S6E3FC3 Panel"
	depends on DRM && DRM_PANEL

config DRM_PANEL_SAMSUNG_S6E3FC3_P10
	tristate "Samsung S6E3FC3_P10 Panel"
	depends on DRM && DRM_PANEL

config DRM_PANEL_SAMSUNG_SOFEF01
	tristate "Samsung SOFEF01 Panel"
	depends on DRM && DRM_PANEL

config DRM_PANEL_SAMSUNG_S6E3HC3
	tristate "Samsung S6E3HC3 Panel"
	depends on DRM && DRM_PANEL

config DRM_PANEL_SAMSUNG_S6E3HC3_C10
	tristate "Samsung S6E3HC3_C10 Panel"
	depends on DRM && DRM_PANEL

config DRM_PANEL_SAMSUNG_S6E3HC4
	tristate "Samsung S6E3HC4 Panel"
	depends on DRM && DRM_PANEL

config DRM_PANEL_BOE_NT37290
	tristate "BOE NT37290 Panel"
	depends on DRM && DRM_PANEL

config DRM_PANEL_BOE_NT37290
	tristate "BOE NT37290 Panel"
	depends on DRM && DRM_PANEL
```

## google-modules/gxp/gs201/Kconfig
```kconfig
# SPDX-License-Identifier: GPL-2.0-only

menu "GXP device"

config GXP
	tristate "Device driver for GXP"
	select DMA_SHARED_BUFFER
	select GENERIC_ALLOCATOR
	select IOMMU_API
	select PM
	help
	  This driver supports the GXP device. Say Y if you want to
	  include this driver in the kernel.

	  To compile this driver as a module, choose M here. The module will be
	  called "gxp".

config AMALTHEA
	tristate "Amalthea GXP device driver"
	depends on GXP
	default CONFIG_GXP
	help
	  Alias of CONFIG_GXP.

	  To compile this driver as a module, choose M here. The module will be
	  called "gxp".

endmenu
```

## google-modules/lwis/Kconfig
```kconfig
#
# LWIS camera drivers
#

config LWIS
      bool "Drivers under LWIS implementation"
      depends on VIDEO_GOOGLE
      default n
      help
		    This is the LWIS implementation
```
