## google-modules/amplifiers/cs40l26/Kconfig
```kconfig
# SPDX-License-Identifier: GPL-2.0-only
#
# Cirrus Logic haptic driver configuration
#

config INPUT_CS40L26
	tristate "Cirrus Logic CS40L26 haptic amplifier support"
	select CL_DSP
	help
	  Say Y here to enable support for CS40L26 boosted haptic amplifier.

	  To compile the driver as a module choose M here: the module will
	  be called cs40l26_core.

config INPUT_CS40L26_I2C
	tristate "Support I2C bus connection"
	depends on INPUT_CS40L26 && I2C
	select REGMAP_I2C
	help
	  Say Y if you have CS40L26 hooked to an I2C bus.

	  To compile the driver as a module choose M here: the
	  module will be called cs40l26_i2c.

config INPUT_CS40L26_SPI
	tristate "Support SPI bus connection"
	depends on INPUT_CS40L26 && SPI_MASTER
	select REGMAP_SPI
	help
	  Say Y if you have CS40L26 hooked to a SPI bus.

	  To compile the driver as a module choose M here: the
	  module will be called cs40l26_spi.

config CL_DSP
	tristate "Cirrus Logic Haptics DSP driver"
	help
	  This driver is used to handle firmware loading
	  and configuration for Cirrus Logic Haptic devices.

config SND_SOC_CS40L26
	tristate "Cirrus Logic CS40L26 Stub CODEC"
	depends on INPUT_CS40L26_I2C || INPUT_CS40L26_SPI
```

## google-modules/amplifiers/drv2624/Kconfig
```kconfig
config INPUT_DRV2624_HAPTICS
        tristate "TI DRV2624 haptics support"
        depends on INPUT && I2C
        select INPUT_FF_MEMLESS
        select REGMAP_I2C
        help
          Say Y to enable support for the TI DRV2624 haptics driver.

          To compile this driver as a module, choose M here: the
          module will be called drv2624-haptics.
```

## google-modules/aoc/Kconfig
```kconfig
#
# AoC Driver Support
#

config WC_MBOX
	tristate "Whitechapel Mailbox support"
	depends on MAILBOX
	help
		Say yes here to build the generic mailbox driver for the exynos
		mailboxes in Whitechapel

config AOC_DRIVER
	tristate "WhiteChapel AoC support"
	default n
	depends on WC_MBOX
	# GOOGLE_MODEMCTL is an optional dependency.
	depends on GOOGLE_MODEMCTL || !GOOGLE_MODEMCTL
	help
		Say yes here to add support for the AoC subsystem in WhiteChapel

config AOC_CHAR_DRIVER
	tristate "WhiteChapel AoC character device support"
	default Y if AOC_DRIVER
	help
		Say yes here to expose AoC services as character devices

config AOC_CHAN_DRIVER
	tristate "WhiteChapel AoC IPC channel support"
	default Y if AOC_DRIVER
	help
		Say yes here to add channelized IPC support for USF

config AOC_CONTROL_DRIVER
	tristate "WhiteChapel AoC Basic Control"
	default Y if AOC_DRIVER
	help
		Say yes here to add basic control for the AoC

config AOC_TBN_DRIVER
	tristate "WhiteChapel AoC TBN service"
	default Y if AOC_DRIVER
	help
		Say yes here to add TBN service for the AoC
```

## google-modules/bms/Documentation/devicetree/bindings/bms/google_charger.yaml
```yaml
# SPDX-License-Identifier: GPL-2.0
# Copyright 2024 Google LLC
%YAML 1.2
---

$schema: http://devicetree.org/meta-schemas/core.yaml#

title: Google Charger driver

maintainers:
  - Daniel Okazaki <dtokazaki@google.com>
  - Prasanna Prapancham <prapancham@google.com>
  - Jack Wu <wjack@google.com>
  - Ken Yang <yangken@google.com>
  - Jenny Ho <hsiufangho@google.com>
  - Baltazar Ortiz <baltazarortiz@google.com>

description: |
  Main Google Charger driver.

  Controls charging based on different modules
   - Battery Defender
   - Dock Defend
   - Thermal Engine
   - USB
   - Wireless Charger
   - Google Battery
   - Retail Mode
  Propagates charging stats to CSI.

properties:
  # A dictionary of DT properties for this binding schema
  compatible:
    enum:
      - google,charger

  google,chg-power-supply:
    description: Charger power supply name
    $ref: /schemas/types.yaml#/definitions/string

  google,bat-power-supply:
    description: Battery power supply name
    $ref: /schemas/types.yaml#/definitions/string

  google,wlc-power-supply:
    description: Wireless charger power supply name
    $ref: /schemas/types.yaml#/definitions/string

  google,ext-power-supply:
    description: Dock power supply name
    $ref: /schemas/types.yaml#/definitions/string

  google,usb-power-supply:
    description: USB power supply name
    $ref: /schemas/types.yaml#/definitions/string

  google,tcpm-power-supply:
    description: TCPC power supply phandle
    $ref: /schemas/types.yaml#/definitions/phandle

  google,psy-retry-count:
    description: Retry count for finding power supplies from name in probe.
    $ref: /schemas/types.yaml#/definitions/uint32

  google,pps-cc-tolerance-pct:
    description: PPS cc_max tier change ratio.
      If batt current is less than (cc_max * ratio) / 100), change charge tier to
      higher level.
    $ref: /schemas/types.yaml#/definitions/uint32

  google,enable-user-fcc-fv:
    description: Allows debugfs modification of fcc (fast constant current) and
      fv (float voltage)
    type: boolean

  google,cv-update-interval:
    description: Constant voltage update interval. Determines the frequency of
    the charge loop running.
      Used during
        - POWER_SUPPLY_STATUS_NOT_CHARGING
        - POWER_SUPPLY_STATUS_UNKNOWN
        - invalid charger power supply status
    $ref: /schemas/types.yaml#/definitions/uint32

  google,cc-update-interval:
    description: Constant charge current update interval. Determines the frequency
    of the charge loop running.
      Used during
        - POWER_SUPPLY_STATUS_CHARGING
    $ref: /schemas/types.yaml#/definitions/uint32

  google,chg-cc-tolerance:
    description: Reduces cc_max in mA for a margin of safety.
    $ref: /schemas/types.yaml#/definitions/uint32

  google,fcc-max-ua:
    description: Max fast constant charging current when no charge table exists
    $ref: /schemas/types.yaml#/definitions/uint32

  google,fv-max-uv:
    description: Max and default float voltage when no charge table exists
    $ref: /schemas/types.yaml#/definitions/uint32

  google,chg-termination-enable:
    description: Charge termination control.
    type: boolean

  google,chg-termination-5v:
    description: Fallback to 5V on charge termination
    type: boolean

  google,chg-taper-last-tier:
    description: Enables taper on last tier in charge table
    type: boolean

  google,bd-trigger-voltage:
    description: Voltage level to trigger Battery Defender
    $ref: /schemas/types.yaml#/definitions/uint32

  google,bd-drainto-soc:
    description: Drain to specified SOC level while in Battery Defend.
    $ref: /schemas/types.yaml#/definitions/uint32

  google,bd-trigger-temp:
    description: Temperature average to trigger Battery Defender.
    $ref: /schemas/types.yaml#/definitions/uint32

  google,bd-trigger-time:
    description: Debounce time for Battery Defender
    $ref: /schemas/types.yaml#/definitions/uint32

  google,bd-recharge-voltage:
    description: Voltage to recharge to after triggering Battery Defender.
    $ref: /schemas/types.yaml#/definitions/uint32

  google,bd-recharge-soc:
    description: SOC to recharge to after triggering Battery Defender.
    $ref: /schemas/types.yaml#/definitions/uint32

  google,bd-resume-abs-temp:
    description: Temperature to resume charging at after triggering Battery Defender.
    $ref: /schemas/types.yaml#/definitions/uint32

  google,bd-resume-soc:
    description: SOC to resume charging at after triggering Battery Defender.
    $ref: /schemas/types.yaml#/definitions/uint32

  google,bd-resume-temp:
    description: Temperature to resume charging at after triggering Battery Defender.
    $ref: /schemas/types.yaml#/definitions/uint32

  google,bd-resume-time:
    description: Debounce time to resume charging at after triggering Battery Defender.
    $ref: /schemas/types.yaml#/definitions/uint32

  google,bd-temp-dry-run:
    description: Don't run Battery Defender, but keep track of state in votable.
    type: boolean

  google,bd-temp-enable:
    description: Disables Battery Defender
    type: boolean

  google,pps-enable:
    description: Enable PPS charging capabilities
    type: boolean

  google,thermal-mitigation:
    description: Wired thermal charge current limit table.
    $ref: /schemas/types.yaml#/definitions/uint32-array

  google,thermal-mitigation-budgets:
    description: Wired state2power thermal table. Stores the dissipation budget for
    each power level.
    $ref: /schemas/types.yaml#/definitions/uint32-array

  google,wlc-thermal-mitigation:
    description: EPP/BPP wireless thermal charge current limit table.
    $ref: /schemas/types.yaml#/definitions/uint32-array

  google,thermal-mitigation-budgets:
    description: EPP/BPP wireless state2power thermal table. Stores the dissipation
    budget for each power level.
    $ref: /schemas/types.yaml#/definitions/uint32-array

  google,wlc-fcc-thermal-mitigation:
    description: HPP wireless fast charge current thermal charge current limit table.
    $ref: /schemas/types.yaml#/definitions/uint32-array

  google,therm-wlc-overrides-fcc:
    description: SW will override the fast constant current (fcc). wired and wireless
    limits are linked when this is enabled.
    type: boolean

  google,thermal-stats-lvl-map:
    description: Mapping of thermal table for printing stats.
    $ref: /schemas/types.yaml#/definitions/uint32-array
    items:
      maximum: 10

  google,dd-charge-stop-level:
    description: Dock defend SOC charge stop level.
    $ref: /schemas/types.yaml#/definitions/uint32

  google,dd-charge-start-level:
    description: Dock defend SOC charge start level.
    $ref: /schemas/types.yaml#/definitions/uint32

  google,dd-state:
    description: Dock defend state. DOCK_DEFEND_ENABLED = 0
    $ref: /schemas/types.yaml#/definitions/int32

  google,dd-settings:
    description: User dock defend state. DOCK_DEFEND_USER_ENABLED = 1
    $ref: /schemas/types.yaml#/definitions/int32

  google,dd-trigger-time:
    description: Dock defend debounce trigger time.
    $ref: /schemas/types.yaml#/definitions/uint32

  no-wlc:
    description: Skip wireless charging settings, such as thermal table.
    type: boolean

required:
  - compatible
  - #cooling-cells

dependencies:
  google,thermal-mitigation-budgets: ['google,thermal-mitigation']
  google,wlc-thermal-mitigation-budgets: ['google,wlc-thermal-mitigation']
  google,pps-enable: ['google,tcpm-power-supply']
  google,bat-power-supply: ['google,chg-power-supply']
```

## google-modules/bms/Documentation/devicetree/bindings/bms/google_cpm.yaml
```yaml
# SPDX-License-Identifier: GPL-2.0
# Copyright 2024 Google LLC
%YAML 1.2
---

$schema: http://devicetree.org/meta-schemas/core.yaml#

title: Google CPM driver

maintainers:
  - Daniel Okazaki <dtokazaki@google.com>
  - Prasanna Prapancham <prapancham@google.com>
  - Ken Yang <yangken@google.com>
  - Jenny Ho <hsiufangho@google.com>
  - Baltazar Ortiz <baltazarortiz@google.com>


description: |
  Google Central Power Management driver

  Controls charging voltage/current of
    - main charger
    - parallel charger (optional)
    - wireless charger (optional)

properties:
  # A dictionary of DT properties for this binding schema
  compatible:
    enum:
      - google,cpm

  google,psy-name:
    description: Main charger power supply name
    $ref: /schemas/types.yaml#/definitions/string

  google,tcpm-power-supply:
    description: TCPM power supply phandle
    $ref: /schemas/types.yaml#/definitions/phandle

  google,wlc_dc-power-supply:
    description: Wireless DC power supply name
    $ref: /schemas/types.yaml#/definitions/string

  google,dc-en:
    description: DC enable gpio
    type: boolean

  google,dc-en-value:
    description: DC enable gpio output active HIGH. Absence of gpio indicates
    output active LOW.
    type: boolean

  google,dc_limit-demand:
    description: Charge current floor to enable DC charging
    $ref: /schemas/types.yaml#/definitions/uint32

  google,dc_limit-cc_min:
    description: Wired charge current to disable DC charging if already enabled.
    $ref: /schemas/types.yaml#/definitions/uint32

  google,dc_limit-cc_min_wlc:
    description: Wireless charge current to disable DC charging if already enabled.
    $ref: /schemas/types.yaml#/definitions/uint32

  google,dc_limit-vbatt_min:
    description: Charge voltage to enable DC charging.
    $ref: /schemas/types.yaml#/definitions/uint32

  google,dc_limit-vbatt_low:
    description: Don't start DC charging until batt voltage low is reached.
    $ref: /schemas/types.yaml#/definitions/uint32

  google,dc_limit-vbatt_max:
    description: Stop DC charging at batt voltage.
    $ref: /schemas/types.yaml#/definitions/uint32

  google,dc_limit-vbatt_high:
    description: Don't start DC charging at batt voltage.
    $ref: /schemas/types.yaml#/definitions/uint32

  google,dc_limit-soc_high:
    description: Don't start DC charging at soc.
    $ref: /schemas/types.yaml#/definitions/uint32

  google,taper_step-fv-margin:
    description: Float voltage countdown steps before dc_done while taper charging.
    $ref: /schemas/types.yaml#/definitions/uint32

  google,taper_step-cc-step:
    description: Constant charge current countdown steps before dc_done while taper
    charging.
    $ref: /schemas/types.yaml#/definitions/uint32

  google,taper_step-interval:
    description: Seconds countdown interval steps before dc_done while taper charging.
    $ref: /schemas/types.yaml#/definitions/uint32

  google,taper_step-count:
    description: Countdown steps before dc_done while taper charging.
    $ref: /schemas/types.yaml#/definitions/uint32

  google,taper_step-grace:
    description: Steps from voltage before countdown while taper charging.
    $ref: /schemas/types.yaml#/definitions/uint32

  google,taper_step-voltage:
    description: Voltage before countdown while taper charging.
    $ref: /schemas/types.yaml#/definitions/uint32

  google,taper_step-current:
    description: Current before countdown while taper charging.
    $ref: /schemas/types.yaml#/definitions/uint32

  google,wlc-dc-fcc-ua:
    description: Wireless DC charging fast constant charge current.
    $ref: /schemas/types.yaml#/definitions/uint32

  google,no-init-wlc-ta-vol:
    description: Don't set the wlc init voltage.
    type: boolean

  google,cop-supported:
    description: Charge Overcurent Protection support on main-charger.
      If supported, on COP WARN interrupt, taper charge current down until interrupts
      stop, then reset to normal levels.
    type: boolean

  google,chg-power-supplies:
    description: List of charger power supply names.
    $ref: /schemas/types.yaml#/definitions/string-array

  google,mdis-out-sel-online:
    description: Source online selection criteria for MDIS thermal engine
    $ref: /schemas/types.yaml#/definitions/uint32-array

  google,mdis-thermal-mitigation:
    description: Table to associate thermal mitigation level to dissipation
    budget in mW.
    $ref: /schemas/types.yaml#/definitions/uint32-array

  google,mdis-fan-alarm-level:
    description: Thermal level to set FAN_LVL_ALARM
    $ref: /schemas/types.yaml#/definitions/uint32

  google,pps-awake:
    description: PPS keep wakelock while charging.
    type: boolean

patternProperties:
  "^(google,mdis-out[0-9]+-limits)$":
    description: Thermal mitigation charging current limit profile. Different profiles
    are used for different charging chips.
    $ref: /schemas/types.yaml#/definitions/uint32-array

    dependencies: [ 'google,mdis-thermal-mitigation', 'google,mdis-out-sel-online' ]

required:
  - compatible
  - #cooling-cells

dependencies:
  google,mdis-out-sel-online: [ 'google,mdis-thermal-mitigation' ]
  google,mdis-fan-alarm-level: [ 'google,mdis-thermal-mitigation', 'google,mdis-out-sel-online', '"^(google,mdis-out[0-9]+-limits)$"' ]
  google,dc-en-value: [ 'google,dc-en' ]
```
