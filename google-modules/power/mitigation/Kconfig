## google-modules/soc/gs/drivers/iommu/Kconfig
```kconfig
# SPDX-License-Identifier: GPL-2.0-only
if IOMMU_SUPPORT

config SAMSUNG_IOMMU
	tristate "Samsung IOMMU Support"
	select ARM_DMA_USE_IOMMU
	select IOMMU_DMA
	select SAMSUNG_IOMMU_GROUP
	help
	  Support for IOMMU on GS SoCs.

config SAMSUNG_IOMMU_V9
	tristate "Samsung IOMMU V9 Support"
	select ARM_DMA_USE_IOMMU
	select IOMMU_DMA
	select SAMSUNG_IOMMU_GROUP
	help
	  Support for IOMMU V9 on Samsung Exynos SoCs.

config SAMSUNG_IOMMU_GROUP
	tristate "Samsung IOMMU Group Support"
	help
	  Support for IOMMU group on GS SoCs.

config SAMSUNG_SECURE_IOVA
	tristate "Samsung Secure IOVA Support"
	help
	  Support secure device virtual address management for GS SoCs.

config EXYNOS_PCIE_IOMMU
	tristate "Enable Exynos PCIe IOMMU"
	depends on PCI_EXYNOS_GS
	help
	  Support for IOMMU feature for Exynos PCIe. Memory shared between the
	  PCIe Root Complex and the Endpoints is susceptible to attacks by
	  malicious firmware loaded into the Endpoints. Enabling this provides
	  secure access of memory shared between PCIe RC and the EPs.

config PCIE_IOMMU_HISTORY_LOG
	bool "Enable Exynos PCIe IOMMU Map/Unmap History"
	depends on EXYNOS_PCIE_IOMMU
	help
	  Support for saving map and unmap history of shared memory between the
	  Root Complex and Endpoints of the Exynos PCIe interface. This history
	  can be used for debugging purposes.

	  Say Y to enable this feature.

config IOVAD_VENDOR_HOOKS
	tristate "Enable Pixel IOVA allocator optimizations"
	help
	  Say M here to enable vendor-specific hooks in the I/O Virtual
	  Address (IOVA) allocator code. These hooks allow customizing IOVA
	  allocation behavior.

	  Enabling this option provides support for two main features
	  configured via Device Tree properties:

	  1. Best-Fit IOVA Allocation: This allocation strategy attempts
	     to find the smallest free IOVA range that satisfies a
	     request, which can help reduce fragmentation of the IOVA
	     space. To enable it, add the boolean property
	     "iommu-best-fit-algo;" (or the legacy property
	     "lwis,iommu-best-fit-algo;") to the relevant IOMMU node
	     in the Device Tree.

	  2. Maximum IOVA Alignment Shift Cap: This allows limiting the
	     maximum alignment automatically applied by the IOVA framework
	     during allocation. By default, the framework aligns allocations
	     to the smallest power-of-2 multiple of PAGE_SIZE that is
	     greater than or equal to the requested allocation size.
	     For very large allocations (e.g., > 64 MB), this default
	     behavior can lead to excessively large alignments, which
	     quickly exhausts the available IOVA space, particularly for
	     devices limited to 32-bit DMA addresses.

	     This feature introduces a configurable cap on the maximum
	     alignment the IOVA allocator will impose. Use the Device
	     Tree property "iommu-max-align-shift = <n>;" to specify the
	     maximum alignment shift value (n). The automatically
	     calculated alignment will not exceed 2^n pages, even if the
	     allocation size might otherwise dictate a larger alignment.

	  Enable this option only if you are building a kernel to require or
	  benefit from these custom IOVA allocation behaviors.

	  If unsure, say N.

endif # IOMMU_SUPPORT
```

## google-modules/soc/gs/drivers/media/platform/exynos/Kconfig
```kconfig
# SPDX-License-Identifier: GPL-2.0
#
# Exynos multimedia device drivers
#
config VIDEO_EXYNOS
        bool "Exynos Multimedia Devices"
        default y
        help
          This is a representative exynos multimedia device.

if VIDEO_EXYNOS
	source "$(KCONFIG_SOC_GS_PREFIX)drivers/media/platform/exynos/mfc/Kconfig"
endif

config MEDIA_EXYNOS
        bool
        depends on VIDEO_EXYNOS
        default y
        help
          Compile mdev to use exynos media device driver.
```

## google-modules/soc/gs/drivers/media/platform/exynos/mfc/Kconfig
```kconfig
# SPDX-License-Identifier: GPL-2.0

config VIDEO_EXYNOS_MFC
	tristate "Exynos MFC Driver"
	default n
	depends on VIDEO_EXYNOS
	select VIDEOBUF2_CORE
	select VIDEOBUF2_DMA_SG
	help
	  MFC driver for V4L2.

config MFC_USES_LLC
	bool "MFC LLC support"
	default n
	depends on VIDEO_EXYNOS_MFC
	help
	  Uses the LLC of MFC.

config MFC_USE_DMABUF_CONTAINER
	bool "MFC dma-buf container support"
	default n
	depends on VIDEO_EXYNOS_MFC
	help
	  Use dma-buf container for MFC.

config MFC_USE_DMA_SKIP_LAZY_UNMAP
	bool "MFC support for DMA_ATTR_SKIP_LAZY_UNMAP"
	default n
	depends on VIDEO_EXYNOS_MFC
	help
	  Use dma-buf attribute for skip lazy unmap.
```

## google-modules/soc/gs/drivers/mfd/Kconfig
```kconfig
# SPDX-License-Identifier: GPL-2.0-only
#
# Multifunction miscellaneous devices
#

if HAS_IOMEM

config MFD_S2MPG10
	tristate "SAMSUNG Electronics S2MPG10 PMIC Series Support"
	depends on I2C=y
	select MFD_CORE
	select REGULATOR
	select MFD_S2MPG1X_GPIO
	select GENERIC_PINCONF
	help
	  Support for the Samsung Electronics MFD series.
	  This driver provides common support for accessing the device,
	  additional drivers must be enabled in order to use the functionality
	  of the device

config MFD_S2MPG11
	tristate "SAMSUNG Electronics S2MPG11 PMIC Series Support"
	depends on I2C=y
	select MFD_CORE
	select REGULATOR
	select MFD_S2MPG1X_GPIO
	select GENERIC_PINCONF
	help
	  Support for the Samsung Electronics MFD series.
	  This driver provides common support for accessing the device,
	  additional drivers must be enabled in order to use the functionality
	  of the device

config MFD_S2MPG12
	tristate "SAMSUNG Electronics S2MPG12 PMIC Series Support"
	depends on I2C=y
	select MFD_CORE
	select REGULATOR
	help
	  Support for the Samsung Electronics MFD series.
	  This driver provides common support for accessing the device,
	  additional drivers must be enabled in order to use the functionality
	  of the device

config MFD_S2MPG13
	tristate "SAMSUNG Electronics S2MPG13 PMIC Series Support"
	depends on I2C=y
	select MFD_CORE
	select REGULATOR

config MFD_S2MPG14
	tristate "SAMSUNG Electronics S2MPG14 PMIC Series Support"
	depends on I2C=y
	select MFD_CORE
	select REGULATOR
	select MFD_S2MPG1415_GPIO
	select GENERIC_PINCONF
	help
	  Support for the Samsung Electronics MFD series.
	  This driver provides common support for accessing the device,
	  additional drivers must be enabled in order to use the functionality
	  of the device

config MFD_S2MPG15
	tristate "SAMSUNG Electronics S2MPG15 PMIC Series Support"
	depends on I2C=y
	select MFD_CORE
	select REGULATOR
	select MFD_S2MPG1415_GPIO
	select GENERIC_PINCONF
	help
	  Support for the Samsung Electronics MFD series.
	  This driver provides common support for accessing the device,
	  additional drivers must be enabled in order to use the functionality
	  of the device

config MFD_S2MPG1X_GPIO
	tristate "SAMSUNG Electronics S2MPG1X PMIC GPIO Support"
	depends on I2C=y
	help
	  Support for the Samsung Electronics S2MPG1X GPIO control.
	  Several balls of S2MPG1X chips replace a few of the GPIO pins of AP
	  and provide registers for controlling them.
	  If MFD_S2MPG10 or MFD_S2MPG1X is selected, this config will be
	  included together.

config MFD_S2MPG1415_GPIO
	tristate "SAMSUNG Electronics S2MPG1415 PMIC GPIO Support"
	depends on I2C=y
	help
	  Support for the Samsung Electronics S2MPG1X GPIO control.
	  Several balls of S2MPG14 chips replace a few of the GPIO pins of AP
	  and provide registers for controlling them.
	  If MFD_S2MPG14 or MFD_S2MPG15 is selected, this config will be
	  included together.

config MFD_SLG51000
	tristate "Dialog Semiconductor SLG51000 core driver"
	depends on I2C
	select MFD_CORE
	select REGMAP_I2C
	help
	  Say y here to support for the Dialog Semiconductor SLG51000.
	  The SLG51000 is seven compact and customizable low dropout regulators.

config MFD_SLG51002
	tristate "Dialog Semiconductor SLG51002 core driver"
	depends on I2C
	select MFD_CORE
	select REGMAP_I2C
	help
	  Say y here to support for the Dialog Semiconductor SLG51002.
	  The SLG51002 is eight compact and customizable low dropout regulators.

endif
```

## google-modules/soc/gs/drivers/misc/Kconfig
```kconfig
# SPDX-License-Identifier: GPL-2.0-only
#
# Misc strange devices
#

config GSC_TPM
	tristate "Google Security Companion"
	depends on SPI
	help
	  Say Y here if you have a GSC security microcontroller from Google LLC
	  It will be accessible using a TPM-style transport interface from within
	  Linux.

	  To compile this driver as a module, choose M here: the
	  module will be called gsc-spi.

config ACCESS_RAMOOPS
	tristate "Driver to allow access for decrypting encrypted ramoops"
	depends on PSTORE_CONSOLE
	help
	  Say 'Y' here to enable access to ramoops encryption metadata. The
	  encryption metablock contains ramoops encryption parameters.

	  To compile this driver as a module, choose M here: the module will be
	  called access_ramoops.

source "$(KCONFIG_SOC_GS_PREFIX)drivers/misc/s5910/Kconfig"
source "$(KCONFIG_SOC_GS_PREFIX)drivers/misc/sscoredump/Kconfig"
source "$(KCONFIG_SOC_GS_PREFIX)drivers/misc/sbb-mux/Kconfig"
```

## google-modules/soc/gs/drivers/misc/sscoredump/Kconfig
```kconfig
#
# SPDX-License-Identifier: GPL-2.0-only
#

config SUBSYSTEM_COREDUMP
	tristate "Subsystem coredump driver"
	default n
	help
	  Say Y here if you want to enable the subsystem coredump driver.
	  Use APIs exported by this module to generate coredumps/crash info.

	  To compile this driver as a module, choose M here: the
	  module will be called sscoredump.
```

## google-modules/soc/gs/drivers/performance/gs_perf_mon/Kconfig
```kconfig
# SPDX-License-Identifier: GPL-2.0-only

config GS_PERF_MON
	tristate "Google CPU Performance Monitor"
	default n
	help
	  A monitoring module to provide high resolution CPU state info.
	  The monitor makes use of PMU/AMU events provided by the ARM cores
	  and hooks from CPU state change functions to supply fine
	  grained CPU information. Some example clients are memory latency
	  governors. WARNING: this monitor allocates PMU counters so it can
	  conflict with other profiling tools.
```

## google-modules/soc/gs/drivers/phy/Kconfig
```kconfig
# SPDX-License-Identifier: GPL-2.0-only
#
# PHY
#

source "$(KCONFIG_SOC_GS_PREFIX)drivers/phy/samsung/Kconfig"
```

## google-modules/soc/gs/drivers/pinctrl/Kconfig
```kconfig
# SPDX-License-Identifier: GPL-2.0-only
#
# PINCTRL infrastructure and drivers
#

source "$(KCONFIG_SOC_GS_PREFIX)drivers/pinctrl/gs/Kconfig"

config PINCTRL_SLG51000
	tristate "Dialog Semiconductor SLG51000 pinctrl driver"
	depends on I2C
	select REGMAP_I2C
	help
	  Say y here to support for the Dialog Semiconductor SLG51000.
	  The SLG51000 is seven compact and customizable low dropout regulators.

config PINCTRL_SLG51002
	tristate "Dialog Semiconductor SLG51002 pinctrl driver"
	depends on I2C
	select REGMAP_I2C
	help
	  Say y here to support for the Dialog Semiconductor SLG51002.
	  The SLG51002 is eight compact and customizable low dropout regulators.
```
