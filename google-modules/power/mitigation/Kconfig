## google-modules/power/mitigation/Kconfig
```kconfig
# SPDX-License-Identifier: GPL-2.0

config GOOGLE_BCL
	tristate "Google Battery current limiter"
	depends on SOC_GS101 || SOC_GS201 || SOC_ZUMA
	# GOOGLE_MODEMCTL is an optional dependency.
	depends on GOOGLE_MODEMCTL || !GOOGLE_MODEMCTL
	help
	  This enables the monitoring and reporting of different types of system
	  throttling as a result of battery current limiter.
```

## google-modules/power/reset/Kconfig
```kconfig
# SPDX-License-Identifier: GPL-2.0

config PIXEL_POWER_REBOOT
	tristate "Pixel Power Reboot driver"
	depends on SOC_GS101 || SOC_GS201 || SOC_ZUMA
	help
	  Reboot driver support for Pixel devices.
```

## google-modules/soc/gs/Documentation/devicetree/bindings/backlight/rt4539.yaml
```yaml
# SPDX-License-Identifier: GPL-2.0-only OR BSD-2-Clause
%YAML 1.2
---
$schema: http://devicetree.org/meta-schemas/core.yaml#

title: Customized Richtek RT4539 backlight drvier

maintainers:
  - Ken Lin <lyenting@google.com>

description: |
  Customized RT4539 driver.

properties:
  compatible:
    enum:
      - richtek,rt4539

  reg:
    maxItems: 1

  enable-supply:
    description:
      Supply to use to enable backight IC.
    maxItems: 1

  led-headroom:
    description: Config LED driver headroom
      - B00: 400mV
      - B01: 450mV
      - B10: 500mV
      - B11: 600mV
    maxItems: 1

  bit-selection:
    description: Config bit selection from 8 to 12 bits
      - 8 to 11: Both linear and exponential
      - 12: Linear only
    maxItems: 1

  initial-brightness:
    description: Config initial brightness
      - 0: 0%
      - 4095: 100%
    maxItems: 1

  dimming-mode:
    description: Select dimming mode
      - B000: PWM mode
      - B001: PWM-26k mode
      - B010: Mixed mode
      - B011: Mixed-26k mode
      - B100: DC mode
    maxItems: 1

  boost-switch-freq:
    description: config boost switching frequency
      - 0x00h: 100kHz
      (resoltuion: 50kHz)
      - 0x04h: 300kHz
      (resoltuion: 100kHz)
      - 0x0Bh: 1000kHz
      - 0x0Ch: 1225kHz
      - 0x0Dh: 1335kHz
      - 0x0Eh: 1450kHz
      - 0x0Fh: 1600kHz
    maxItems: 1

  fade-in-out-time-ctrl:
    description: Config fade in/out time control
      - B000: 0.5us
      (resolution: multiply by 2)
      - B111: 64us
    maxItems: 1

  slope-time-ctrl:
    description: Config slope time control
      - B000: 0ms
      - B001: 1ms
      - B010: 8ms
      - B011: 128ms
      - B100: 256ms
      - B101: 512ms
      - B110: 768ms
      - B111: 1024ms
    maxItems: 1

  slope-time-filter:
    description: Select slope time filter
      - B00: No Filter (exponential)
      - B01: Light smoothing
      - B10: Medium smoothing
      - B11: Heavy smoothing
    maxItems: 1

  current-max:
    description: Config the maximum LED current
      - 0x00h : 0mA
      - 0x01h to 0x2Fh : 10.04mA
      (resolution: 0.12mA)
      - 0xFFh : 35mA
    maxItems: 1

  brightness-control:
    description: Config advanced brigtness control
      - B00: External PWM signal
      - B01: I2C brightness register
      - B10: External PWM signal multiplied with I2C brightness register
    maxItems: 1

  enabled-leds:
    description: Enable or disable FB channel
      - bit 1 to 6: FB1_EN to FB6_EN
      - B0: Off
      - B1: On
    maxItems: 1

  boost-ovp-selection:
    description: Config boost over voltage protection
      - 0x00h: 10V
      (resolution: 1V)
      - 0x1Eh: 40V
    maxItems: 1

  led-short-protection:
    description: Enable LED short protection
    maxItems: 1

  pfm-enable:
    description: Enable control CLK PFM function
    maxItems: 1


required:
  - compatible
  - reg

additionalProperties: false

examples:
  - |
    i2c {
        #address-cells = <1>;
        #size-cells = <0>;

        rt4539_bl: backlight@3c {
            compatible = "richtek,rt4539";
            reg = <0x3c>;

            bl-name = "lcd-bl";
            enable-supply = <&m_ldo25_reg>;

            /* LED driver headroom 500mV  */
            led-headroom = /bits/ 8 <0x02>;

            bit-selection = /bits/ 8 <12>;

            /* 28% (140 nits) initial brightness */
            initial-brightness = /bits/ 16 <1146>;

            /* DC Mode */
            dimming-mode = /bits/ 8 <0x04>;

            /* 1225kHz */
            boost-switch-freq = /bits/ 8 <0x0c>;

            /* 0.5 us */
            fade-in-out-time-ctrl = /bits/ 8 <0x00>;

            /* 8 ms */
            slope-time-ctrl = /bits/ 8 <0x02>;

            /* no filter */
            slope-time-filter = /bits/ 8 <0x00>;

            /* max current 23mA */
            current-max = /bits/ 8 <0x9b>;

            /* PWM signal multiplied with I2C */
            brightness-control = /bits/ 8 <0x02>;

            /* 5 LEDS */
            enabled-leds = /bits/ 8 <0x3e>;

            /* 28V */
            boost-ovp-selection = /bits/ 8 <0x12>;
            led-short-protection;
            pfm-enable;
        };
    };
```

## google-modules/soc/gs/Documentation/devicetree/bindings/pci/controller/dwc/pcie-exynos-rc.yaml
```yaml
# SPDX-License-Identifier: (GPL-2.0 OR BSD-2-Clause)
%YAML 1.2
---
$schema: http://devicetree.org/meta-schemas/core.yaml#

title: exynos_pcie_rc driver device tree bindings

maintainers:
  - Ting-Hsin Chen <tinghsin@google.com>

description: |
  The exynos_pcie_rc driver implements driver of Designware (Synopsis) based
  PCIe controller with Samsung provided PHY interface.

properties:
  customized-de-emphasis:
    description: Configuartion for using customized de-emphasis value.
    type: boolean
    default: false

  de-emphasis-value:
    description: The setting for de-emphasis value if customsized de-emphasis is enabled.
    type: int
    default: 0
```

## google-modules/soc/gs/Documentation/devicetree/bindings/thermal/google-thermal.txt
```
* Google Battery Current Limiter (BCL)

** Required properties:

- compatible : One of the following:
	       "google,gs101-bcl"

Example:
	google_bcl: google,bcl{
		compatible = "google,gs101-bcl";
		};
	};
```

## google-modules/soc/gs/Documentation/devicetree/bindings/usb/max77759tcpc.yaml
```yaml
# SPDX-License-Identifier: (GPL-2.0 OR BSD-2-Clause)
%YAML 1.2
---
$schema: http://devicetree.org/meta-schemas/core.yaml#

title: max77759tcpc driver device tree bindings

maintainers:
  - Badhri Jagan Sridharan <badhri@google.com>

description: |
  The max77759tcpc driver implements usb typec driver.

properties:
  bcl-usb-voting:
    description: Allow USB to vote to change BCL's BATOILO1/2 threshold
    type: boolean
```

## google-modules/soc/gs/drivers/block/zram/Kconfig
```kconfig
# SPDX-License-Identifier: GPL-2.0
config ZRAM_GS
	tristate "Compressed RAM block device support"
	depends on BLOCK && SYSFS && MMU
	depends on CRYPTO_LZO || CRYPTO_ZSTD || CRYPTO_LZ4 || CRYPTO_LZ4HC || CRYPTO_842
	select ZSMALLOC
	help
	  Creates virtual block devices called /dev/zramX (X = 0, 1, ...).
	  Pages written to these disks are compressed and stored in memory
	  itself. These disks allow very fast I/O and compression provides
	  good amounts of memory savings.

	  It has several use cases, for example: /tmp storage, use as swap
	  disks and maybe many more.

	  See Documentation/admin-guide/blockdev/zram.rst for more information.

config ZCOMP_CPU
	tristate "CPU compression"
	depends on ZRAM_GS
	default n
	help
	  Support CPU compressor. User should configuire it via echo
	  "lzo" > /sys/block/zramX/comp_algorithm

config ZCOMP_EH
	tristate "Support Emerald Hill HW compressor"
	depends on ZRAM_GS
	select GOOGLE_EH
	default n
	help
	  Support Emerald Hill HW compressor. User should configure it via
	  echo "lz77eh" > /sys/block/zramX/comp_algorithm

config ZRAM_GS_WRITEBACK
       bool "Write back incompressible or idle page to backing device"
       depends on ZRAM_GS
       help
	 With incompressible page, there is no memory saving to keep it
	 in memory. Instead, write it out to backing device.
	 For this feature, admin should set up backing device via
	 /sys/block/zramX/backing_dev.

	 With /sys/block/zramX/{idle,writeback}, application could ask
	 idle page's writeback to the backing device to save in memory.

	 See Documentation/admin-guide/blockdev/zram.rst for more information.

config ZRAM_GS_MEMORY_TRACKING
	bool "Track zRam block status"
	depends on ZRAM_GS && DEBUG_FS
	help
	  With this feature, admin can track the state of allocated blocks
	  of zRAM. Admin could see the information via
	  /sys/kernel/debug/zram/zramX/block_state.

	  See Documentation/admin-guide/blockdev/zram.rst for more information.
```

## google-modules/soc/gs/drivers/clocksource/Kconfig
```kconfig
# SPDX-License-Identifier: GPL-2.0-only

config CLKSRC_EXYNOS_MCT_GS
	tristate "Exynos multi core timer driver in Google SoCs"
	depends on ARM || ARM64
	help
	  Support for Multi Core Timer controller in certain Google SoCs.

config CLKSRC_EXYNOS_MCT_V3_GS
	tristate "Exynos multi core timer (version 3) driver in Google SoCs"
	depends on ARM || ARM64
	help
	  Support for Multi Core Timer controller (version 3) in certain Google SoCs.
```

## google-modules/soc/gs/drivers/cpufreq/Kconfig
```kconfig
# SPDX-License-Identifier: GPL-2.0-only
#
# GS CPU Frequency scaling drivers
#

config ARM_EXYNOS_ACME
	tristate "SAMSUNG EXYNOS ACME(A Cpufreq that Meets Every chipset) driver"
	default n
	help
	  This adds the CPUFreq driver for every exynos chipset. Exynos
	  ACME supported SoC must use the exynos CAL framework.

	  If in doubt, say N.
```

## google-modules/soc/gs/drivers/dma-buf/heaps/samsung/Kconfig
```kconfig
# SPDX-License-Identifier: GPL-2.0
config DMABUF_SAMSUNG_HEAPS
	tristate "DMA-BUF Userland Memory Heaps for Samsung"
	select SAMSUNG_SECURE_IOVA if EXYNOS_CONTENT_PATH_PROTECTION
	select DMABUF_HEAPS_PAGE_POOL
	select DMABUF_HEAPS_DEFERRED_FREE
	select TRUSTY_DMA_BUF_SHARED_MEM_ID
	depends on DMABUF_HEAPS
	help
	  Choose this option to enable the DMA-BUF userland memory heaps for samsung.
	  This options creates per heap chardevs in /dev/dma_heap/* which allows
	  userspace to allocate dma-bufs that can be shared between drivers.

config DMABUF_HEAPS_SAMSUNG_CHUNK
	bool "DMA-BUF CHUNK Samsung Heap"
	help
	  Choose this option to enable dma-buf CHUNK heap. This heap is backed
	  by the Contiguous Memory Allocator (CMA) and allocates the buffers that
	  are arranged into a list of fixed size chunks taken from CMA.

config DMABUF_HEAPS_SAMSUNG_CMA
	bool "DMA-BUF CMA Samsung Heap"
	help
	  Choose this option to enable dma-buf CMA heap for samsung.
	  This heap is backed by the Contiguous Memory Allocator (CMA) and have own
	  cma region by dt binding.

config DMABUF_HEAPS_SAMSUNG_CARVEOUT
	bool "DMA-BUF Carveout Samsung Heap"
	help
	  Choose this option to enable dma-buf Carveout heap for samsung.
	  This heap has own reserved region by dt binding.

config DMABUF_HEAPS_GOOGLE_GCMA
	bool "DMA-BUF GCMA Heap"
	depends on GCMA
	help
	  Choose this option to enable dma-buf GCMA heap. It allows
	  using the carved out memory space for clean page cache when memory
	  is not claimed by owner.
	  This heap has own reserved region by dt binding.

config DMABUF_HEAPS_SAMSUNG_SYSTEM
	bool "DMA-BUF System Samsung Heap"
	help
	  Choose this option to enable dma-buf System heap for samsung.
```

## google-modules/soc/gs/drivers/dma/Kconfig
```kconfig
# SPDX-License-Identifier: GPL-2.0-only
#
# DMA engine configuration
#

config SAMSUNG_DMADEV
	tristate "Legacy Samsung DMA abstraction"
	select PL330_DMA_GS
	help
	  Use DMA device engine for PL330 DMA controller.

config PL330_DMA_GS
	tristate "DMA API Driver for PL330 in Google SoCs"
	select DMA_ENGINE
	depends on ARM_AMBA
	help
	  Select if your platform is a Google SoC and has one or more PL330
	  DMACs.
```

## google-modules/soc/gs/drivers/i2c/busses/Kconfig
```kconfig
# SPDX-License-Identifier: GPL-2.0-only
#

config I2C_EXYNOS5_GS
	tristate "Exynos high-speed I2C driver for GS SoCs"
	depends on OF
	help
	  High-speed I2C controller on Google GS101.

config I2C_ACPM
	tristate "I2C_ACPM driver"
	help
	  I2C ACPM driver on GS SoCs.
```

## google-modules/soc/gs/drivers/iio/Kconfig
```kconfig
# SPDX-License-Identifier: GPL-2.0-only
#
# Industrial I/O subsystem configuration
#

if IIO

source "$(KCONFIG_SOC_GS_PREFIX)drivers/iio/power/Kconfig"

endif # IIO
```

## google-modules/soc/gs/drivers/input/fingerprint/Kconfig
```kconfig
# SPDX-License-Identifier: GPL-2.0

config GOODIX_FINGERPRINT
	tristate "generic goodix fingerprint driver"
	default n
	help
	add support for goodix fingerprint driver.
```

## google-modules/soc/gs/drivers/input/keyboard/Kconfig
```kconfig
# SPDX-License-Identifier: GPL-2.0-only
#

if INPUT_KEYBOARD

config KEYBOARD_S2MPG12
	tristate "Samsung Electronics S2MPG12 Powerkey Controller"
	depends on I2C
	depends on MFD_S2MPG12

config KEYBOARD_S2MPG14
       tristate "Samsung Electronics S2MPG14 Powerkey Controller"

endif # INPUT_KEYBOARD
```

## google-modules/soc/gs/drivers/input/misc/Kconfig
```kconfig
# SPDX-License-Identifier: GPL-2.0-only
#
# Input misc drivers configuration
#

if INPUT_MISC

source "$(KCONFIG_SOC_GS_PREFIX)drivers/input/misc/vl53l1/Kconfig"

endif
```
