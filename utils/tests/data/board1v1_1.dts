/dts-v1/;
/plugin/;

/ {
  compatible = "board_manufacturer,board_model";
  board_id = <0x00010000>;
  board_rev = <0x00010001>;
  another_board_id = <0xaabbccdd>;
  /* optional, the soc used by the board */
  soc_id = <0x00020000>;
};

&deviceB {
  value = <0x2>;
  status = "okay";
};
