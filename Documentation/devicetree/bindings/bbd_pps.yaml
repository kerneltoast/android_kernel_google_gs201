## Documentation/devicetree/bindings/google,aoc.yaml
```yaml
# SPDX-License-Identifier: GPL-2.0-only OR BSD-2-Clause
%YAML 1.2
---
$id: http://devicetree.org/schemas/reserved-memory/google,open-dice.yaml#
$schema: http://devicetree.org/meta-schemas/core.yaml#

title: AoC SoC

description: |
  This binding represents the AoC component.

maintainers:
  - Alex Iacobucci <alexiacobucci@google.com>

properties:
  compatible:
    const: google,aoc

  wifi-chip:
    description:
      integer specifying the wifi chip for that particulare device.
    maxItems: 1

required:
  - compatible

# TODO: add remaining items in required and properties.

examples:
  - |
  aoc: aoc@17000000 {
      compatible = "google,aoc";

      reg = <0x0 0x17000000 0x02000000>,
            <0x0 0x154B0000 0x00001000>,
            <0x0 0x190C0000 0x00001000>,
            <0x0 0x19060000 0x00005000>;

      reg-names = "blk_aoc", "aoc_req", "aoc_s2mpu", "ssmt_aoc";

      interrupts = <GIC_SPI IRQ_AOC_Watchdog_CPU_AOC
              IRQ_TYPE_LEVEL_HIGH 0>;
      interrupt-names = "watchdog";

      pinctrl-names = "default";
      pinctrl-0 = <&aoc_vsync_pins>;

      gsa-enabled = "true";

      iommus = <&sysmmu_aoc>;
      memory-region = <&aoc_reserve>;
      samsung,iommu-group = <&iommu_group_aoc>;

      mbox-channels = <48>;

      mbox-names = "aoc2ap";
      mboxes = <&mbox_aoc_a32  0
                &mbox_aoc_a32  1
                &mbox_aoc_a32  2
                &mbox_aoc_a32  3
                &mbox_aoc_a32  4
                &mbox_aoc_a32  5
                &mbox_aoc_a32  6
                &mbox_aoc_a32  7
                &mbox_aoc_a32  8
                &mbox_aoc_a32  9
                &mbox_aoc_a32 10
                &mbox_aoc_a32 11
                &mbox_aoc_a32 12
                &mbox_aoc_a32 13
                &mbox_aoc_a32 14
                &mbox_aoc_a32 15
                &mbox_aoc_f1 0
                &mbox_aoc_f1 1
                &mbox_aoc_f1 2
                &mbox_aoc_f1 3
                &mbox_aoc_f1 4
                &mbox_aoc_f1 5
                &mbox_aoc_f1 6
                &mbox_aoc_f1 7
                &mbox_aoc_f1 8
                &mbox_aoc_f1 9
                &mbox_aoc_f1 10
                &mbox_aoc_f1 11
                &mbox_aoc_f1 12
                &mbox_aoc_f1 13
                &mbox_aoc_f1 14
                &mbox_aoc_f1 15
                &mbox_aoc_p6 0
                &mbox_aoc_p6 1
                &mbox_aoc_p6 2
                &mbox_aoc_p6 3
                &mbox_aoc_p6 4
                &mbox_aoc_p6 5
                &mbox_aoc_p6 6
                &mbox_aoc_p6 7
                &mbox_aoc_p6 8
                &mbox_aoc_p6 9
                &mbox_aoc_p6 10
                &mbox_aoc_p6 11
                &mbox_aoc_p6 12
                &mbox_aoc_p6 13
                &mbox_aoc_p6 14
                &mbox_aoc_p6 15
      >;

      acpm-ipc-channel = <13>;

      force-vnom = <0>;

      gsa-device = <&gsa>;

      pcu-base = <0x1400000>;
      gpio-base = <0x1C00000>;
      pcu-db-set-offset = <0x1F004>;
      pcu-db-clr-offset = <0x1F008>;
      cp-aperture-start-offset = <0x7FDF80>;
      cp-aperture-end-offset = <0x7FFFFF>;
      clock-divider = <1>;

      channel-max-pending-msgs = <128>;
      block-channel-threshold = <64>;

      notify-on-state-transition = "true";
      hotword-supported = "true";
      chre-supported = "true";
  };
```

## Documentation/devicetree/bindings/google_bigwave.yaml
```yaml
# SPDX-License-Identifier: (GPL-2.0 OR BSD-2-Clause)
%YAML 1.2
---

$schema: http://devicetree.org/meta-schemas/core.yaml#

title: Bigwave video driver device tree bindings

maintainers:
  - Ruofei Ma <ruofeim@google.com>
  - Vinay Kalia <vinaykalia@google.com>
  - Wesley Lee <szuweilee@google.com>

description:
  The Bigwave video driver allows userspace access to the bigwave HW for
  the AV1 encoding and decoding tasks. The Bigwave video driver changes
  the HW frequency and votes the MIF bandwidth according to the work load.

properties:
  ip-ver:
    description: Specify the version of zuma SOC. When the value is 0,
                 zuma A0 SOC is used. Otherwise, it is zuma B0.
    type: boolean

  freq-khz:
    description: Specify the bigwave working frequency for a particular
                 workload.
    type: u32

  load-pps:
    description: Define the workload. The value, 122400, is obatined by
                 1920 * 1088 * 60 / 1024 for 1080p60fps contents.
    type: u32

  rd-bw:
    description: Define the read bandwidth in terms of Kilobyte per
                 second for the decoder.
    type: u32

  wr-bw:
    description: Define the write bandwidth in terms of Kilobyte per
                 second for the decoder.
    type: u32

  pk-bw:
    description: Define the peak bandwidth in terms of Kilobyte per
                 second for the decoder.
    type: u32

  rd-bw-afbc:
    description: Define the read bandwidth in terms of Kilobyte per
                 second for the decoder when AFBC (memory compression)
                 is enabled.
    type: u32

  wr-bw-afbc:
    description: Define the write bandwidth in terms of Kilobyte per
                 second for the decoder when AFBC (memory compression)
                 is enabled.
    type: u32

  pk-bw-afbc:
    description: Define the peak bandwidth in terms of Kilobyte per
                 second for the decoder when AFBC (memory compression)
                 is enabled.
    type: u32

  rd-bw-enc:
    description: Define the read bandwidth in terms of Kilobyte per
                 second for the encoder.
    type: u32

  wr-bw-enc:
    description: Define the write bandwidth in terms of Kilobyte per
                 second for the encoder.
    type: u32

  pk-bw-enc:
    description: Define the peak bandwidth in terms of Kilobyte per
                 second for the encoder.
    type: u32
```

## Documentation/devicetree/bindings/misc/access_ramoops.yaml
```yaml
# SPDX-License-Identifier: (GPL-2.0 OR BSD-2-Clause)
%YAML 1.2
---
$schema: http://devicetree.org/meta-schemas/core.yaml#

title: access_ramoops driver device tree bindings

maintainers:
  - Patrick Tjin <pattjin@google.com>

description: |
  The access_ramoops driver allows userspace access to the persistent RAM
  storage used for oops and panics as well as the metadata required to decrypt
  that data.

properties:
  compatible:
    const: access_ramoops

  memory-region:
    description:
       phandle to a node describing reserved memory used
       (see bindings/reserved-memory/reserved-memory.txt)
    maxItems: 1

  label:
    description:
       name of the region, will be used to create the device node /dev/<label>
    maxItems: 1

required:
  - compatible
  - memory-region
  - label
```

## Kconfig
```kconfig
config TOUCHSCREEN_HEATMAP
	tristate "Heatmap support for touchscreen"
	select VIDEOBUF2_VMALLOC
	help
	  Do not explicitly select this option. The drivers that utilize
	  this module must select this in their Kconfig.

config TOUCHSCREEN_TBN
	tristate "Touch Bus Negotiator for Google Pixel"
	help
	  Say Y here if you have a Google Pixel device. This module enables
	  support for kernel touch drivers to coordinate bus access with remote
	  processors (e.g. sensor DSP processor), which is required to enable
	  low power touch gesture detection in processors other than AP.

	  If unsure, say N.

	  To compile this driver as a module, choose M here: the module will be
	  called touch_bus_negotiator.

config TOUCHSCREEN_TBN_AOC_CHANNEL_MODE
	bool "AOC channel mode for TBN"
	depends on TOUCHSCREEN_TBN
	help
	  Say Y here if you want to enable AOC channel mode for TBN.

	  If unsure, say N.

config TOUCHSCREEN_OFFLOAD
	tristate "Touchscreen algorithm offload"
	help
	  Say Y here to enable touchscreen algorithm offload. This module allows
	  the touchscreen driver to feed heatmap data into a char device to be
	  consumed by a client outside the kernel.

	  If unsure, say N.

config GOOG_TOUCH_INTERFACE
	tristate "Google Touch Interface (GTI)"
	depends on TOUCHSCREEN_OFFLOAD
	depends on TOUCHSCREEN_HEATMAP
	help
	  Say Y here if you want to enable the Google Touch Interface driver.

	  If unsure, say N.

config TOUCHSCREEN_SPI_FLASH
        bool "Touchscreen with flash support"
        default n
        help
          Say Y here if you have the touchscreen with flash support.

          If unsure, say N.

config GOOG_USI_STYLUS
	tristate "Google USI Stylus Subsystem"
	help
	  Say Y here if you want to enable the Google USI Stylus Subsystem.

	  If unsure, Say N.
```
