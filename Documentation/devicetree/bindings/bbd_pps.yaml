## audiometrics/Kconfig
```kconfig
# SPDX-License-Identifier: GPL-2.0

config AUDIOMETRICS
	tristate "Google Audio Metrics"
```

## cs35l41/Kconfig
```kconfig
config SND_SOC_CS35L41
        tristate "Cirrus Logic CS35L41 CODEC"
        select SND_SOC_WM_ADSP

config SND_SOC_CS35L41_SPI
	tristate "Cirrus Logic CS35L41 CODEC (SPI)"
	depends on SND_SOC_CS35L41
	depends on SPI_MASTER
	select SND_SOC_CS35L41
	select REGMAP_SPI

config SND_SOC_CS35L41_I2C
	tristate "Cirrus Logic CS35L41 CODEC (I2C)"
	depends on I2C
	select SND_SOC_CS35L41
	select REGMAP_I2C
```

## cs35l45/Kconfig
```kconfig
config SND_SOC_CS35L45
        tristate "Cirrus Logic CS35L45 CODEC"
        select SND_SOC_WM_ADSP

config SND_SOC_CS35L45_SPI
	tristate "Cirrus Logic CS35L45 CODEC (SPI)"
	depends on SND_SOC_CS35L45
	depends on SPI_MASTER
	select SND_SOC_CS35L45
	select REGMAP_SPI

config SND_SOC_CS35L45_I2C
	tristate "Cirrus Logic CS35L45 CODEC (I2C)"
	depends on I2C
	select SND_SOC_CS35L45
	select REGMAP_I2C
```

## drivers/bts/Kconfig
```kconfig
# SPDX-License-Identifier: GPL-2.0
#
# BTS device driver Kernel Configuration
#
menuconfig EXYNOS_BTS
       tristate "BTS device driver support"
       help
         Enables BTS(Bus Traffic Shaper) device driver support
         BTS device driver will set BTS and request DVFS for
         controlling system bus traffic. Default setting of BTS
         should be different to chipset because of hardware characteristics.
```

## drivers/char/hw_random/Kconfig
```kconfig
# SPDX-License-Identifier: GPL-2.0-only
#
# Hardware Random Number Generator (RNG) configuration
#

config HW_RANDOM_EXYNOS_SWD
	tristate "EXYNOS SWD HW random number generator support"
	default n
	help
	  This driver provides kernel-side support for TRNG hardware
	  found in secure world by using smc call

	  To compile this driver as a module, choose M here: the
	  module will be called exynos-rng.

	  If unsure, say Y.
```

## drivers/clk/gs/Kconfig
```kconfig
# SPDX-License-Identifier: GPL-2.0-only

config EXYNOS_GS_COMMON_CLK
	tristate "Samsung Exynos clock controller support for GS SoCs"
	depends on CAL_IF
	help
	  Support for the Exynos clock controller for the GS SoCs.
	  Select Y/M if you build for this SoC.
```

## drivers/clk/samsung/Kconfig
```kconfig
# SPDX-License-Identifier: GPL-2.0-only
# Recent Exynos platforms should just select COMMON_CLK_SAMSUNG:
config EXYNOS_ARM64_COMMON_CLK
	bool "Samsung Exynos ARMv8-family clock controller support" if COMPILE_TEST
	depends on COMMON_CLK_SAMSUNG

config EXYNOS_AUDSS_CLK_CON
	tristate "Samsung Exynos AUDSS clock controller support"
	depends on COMMON_CLK_SAMSUNG
	default y if ARCH_EXYNOS
	help
	  Support for the Audio Subsystem CLKCON clock controller present
	  on some Exynos SoC variants. Choose M or Y here if you want to
	  use audio devices such as I2S, PCM, etc.

# For S3C24XX platforms, select following symbols:
config S3C2410_COMMON_CLK
	bool "Samsung S3C2410 clock controller support" if COMPILE_TEST
	select COMMON_CLK_SAMSUNG
	help
	  Build the s3c2410 clock driver based on the common clock framework.

config S3C2410_COMMON_DCLK
	bool
	select COMMON_CLK_SAMSUNG
	select REGMAP_MMIO
	help
	  Temporary symbol to build the dclk driver based on the common clock
	  framework.

config S3C2412_COMMON_CLK
	bool "Samsung S3C2412 clock controller support" if COMPILE_TEST
	select COMMON_CLK_SAMSUNG

config S3C2443_COMMON_CLK
	bool "Samsung S3C2443 clock controller support" if COMPILE_TEST
	select COMMON_CLK_SAMSUNG

config COMPOSITE_CLK_SAMSUNG
	tristate "Samsung Exynos clock controller support"
	depends on COMMON_CLK_SAMSUNG && CAL_IF
```

## drivers/devfreq/google/Kconfig
```kconfig
# SPDX-License-Identifier: GPL-2.0-only

config ARM_MEMLAT_MON
	tristate "ARM CPU Memory Latency monitor hardware"
	help
	  The PMU present on these ARM cores allow for the use of counters to
	  monitor the memory latency characteristics of an ARM CPU workload.
	  This driver uses these counters to implement the APIs needed by
	  the mem_latency devfreq governor.

config DEVFREQ_GOV_MEMLAT
	tristate "HW monitor based governor for device BW"
	depends on ARM_MEMLAT_MON
	help
	  HW monitor based governor for device to DDR bandwidth voting.
	  This governor sets the CPU BW vote based on stats obtained from memalat
	  monitor if it determines that a workload is memory latency bound. Since
	  this uses target specific counters it can conflict with existing profiling
	  tools.

config MEMLAT_DEVFREQ
	tristate "HW monitor based DEVFREQ driver for device BW"
	depends on ARM_MEMLAT_MON
	help
	  This adds the DEVFREQ driver for memory latency goverors.

config ARM_EXYNOS_DEVFREQ
	tristate "ARM EXYNOS DEVFREQ Common driver"
	select PM_OPP
	help
	  This adds the DEVFREQ driver for Exynos series common bus

config EXYNOS_ALT_DVFS
	tristate "ALT(Active Load Tracing) DVFS"
	depends on ARM_EXYNOS_DEVFREQ
	help
	  Enable ALT-DVFS scheme for simpleinteractive governor.
	  When ALT-DVFS is enabled, governor will start to trace and
	  calculate memory load based on activated cycle. Simpleinteractive
	  governor decides new frequency for DVFS by comparing current load
	  and PM QoS requests.
```

## drivers/dma-buf/heaps/Kconfig
```kconfig
# SPDX-License-Identifier: GPL-2.0

source "$(KCONFIG_SOC_GS_PREFIX)drivers/dma-buf/heaps/samsung/Kconfig"
```

## drivers/dma-buf/heaps/samsung/Kconfig
```kconfig
# SPDX-License-Identifier: GPL-2.0
config DMABUF_SAMSUNG_HEAPS
	tristate "DMA-BUF Userland Memory Heaps for Samsung"
	depends on DMABUF_HEAPS
	help
	  Choose this option to enable the DMA-BUF userland memory heaps for samsung.
	  This options creates per heap chardevs in /dev/dma_heap/* which allows
	  userspace to allocate dma-bufs that can be shared between drivers.

config DMABUF_HEAPS_SAMSUNG_CMA
	bool "DMA-BUF CMA Samsung Heap"
	help
	  Choose this option to enable dma-buf CMA heap for samsung.
	  This heap is backed by the Contiguous Memory Allocator (CMA) and have own
	  cma region by dt binding.

config DMABUF_HEAPS_SAMSUNG_CARVEOUT
	bool "DMA-BUF Carveout Samsung Heap"
	help
	  Choose this option to enable dma-buf Carveout heap for samsung.
	  This heap has own reserved region by dt binding.

config DMABUF_HEAPS_SAMSUNG_SYSTEM
	bool "DMA-BUF System Samsung Heap"
	help
	  Choose this option to enable dma-buf System heap for samsung.
```

## drivers/edgetpu/Kconfig
```kconfig
menu "EdgeTPU devices"

config EDGETPU_FRAMEWORK
	tristate "EdgeTPU framework"
	depends on X86_64 || ARM64
	select DMA_SHARED_BUFFER
	select GENERIC_ALLOCATOR
	select IOMMU_API
	select SYNC_FILE
	help
	  This framework supports darwinn-2.0 devices.

config JANEIRO
	tristate "Janeiro ML accelerator device driver"
	depends on EDGETPU_FRAMEWORK
	select PM
	help
	  This driver supports the Janeiro device.  Say Y if you want to
	  include this driver in the kernel.

	  To compile this driver as a module, choose M here.  The module
	  will be called "janeiro".

config EDGETPU_EXTERNAL_WRAPPER_CLASS
        bool "EdgeTPU add external wrapper class"
	depends on EDGETPU_FRAMEWORK
	default n
	help
	  Selected if an external wrapper class is to be used.  This option is
	  intended to be auto-selected by other config options that depend on
	  external classes that wrap the EdgeTPU core driver and is not
	  intended for interactive use.

config EDGETPU_TELEMETRY_TRACE
	bool "Build EdgeTPU driver with firmware tracing support"
	depends on EDGETPU_FRAMEWORK
	default y
	help
	  Say Y to have the driver handle the tracing events sent from the
	  firmware. Enable this will increase the time for setup, suggest to
	  disable this in production mode to reduce the software overhead.

	  It's fine to have this enabled even the firmware doesn't send tracing
	  events.

endmenu
```

## drivers/gpu/exynos/Kconfig
```kconfig
# SPDX-License-Identifier: GPL-2.0

menu "Exynos Graphic Devices"
source "$(KCONFIG_SOC_GS_PREFIX)drivers/gpu/exynos/g2d/Kconfig"
endmenu
```

## drivers/gpu/exynos/g2d/Kconfig
```kconfig
# SPDX-License-Identifier: GPL-2.0-only
config EXYNOS_GRAPHICS_G2D
	tristate "FIMG2D support"
	select SYNC_FILE
	help
	  This enables FIMG2D driver of Exynos SoCs.

config G2D_SYSTRACE
	bool "FIMG2D systrace debug support"
	help
	  This enables systrace logging for debug.
```

## drivers/iio/power/Kconfig
```kconfig
# SPDX-License-Identifier: GPL-2.0
#
# Power sensors
#
# When adding new entries keep the list in alphabetical order

menu "Power sensors"

config ODPM
	tristate "ODPM driver for M/S PMICs"
	depends on (SOC_GS101 && MFD_S2MPG10 && MFD_S2MPG11) || \
		   (SOC_GS201 && MFD_S2MPG12 && MFD_S2MPG13) || \
		   (SOC_ZUMA && MFD_S2MPG14 && MFD_S2MPG15)
	select DRV_SAMSUNG_PMIC
	help
	  Say Y here to enable the On-Device Power Monitor (ODPM) driver.
	  The On-Device Power Monitor allows for rail-specific energy and power
	  measurements of the different subdomains of a PMIC device. The ODPM
	  driver also allows for rail selection out of a subset of measurement
	  "channels".

endmenu
```

## drivers/input/Kconfig
```kconfig
# SPDX-License-Identifier: GPL-2.0-only
#
# Input device configuration
#

if INPUT

config INPUT_KEYDEBUG
	tristate "Long Press Key Debugging"
	depends on INPUT && KERNEL_TOP
	select INPUT_KEYCOMBO
	help
	  Say Y here if you want to hook debug function to dump information
	  to debug device hang when some keys are long pressed.

config INPUT_KEYCOMBO
	tristate "Key combo"
	depends on INPUT
	help
	  Say Y here if you want to take action when some keys are pressed;


source "$(KCONFIG_SOC_GS_PREFIX)drivers/input/misc/Kconfig"

source "$(KCONFIG_SOC_GS_PREFIX)drivers/input/fingerprint/Kconfig"

source "$(KCONFIG_SOC_GS_PREFIX)drivers/input/keyboard/Kconfig"

endif
```
